AUTOSAR XML (schema 00048)
package /COM/VECTOR/CFG/WORKFLOW/SYSDESC/SYNC
  system SYSTEM: category=ECU_EXTRACT
    system mapping MAPPINGS
    root-software-compositions:
      root sw composition prototype COMPOSITIONTYPE: flat-map=FLATMAP, software-composition=COMPOSITIONTYPE
  composition sw component type COMPOSITIONTYPE  # UB:Derived from original system description
    6 x component:
      BswM: type=BswM
      Os_OsCore0_swc: type=Os_OsCore0_swc
      EcuM: type=EcuM
      swc_test: type=swc_test
      ComM: type=ComM
      Det: type=Det
    connect BswM.Switch_ESH_ModeSwitch -> BswM.Notification_ESH_ModeNotification
    connect swc_test.Request_ESH_PostRunRequest_0 -> BswM.Request_ESH_PostRunRequest_0
    connect ComM.UR_CN_testCANFDdbc_76c2c5ca -> swc_test.UR_CN_testCANFDdbc_76c2c5ca
  end to end protection set E2EPROTECTIONSET
  port interface mapping set PORTINTERFACEMAPPINGSET
