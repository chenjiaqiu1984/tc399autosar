AUTOSAR XML (schema 00048)
package /MICROSAR
  bsw implementation PduR_Impl: programming-language=C, sw-version=15.04.01, used-code-generator=DaVinci Configurator, vendor-id=30, ar-release-version=4.01.02
package /MICROSAR/PduR_ib_bswmd/BswModuleDescriptions
  bsw module description PduR
    bsw internal behavior PduRBehavior
      exclusive area PDUR_EXCLUSIVE_AREA_0
