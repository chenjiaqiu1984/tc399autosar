AUTOSAR XML (schema 00048)
package /ActiveEcuC
  module config Rte: implementation-config-variant=VARIANT-PRE-COMPILE, module-description=Rte_Impl
    RteOsInteraction
      3 x RteUsedOsActivation, all with RteExpectedActivationOffset=0, RteExpectedTickDuration=0:
        Rte_Al_TE2_bsw_task_0_10ms: RteActivationOsAlarmRef=Rte_Al_TE2_bsw_task_0_10ms, RteActivationOsTaskRef=bsw_task
        Rte_Al_TE_swc_test_swc_test_10ms: RteActivationOsAlarmRef=Rte_Al_TE_swc_test_swc_test_10ms, RteActivationOsTaskRef=swc_task
        Rte_Al_TE_swc_test_swc_test_500ms: RteActivationOsAlarmRef=Rte_Al_TE_swc_test_swc_test_500ms, RteActivationOsTaskRef=swc_task
    RteGeneration:
      RteGenerationMode = COMPATIBILITY_MODE
      RteIocInteractionReturnValue = RTE_IOC
      RteValueRangeCheckEnabled = false
      RteCalibrationSupport = NONE
      RteCodeVendorId = 30
      RteDevErrorDetect = false
      RteDevErrorDetectUninit = false
      RteMeasurementSupport = false
      RteOptimizationMode = MEMORY
      RteVfbTraceEnabled = false
    RteInitializationBehavior: RteInitializationStrategy=RTE_INITIALIZATION_STRATEGY_AT_DATA_DECLARATION, RteSectionInitializationPolicy=INIT
    RteBswGeneral: RteSchMVersionInfoApi=false, RteUseComShadowSignalApi=false
    5 x RteBswModuleInstance:
      BswM: RteBswImplementationRef=BswM_Impl, RteBswModuleConfigurationRef=BswM
        BSWM_EXCLUSIVE_AREA_0 (RteBswExclusiveAreaImpl): RteExclusiveAreaImplMechanism=ALL_INTERRUPT_BLOCKING, RteBswExclusiveAreaRef=BSWM_EXCLUSIVE_AREA_0
        BswM_MainFunctionTimingEvent0 (RteBswEventToTaskMapping):
          RteBswImmediateRestart = false
          RteBswPositionInTask = 8
          RteBswEventRef = BswM_MainFunctionTimingEvent0
          RteBswMappedToTaskRef = bsw_task
          RteBswUsedOsAlarmRef = Rte_Al_TE2_bsw_task_0_10ms
      Dio: RteBswImplementationRef=Dio_Impl, RteBswModuleConfigurationRef=Dio
      McalLib: RteBswImplementationRef=McalLib_Impl, RteBswModuleConfigurationRef=McalLib
        4 x RteBswExclusiveAreaImpl, all with RteExclusiveAreaImplMechanism=ALL_INTERRUPT_BLOCKING:
          PeripheralEndInit: RteBswExclusiveAreaRef=PeripheralEndInit
          SafetyEndInit: RteBswExclusiveAreaRef=SafetyEndInit
          CpuEndInit: RteBswExclusiveAreaRef=CpuEndInit
          StmTimerResolution: RteBswExclusiveAreaRef=StmTimerResolution
      Mcu: RteBswImplementationRef=Mcu_Impl, RteBswModuleConfigurationRef=Mcu
        TomTgcReg (RteBswExclusiveAreaImpl): RteExclusiveAreaImplMechanism=ALL_INTERRUPT_BLOCKING, RteBswExclusiveAreaRef=TomTgcReg
        AtomAgcReg (RteBswExclusiveAreaImpl): RteExclusiveAreaImplMechanism=ALL_INTERRUPT_BLOCKING, RteBswExclusiveAreaRef=AtomAgcReg
      Port: RteBswImplementationRef=Port_Impl, RteBswModuleConfigurationRef=Port
    BswM_EcuSwComposition (RteSwComponentInstance): RteSoftwareComponentInstanceRef=BswM
      Timer_BswM_MainFunction (RteEventToTaskMapping):
        RteImmediateRestart = false
        RtePositionInTask = 8
        RteEventRef = Timer_BswM_MainFunction
        RteMappedToTaskRef = bsw_task
        RteUsedOsAlarmRef = Rte_Al_TE2_bsw_task_0_10ms
    Os_OsCore0_swc_EcuSwComposition (RteSwComponentInstance): RteSoftwareComponentInstanceRef=Os_OsCore0_swc
      OpEventGetCounterValue_GetCounterValue_OsService_SystemTimer (RteEventToTaskMapping): RteImmediateRestart=false, RteEventRef=OpEventGetCounterValue_GetCounterValue_OsService_SystemTimer
      OpEventGetElapsedValue_GetElapsedValue_OsService_SystemTimer (RteEventToTaskMapping): RteImmediateRestart=false, RteEventRef=OpEventGetElapsedValue_GetElapsedValue_OsService_SystemTimer
    EcuM (RteBswModuleInstance): RteBswImplementationRef=EcuM_Impl, RteBswModuleConfigurationRef=EcuM
      4 x RteBswExclusiveAreaImpl, all with RteExclusiveAreaImplMechanism=ALL_INTERRUPT_BLOCKING:
        ECUM_EXCLUSIVE_AREA_{0..3}: RteBswExclusiveAreaRef=ECUM_EXCLUSIVE_AREA_{0..3}
      EcuM_MainFunctionTimingEvent0 (RteBswEventToTaskMapping):
        RteBswImmediateRestart = false
        RteBswPositionInTask = 9
        RteBswEventRef = EcuM_MainFunctionTimingEvent0
        RteBswMappedToTaskRef = bsw_task
        RteBswUsedOsAlarmRef = Rte_Al_TE2_bsw_task_0_10ms
    Rte (RteBswModuleInstance): RteBswImplementationRef=Rte_Impl, RteBswModuleConfigurationRef=Rte
    EcuM_EcuSwComposition (RteSwComponentInstance): RteSoftwareComponentInstanceRef=EcuM
      8 x RteEventToTaskMapping, all with RteImmediateRestart=false:
        Timer_EcuM_MainFunction: RtePositionInTask=9, RteEventRef=Timer_EcuM_MainFunction, RteMappedToTaskRef=bsw_task, RteUsedOsAlarmRef=Rte_Al_TE2_bsw_task_0_10ms
        OpEventSelectShutdownTarget_SelectShutdownTarget_EcuM_ShutdownTarget: RteEventRef=OpEventSelectShutdownTarget_SelectShutdownTarget_EcuM_ShutdownTarget
        OpEventGetShutdownTarget_GetShutdownTarget_EcuM_ShutdownTarget: RteEventRef=OpEventGetShutdownTarget_GetShutdownTarget_EcuM_ShutdownTarget
        OpEventGetLastShutdownTarget_GetLastShutdownTarget_EcuM_ShutdownTarget: RteEventRef=OpEventGetLastShutdownTarget_GetLastShutdownTarget_EcuM_ShutdownTarget
        OpEventSelectShutdownCause_SelectShutdownCause_EcuM_ShutdownTarget: RteEventRef=OpEventSelectShutdownCause_SelectShutdownCause_EcuM_ShutdownTarget
        OpEventGetShutdownCause_GetShutdownCause_EcuM_ShutdownTarget: RteEventRef=OpEventGetShutdownCause_GetShutdownCause_EcuM_ShutdownTarget
        OpEventSelectBootTarget_SelectBootTarget_EcuM_BootTarget: RteEventRef=OpEventSelectBootTarget_SelectBootTarget_EcuM_BootTarget
        OpEventGetBootTarget_GetBootTarget_EcuM_BootTarget: RteEventRef=OpEventGetBootTarget_GetBootTarget_EcuM_BootTarget
    swc_test_EcuSwComposition (RteSwComponentInstance): RteSoftwareComponentInstanceRef=swc_test
      3 x RteEventToTaskMapping, all with RteImmediateRestart=false:
        swc_test_InitEvent: RtePositionInTask=0, RteEventRef=swc_test_InitEvent, RteMappedToTaskRef=swc_init
        TMT_swc_test_500ms: RtePositionInTask=1, RteEventRef=TMT_swc_test_500ms, RteMappedToTaskRef=swc_task, RteUsedOsEventRef=Rte_Ev_Run_swc_test_swc_test_500ms, RteUsedOsAlarmRef=Rte_Al_TE_swc_test_swc_test_500ms
        TMT_swc_test_10ms: RtePositionInTask=0, RteEventRef=TMT_swc_test_10ms, RteMappedToTaskRef=swc_task, RteUsedOsEventRef=Rte_Ev_Run_swc_test_swc_test_10ms, RteUsedOsAlarmRef=Rte_Al_TE_swc_test_swc_test_10ms
    swc_test (RteSwComponentType): RteComponentTypeRef=swc_test, RteImplementationRef=swc_test_Implementation
      ComponentTypeCalibration (RteComponentTypeCalibration): RteCalibrationSupportEnabled=false
