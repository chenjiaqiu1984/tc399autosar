AUTOSAR XML (schema 00048)
package /Dio
  module config Dio: implementation-config-variant=VARIANT-LINK-TIME, module-description=Dio_Impl
    CommonPublishedInformation:
      ArMajorVersion = 4
      ArMinorVersion = 4
      ArPatchVersion = 0
      ModuleId = 120
      Release = _TRICORE_TC399
      SwMajorVersion = 20
      SwMinorVersion = 25
      SwPatchVersion = 0
      VendorId = 17
    DioConfig
      DioPort_20 (DioPort): DioPortId=20
        4 x DioChannel:
          DioChannel_20_{11..14}: DioChannelId={11..14}
      DioPort_33 (DioPort): DioPortId=33
        4 x DioChannel:
          DioChannel_33_{4..7}: DioChannelId={4..7}
    DioGeneral: DioDevErrorDetect=false, DioFlipChannelApi=true, DioMaskedWritePortApi=false, DioSafetyEnable=false, DioVersionInfoApi=false
