AUTOSAR XML (schema 00048)
package /ActiveEcuC
  module config vBaseEnv: implementation-config-variant=VARIANT-PRE-COMPILE, module-description=vBaseEnv_Impl
    vBaseEnvGeneral: vBaseEnvTestedDerivativeRef=TC399X_StepB
      vBaseEnvInterruptHandling
        vBaseEnvCan
          9 x vBaseEnvChannel:
            SRC_CAN0INT0: vBaseEnvIndex=0, vBaseEnvIsrInterruptPriority=10, vBaseEnvIsrInterruptSource=1456
            SRC_CAN0INT1: vBaseEnvIndex=0, vBaseEnvIsrInterruptPriority=11, vBaseEnvIsrInterruptSource=1460
            SRC_CAN0INT2: vBaseEnvIndex=0, vBaseEnvIsrInterruptPriority=12, vBaseEnvIsrInterruptSource=1464
            SRC_CAN1INT0: vBaseEnvIndex=1, vBaseEnvIsrInterruptPriority=13, vBaseEnvIsrInterruptSource=1520
            SRC_CAN1INT1: vBaseEnvIndex=1, vBaseEnvIsrInterruptPriority=14, vBaseEnvIsrInterruptSource=1524
            SRC_CAN1INT2: vBaseEnvIndex=1, vBaseEnvIsrInterruptPriority=15, vBaseEnvIsrInterruptSource=1528
            SRC_CAN2INT0: vBaseEnvIndex=2, vBaseEnvIsrInterruptPriority=16, vBaseEnvIsrInterruptSource=1584
            SRC_CAN2INT1: vBaseEnvIndex=2, vBaseEnvIsrInterruptPriority=17, vBaseEnvIsrInterruptSource=1588
            SRC_CAN2INT2: vBaseEnvIndex=2, vBaseEnvIsrInterruptPriority=18, vBaseEnvIsrInterruptSource=1592
        vBaseEnvLin
          12 x vBaseEnvChannel:
            SRC_ASCLIN0TX: vBaseEnvIndex=0, vBaseEnvIsrInterruptPriority=20, vBaseEnvIsrInterruptSource=80
            SRC_ASCLIN0RX: vBaseEnvIndex=0, vBaseEnvIsrInterruptPriority=21, vBaseEnvIsrInterruptSource=84
            SRC_ASCLIN0ERR: vBaseEnvIndex=0, vBaseEnvIsrInterruptPriority=22, vBaseEnvIsrInterruptSource=88
            SRC_ASCLIN1TX: vBaseEnvIndex=1, vBaseEnvIsrInterruptPriority=23, vBaseEnvIsrInterruptSource=92
            SRC_ASCLIN1RX: vBaseEnvIndex=1, vBaseEnvIsrInterruptPriority=24, vBaseEnvIsrInterruptSource=96
            SRC_ASCLIN1ERR: vBaseEnvIndex=1, vBaseEnvIsrInterruptPriority=25, vBaseEnvIsrInterruptSource=100
            SRC_ASCLIN2TX: vBaseEnvIndex=2, vBaseEnvIsrInterruptPriority=26, vBaseEnvIsrInterruptSource=104
            SRC_ASCLIN2RX: vBaseEnvIndex=2, vBaseEnvIsrInterruptPriority=27, vBaseEnvIsrInterruptSource=108
            SRC_ASCLIN2ERR: vBaseEnvIndex=2, vBaseEnvIsrInterruptPriority=28, vBaseEnvIsrInterruptSource=112
            SRC_ASCLIN3TX: vBaseEnvIndex=3, vBaseEnvIsrInterruptPriority=29, vBaseEnvIsrInterruptSource=116
            SRC_ASCLIN3RX: vBaseEnvIndex=3, vBaseEnvIsrInterruptPriority=30, vBaseEnvIsrInterruptSource=120
            SRC_ASCLIN3ERR: vBaseEnvIndex=3, vBaseEnvIsrInterruptPriority=31, vBaseEnvIsrInterruptSource=124
        vBaseEnvEthernet
          10 x vBaseEnvChannel, all with vBaseEnvIndex=0:
            SRC_GETH0: vBaseEnvIsrInterruptPriority=30, vBaseEnvIsrInterruptSource=1408
            SRC_GETH1: vBaseEnvIsrInterruptPriority=31, vBaseEnvIsrInterruptSource=1412
            SRC_GETH2: vBaseEnvIsrInterruptPriority=32, vBaseEnvIsrInterruptSource=1416
            SRC_GETH3: vBaseEnvIsrInterruptPriority=33, vBaseEnvIsrInterruptSource=1420
            SRC_GETH4: vBaseEnvIsrInterruptPriority=34, vBaseEnvIsrInterruptSource=1424
            SRC_GETH5: vBaseEnvIsrInterruptPriority=35, vBaseEnvIsrInterruptSource=1428
            SRC_GETH6: vBaseEnvIsrInterruptPriority=36, vBaseEnvIsrInterruptSource=1432
            SRC_GETH7: vBaseEnvIsrInterruptPriority=37, vBaseEnvIsrInterruptSource=1436
            SRC_GETH8: vBaseEnvIsrInterruptPriority=38, vBaseEnvIsrInterruptSource=1440
            SRC_GETH9: vBaseEnvIsrInterruptPriority=39, vBaseEnvIsrInterruptSource=1444
        vBaseEnvFlexray
          10 x vBaseEnvChannel, all with vBaseEnvIndex=0:
            SRC_ERAY0INT0: vBaseEnvIsrInterruptPriority=40, vBaseEnvIsrInterruptSource=2048
            SRC_ERAY0INT1: vBaseEnvIsrInterruptPriority=41, vBaseEnvIsrInterruptSource=2052
            SRC_ERAY0TINT0: vBaseEnvIsrInterruptPriority=42, vBaseEnvIsrInterruptSource=2056
            SRC_ERAY0TINT1: vBaseEnvIsrInterruptPriority=43, vBaseEnvIsrInterruptSource=2060
            SRC_ERAYxNDAT0: vBaseEnvIsrInterruptPriority=44, vBaseEnvIsrInterruptSource=2064
            SRC_ERAY0NDAT1: vBaseEnvIsrInterruptPriority=45, vBaseEnvIsrInterruptSource=2068
            SRC_ERAY0MBSC0: vBaseEnvIsrInterruptPriority=46, vBaseEnvIsrInterruptSource=2072
            SRC_ERAY0MBSC1: vBaseEnvIsrInterruptPriority=47, vBaseEnvIsrInterruptSource=2076
            SRC_ERAY0OBUSY: vBaseEnvIsrInterruptPriority=48, vBaseEnvIsrInterruptSource=2080
            SRC_ERAY0IBUSY: vBaseEnvIsrInterruptPriority=49, vBaseEnvIsrInterruptSource=2084
      34 x vBaseEnvMemLayoutHwRegion:
        DSPR0
        PSPR0
        DSPR1
        PSPR1
        DSPR2
        PSPR2
        DSPR3
        PSPR3
        DSPR4
        PSPR4
        DSPR5
        PSPR5
        PFlash0_Cached
        PFlash0_NonCached
        PFlash1_Cached
        PFlash1_NonCached
        PFlash2_Cached
        PFlash2_NonCached
        PFlash3_Cached
        PFlash3_NonCached
        PFlash4_Cached
        PFlash4_NonCached
        PFlash5_Cached
        PFlash5_NonCached
        LMU0_Cached
        LMU0_NonCached
        LMU1_Cached
        LMU1_NonCached
        LMU2_Cached
        LMU2_NonCached
        BMHD{0..3}
      TC399X_StepB (vBaseEnvDerivativeInformation):
        vBaseEnvCpuCoreAmount = 6
        vBaseEnvCpuMaxFrequency = 300000000
        vBaseEnvTestedDerivative = TC39x
        vBaseEnvTestedDerivativeDescription = Infineon Aurix 2G TC39x Family
        vBaseEnvAvailableChannels_Can = 12
        vBaseEnvAvailableChannels_Ethernet = 1
        vBaseEnvAvailableChannels_Flexray = 4
        vBaseEnvAvailableChannels_Lin = 12
        vBaseEnvCpuCore = TC162
        vBaseEnvAdditionalParameters: vBaseEnvWatchdogGroup=B, vBaseEnvPllGroup=B, vBaseEnvPortGroup=B, vBaseEnvResetGroup=B, vBaseEnvDerivativeGroup=TC3xx
        34 x vBaseEnvMemLayoutHwRegion:
          DSPR0: vBaseEnvHwRegionStartAddress=1879048192, vBaseEnvHwRegionSize=245760, vBaseEnvHwRegionType=RAM
          PSPR0: vBaseEnvHwRegionStartAddress=1880096768, vBaseEnvHwRegionSize=65536, vBaseEnvHwRegionType=RAM
          DSPR1: vBaseEnvHwRegionStartAddress=1610612736, vBaseEnvHwRegionSize=245760, vBaseEnvHwRegionType=RAM
          PSPR1: vBaseEnvHwRegionStartAddress=1611661312, vBaseEnvHwRegionSize=65536, vBaseEnvHwRegionType=RAM
          DSPR2: vBaseEnvHwRegionStartAddress=1342177280, vBaseEnvHwRegionSize=98304, vBaseEnvHwRegionType=RAM
          PSPR2: vBaseEnvHwRegionStartAddress=1343225856, vBaseEnvHwRegionSize=65536, vBaseEnvHwRegionType=RAM
          DSPR3: vBaseEnvHwRegionStartAddress=1073741824, vBaseEnvHwRegionSize=98304, vBaseEnvHwRegionType=RAM
          PSPR3: vBaseEnvHwRegionStartAddress=1074790400, vBaseEnvHwRegionSize=98304, vBaseEnvHwRegionType=RAM
          DSPR4: vBaseEnvHwRegionStartAddress=805306368, vBaseEnvHwRegionSize=98304, vBaseEnvHwRegionType=RAM
          PSPR4: vBaseEnvHwRegionStartAddress=806354944, vBaseEnvHwRegionSize=98304, vBaseEnvHwRegionType=RAM
          DSPR5: vBaseEnvHwRegionSize=98304, vBaseEnvHwRegionStartAddress=268435456, vBaseEnvHwRegionType=RAM
          PSPR5: vBaseEnvHwRegionStartAddress=269484032, vBaseEnvHwRegionSize=98304, vBaseEnvHwRegionType=RAM
          PFlash0_Cached: vBaseEnvHwRegionStartAddress=2147483648, vBaseEnvHwRegionSize=3145728, vBaseEnvHwRegionType=ROM
          PFlash0_NonCached: vBaseEnvHwRegionStartAddress=2684354560, vBaseEnvHwRegionSize=3145728, vBaseEnvHwRegionType=ROM
          PFlash1_Cached: vBaseEnvHwRegionStartAddress=2150629376, vBaseEnvHwRegionSize=3145728, vBaseEnvHwRegionType=ROM
          PFlash1_NonCached: vBaseEnvHwRegionStartAddress=2687500288, vBaseEnvHwRegionSize=3145728, vBaseEnvHwRegionType=ROM
          PFlash2_Cached: vBaseEnvHwRegionStartAddress=2153775104, vBaseEnvHwRegionSize=3145728, vBaseEnvHwRegionType=ROM
          PFlash2_NonCached: vBaseEnvHwRegionStartAddress=2690646016, vBaseEnvHwRegionSize=3145728, vBaseEnvHwRegionType=ROM
          PFlash3_Cached: vBaseEnvHwRegionStartAddress=2156920832, vBaseEnvHwRegionSize=3145728, vBaseEnvHwRegionType=ROM
          PFlash3_NonCached: vBaseEnvHwRegionStartAddress=2693791744, vBaseEnvHwRegionSize=3145728, vBaseEnvHwRegionType=ROM
          PFlash4_Cached: vBaseEnvHwRegionStartAddress=2160066560, vBaseEnvHwRegionSize=3145728, vBaseEnvHwRegionType=ROM
          PFlash4_NonCached: vBaseEnvHwRegionStartAddress=2696937472, vBaseEnvHwRegionSize=3145728, vBaseEnvHwRegionType=ROM
          PFlash5_Cached: vBaseEnvHwRegionStartAddress=2163212288, vBaseEnvHwRegionSize=1048576, vBaseEnvHwRegionType=ROM
          PFlash5_NonCached: vBaseEnvHwRegionStartAddress=2700083200, vBaseEnvHwRegionSize=1048576, vBaseEnvHwRegionType=ROM
          LMU0_Cached: vBaseEnvHwRegionStartAddress=2416181248, vBaseEnvHwRegionSize=262144, vBaseEnvHwRegionType=RAM
          LMU0_NonCached: vBaseEnvHwRegionStartAddress=2953052160, vBaseEnvHwRegionSize=262144, vBaseEnvHwRegionType=RAM
          LMU1_Cached: vBaseEnvHwRegionStartAddress=2416443392, vBaseEnvHwRegionSize=262144, vBaseEnvHwRegionType=RAM
          LMU1_NonCached: vBaseEnvHwRegionStartAddress=2953314304, vBaseEnvHwRegionSize=262144, vBaseEnvHwRegionType=RAM
          LMU2_Cached: vBaseEnvHwRegionStartAddress=2416705536, vBaseEnvHwRegionSize=262144, vBaseEnvHwRegionType=RAM
          LMU2_NonCached: vBaseEnvHwRegionStartAddress=2953576448, vBaseEnvHwRegionSize=262144, vBaseEnvHwRegionType=RAM
          BMHD0: vBaseEnvHwRegionStartAddress=2940207104, vBaseEnvHwRegionSize=512, vBaseEnvHwRegionType=ROM
          BMHD1: vBaseEnvHwRegionStartAddress=2940207616, vBaseEnvHwRegionSize=512, vBaseEnvHwRegionType=ROM
          BMHD2: vBaseEnvHwRegionStartAddress=2940208128, vBaseEnvHwRegionSize=512, vBaseEnvHwRegionType=ROM
          BMHD3: vBaseEnvHwRegionStartAddress=2940208640, vBaseEnvHwRegionSize=512, vBaseEnvHwRegionType=ROM
      TC397X_StepB (vBaseEnvDerivativeInformation):
        vBaseEnvCpuCoreAmount = 6
        vBaseEnvCpuMaxFrequency = 300000000
        vBaseEnvTestedDerivative = TC39x
        vBaseEnvTestedDerivativeDescription = Infineon Aurix 2G TC39x Family
        vBaseEnvAvailableChannels_Can = 12
        vBaseEnvAvailableChannels_Ethernet = 1
        vBaseEnvAvailableChannels_Flexray = 4
        vBaseEnvAvailableChannels_Lin = 12
        vBaseEnvCpuCore = TC162
        vBaseEnvAdditionalParameters: vBaseEnvWatchdogGroup=B, vBaseEnvPllGroup=B, vBaseEnvPortGroup=B, vBaseEnvResetGroup=B, vBaseEnvDerivativeGroup=TC3xx
        34 x vBaseEnvMemLayoutHwRegion:
          DSPR0: vBaseEnvHwRegionStartAddress=1879048192, vBaseEnvHwRegionSize=245760, vBaseEnvHwRegionType=RAM
          PSPR0: vBaseEnvHwRegionStartAddress=1880096768, vBaseEnvHwRegionSize=65536, vBaseEnvHwRegionType=RAM
          DSPR1: vBaseEnvHwRegionStartAddress=1610612736, vBaseEnvHwRegionSize=245760, vBaseEnvHwRegionType=RAM
          PSPR1: vBaseEnvHwRegionStartAddress=1611661312, vBaseEnvHwRegionSize=65536, vBaseEnvHwRegionType=RAM
          DSPR2: vBaseEnvHwRegionStartAddress=1342177280, vBaseEnvHwRegionSize=98304, vBaseEnvHwRegionType=RAM
          PSPR2: vBaseEnvHwRegionStartAddress=1343225856, vBaseEnvHwRegionSize=65536, vBaseEnvHwRegionType=RAM
          DSPR3: vBaseEnvHwRegionStartAddress=1073741824, vBaseEnvHwRegionSize=98304, vBaseEnvHwRegionType=RAM
          PSPR3: vBaseEnvHwRegionStartAddress=1074790400, vBaseEnvHwRegionSize=98304, vBaseEnvHwRegionType=RAM
          DSPR4: vBaseEnvHwRegionStartAddress=805306368, vBaseEnvHwRegionSize=98304, vBaseEnvHwRegionType=RAM
          PSPR4: vBaseEnvHwRegionStartAddress=806354944, vBaseEnvHwRegionSize=98304, vBaseEnvHwRegionType=RAM
          DSPR5: vBaseEnvHwRegionSize=98304, vBaseEnvHwRegionStartAddress=268435456, vBaseEnvHwRegionType=RAM
          PSPR5: vBaseEnvHwRegionStartAddress=269484032, vBaseEnvHwRegionSize=98304, vBaseEnvHwRegionType=RAM
          PFlash0_Cached: vBaseEnvHwRegionStartAddress=2147483648, vBaseEnvHwRegionSize=3145728, vBaseEnvHwRegionType=ROM
          PFlash0_NonCached: vBaseEnvHwRegionStartAddress=2684354560, vBaseEnvHwRegionSize=3145728, vBaseEnvHwRegionType=ROM
          PFlash1_Cached: vBaseEnvHwRegionStartAddress=2150629376, vBaseEnvHwRegionSize=3145728, vBaseEnvHwRegionType=ROM
          PFlash1_NonCached: vBaseEnvHwRegionStartAddress=2687500288, vBaseEnvHwRegionSize=3145728, vBaseEnvHwRegionType=ROM
          PFlash2_Cached: vBaseEnvHwRegionStartAddress=2153775104, vBaseEnvHwRegionSize=3145728, vBaseEnvHwRegionType=ROM
          PFlash2_NonCached: vBaseEnvHwRegionStartAddress=2690646016, vBaseEnvHwRegionSize=3145728, vBaseEnvHwRegionType=ROM
          PFlash3_Cached: vBaseEnvHwRegionStartAddress=2156920832, vBaseEnvHwRegionSize=3145728, vBaseEnvHwRegionType=ROM
          PFlash3_NonCached: vBaseEnvHwRegionStartAddress=2693791744, vBaseEnvHwRegionSize=3145728, vBaseEnvHwRegionType=ROM
          PFlash4_Cached: vBaseEnvHwRegionStartAddress=2160066560, vBaseEnvHwRegionSize=3145728, vBaseEnvHwRegionType=ROM
          PFlash4_NonCached: vBaseEnvHwRegionStartAddress=2696937472, vBaseEnvHwRegionSize=3145728, vBaseEnvHwRegionType=ROM
          PFlash5_Cached: vBaseEnvHwRegionStartAddress=2163212288, vBaseEnvHwRegionSize=1048576, vBaseEnvHwRegionType=ROM
          PFlash5_NonCached: vBaseEnvHwRegionStartAddress=2700083200, vBaseEnvHwRegionSize=1048576, vBaseEnvHwRegionType=ROM
          LMU0_Cached: vBaseEnvHwRegionStartAddress=2416181248, vBaseEnvHwRegionSize=262144, vBaseEnvHwRegionType=RAM
          LMU0_NonCached: vBaseEnvHwRegionStartAddress=2953052160, vBaseEnvHwRegionSize=262144, vBaseEnvHwRegionType=RAM
          LMU1_Cached: vBaseEnvHwRegionStartAddress=2416443392, vBaseEnvHwRegionSize=262144, vBaseEnvHwRegionType=RAM
          LMU1_NonCached: vBaseEnvHwRegionStartAddress=2953314304, vBaseEnvHwRegionSize=262144, vBaseEnvHwRegionType=RAM
          LMU2_Cached: vBaseEnvHwRegionStartAddress=2416705536, vBaseEnvHwRegionSize=262144, vBaseEnvHwRegionType=RAM
          LMU2_NonCached: vBaseEnvHwRegionStartAddress=2953576448, vBaseEnvHwRegionSize=262144, vBaseEnvHwRegionType=RAM
          BMHD0: vBaseEnvHwRegionStartAddress=2940207104, vBaseEnvHwRegionSize=512, vBaseEnvHwRegionType=ROM
          BMHD1: vBaseEnvHwRegionStartAddress=2940207616, vBaseEnvHwRegionSize=512, vBaseEnvHwRegionType=ROM
          BMHD2: vBaseEnvHwRegionStartAddress=2940208128, vBaseEnvHwRegionSize=512, vBaseEnvHwRegionType=ROM
          BMHD3: vBaseEnvHwRegionStartAddress=2940208640, vBaseEnvHwRegionSize=512, vBaseEnvHwRegionType=ROM
