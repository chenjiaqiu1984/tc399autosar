AUTOSAR XML (schema 00048)
package /ActiveEcuC
  module config Os: implementation-config-variant=VARIANT-PRE-COMPILE, module-description=Os_Impl
    SystemTimer (OsCounter):
      OsCounterMaxAllowedValue = 2147483647
      OsCounterMinCycle = 1
      OsCounterType = HARDWARE
      OsSecondsPerTick = 0.001
      OsCounterTicksPerBase = 100000
      OsCounterAccessingApplication = SystemApplication_OsCore0
      OsDriver: OsDriverHighResolution=false, OsDriverHardwareTimerChannelRef=STM0_Ch0, OsDriverIsrRef=CounterIsr_SystemTimer
    OsOS:
      OsStackMonitoring = true
      OsStatus = EXTENDED
      OsUseGetServiceId = false
      OsUseParameterAccess = false
      OsUseResScheduler = false
      OsForcibleTermination = false
      OsGenerateCalloutStubs = true
      OsGenerateMemMap = COMPLETE
      OsGenerateMemMapForNearAddressing = true
      OsGenerateMemMapForThreads = false
      OsServiceProtection = false
      OsStackUsageMeasurement = false
      OsUseXSignalAsyncApiCalls = false
      OsFpuUsage = NONE
      OsScalabilityClass = SC1
      OsNumberOfCores = 1
      OsMasterCore = OsCore0
      OsSystemTimer = SystemTimer
      OsHooks: OsErrorHook=true, OsPostTaskHook=false, OsPreTaskHook=false, OsShutdownHook=false, OsStartupHook=false
      OsStackSummary
        10 x OsStack, all with OsStackSize=1024, OsStackCore=OsCore0:
          OsCore0_Kernel: OsStackType=CORE_KERNEL_STACK, OsStackUser=OsCore0
          OsCore0_Init: OsStackType=CORE_INIT_STACK, OsStackUser=OsCore0
          OsCore0_Error: OsStackType=CORE_ERROR_STACK, OsStackUser=OsCore0
          OsCore0_Isr_Core: OsStackType=ISR_SHARED_CORE_STACK, OsStackUser=CounterIsr_SystemTimer, OsStackUser=CanIsr_0
          OsCore0_Task_Prio4294967295: OsStackType=TASK_SHARED_PRIORITY_STACK, OsStackUser=IdleTask_OsCore0
          OsCore0_Task_Prio49: OsStackType=TASK_SHARED_PRIORITY_STACK, OsStackUser=Default_Init_Task_Trusted
          OsCore0_Task_Prio50: OsStackType=TASK_SHARED_PRIORITY_STACK, OsStackUser=Default_Init_Task
          OsCore0_Task_Prio48: OsStackType=TASK_SHARED_PRIORITY_STACK, OsStackUser=swc_init
          swc_task: OsStackType=TASK_EXTENDED_STACK, OsStackUser=Os/swc_task
          bsw_task: OsStackType=TASK_EXTENDED_STACK, OsStackUser=Os/bsw_task
    OsPublishedInformation: OsKernelVersion=7, OsPlatformName=TriCoreAurix
      TC39x (OsDerivativeInformation):
        OsMpuPrivilegedRegionsConfigurable = false
        OsMpuAlignment = 8
        OsMpuMemoryGapSize = 16
        OsMpuEndAddressAccessible = false
        OsStackAlignment = 8
        OsExceptionVectorTableAlignment = 256
        OsInterruptVectorTableAlignment = 8192
        OsHardwareManuals = User Manual: TC3XX_ts__TargetSpec_rev1v3v0.pdf V1.3.0, 2016-02 Errata Sheet: TC39x AA_Errata_Sheet_rev1v0_2016-06-08.pdf Rel. 1.0, 2016-06-08
        6 x OsPhysicalCore, all with OsPhysicalCoreType=TC1.6.2P, OsPhysicalCoreExceptionSources=8, OsPhysicalCorePrivelegedHwAccess=true:
          Core0: OsPhysicalCoreId=0, OsPhysicalCoreDefaultEntrySymbol=_start_tc0, OsPhysicalCoreMasterStartAllowed=true, OsPhysicalCoreIsAutostart=true, OsPhysicalCoreStackProtectionUnit=OsPhysicalCore0DataMpu
            OsPhysicalCore0DataMpu (OsPhysicalCoreMpu): OsPhysicalCoreMpuId=0, OsPhysicalCoreMpuMaxRegions=18, OsPhysicalCoreMpuType=DATA
            OsPhysicalCore0CodeMpu (OsPhysicalCoreMpu): OsPhysicalCoreMpuId=1, OsPhysicalCoreMpuMaxRegions=10, OsPhysicalCoreMpuType=CODE
          Core1: OsPhysicalCoreId=1, OsPhysicalCoreDefaultEntrySymbol=_start_tc1, OsPhysicalCoreMasterStartAllowed=false, OsPhysicalCoreIsAutostart=false, OsPhysicalCoreStackProtectionUnit=OsPhysicalCore1DataMpu
            OsPhysicalCore1DataMpu (OsPhysicalCoreMpu): OsPhysicalCoreMpuId=0, OsPhysicalCoreMpuMaxRegions=18, OsPhysicalCoreMpuType=DATA
            OsPhysicalCore1CodeMpu (OsPhysicalCoreMpu): OsPhysicalCoreMpuId=1, OsPhysicalCoreMpuMaxRegions=10, OsPhysicalCoreMpuType=CODE
          Core2: OsPhysicalCoreId=2, OsPhysicalCoreDefaultEntrySymbol=_start_tc2, OsPhysicalCoreMasterStartAllowed=false, OsPhysicalCoreIsAutostart=false, OsPhysicalCoreStackProtectionUnit=OsPhysicalCore2DataMpu
            OsPhysicalCore2DataMpu (OsPhysicalCoreMpu): OsPhysicalCoreMpuId=0, OsPhysicalCoreMpuMaxRegions=18, OsPhysicalCoreMpuType=DATA
            OsPhysicalCore2CodeMpu (OsPhysicalCoreMpu): OsPhysicalCoreMpuId=1, OsPhysicalCoreMpuMaxRegions=10, OsPhysicalCoreMpuType=CODE
          Core3: OsPhysicalCoreId=3, OsPhysicalCoreDefaultEntrySymbol=_start_tc3, OsPhysicalCoreMasterStartAllowed=false, OsPhysicalCoreIsAutostart=false, OsPhysicalCoreStackProtectionUnit=OsPhysicalCore3DataMpu
            OsPhysicalCore3DataMpu (OsPhysicalCoreMpu): OsPhysicalCoreMpuId=0, OsPhysicalCoreMpuMaxRegions=18, OsPhysicalCoreMpuType=DATA
            OsPhysicalCore3CodeMpu (OsPhysicalCoreMpu): OsPhysicalCoreMpuId=1, OsPhysicalCoreMpuMaxRegions=10, OsPhysicalCoreMpuType=CODE
          Core4: OsPhysicalCoreId=4, OsPhysicalCoreDefaultEntrySymbol=_start_tc4, OsPhysicalCoreMasterStartAllowed=false, OsPhysicalCoreIsAutostart=false, OsPhysicalCoreStackProtectionUnit=OsPhysicalCore4DataMpu
            OsPhysicalCore4DataMpu (OsPhysicalCoreMpu): OsPhysicalCoreMpuId=0, OsPhysicalCoreMpuMaxRegions=18, OsPhysicalCoreMpuType=DATA
            OsPhysicalCore4CodeMpu (OsPhysicalCoreMpu): OsPhysicalCoreMpuId=1, OsPhysicalCoreMpuMaxRegions=10, OsPhysicalCoreMpuType=CODE
          Core5: OsPhysicalCoreId=6, OsPhysicalCoreDefaultEntrySymbol=_start_tc5, OsPhysicalCoreMasterStartAllowed=false, OsPhysicalCoreIsAutostart=false, OsPhysicalCoreStackProtectionUnit=OsPhysicalCore5DataMpu
            OsPhysicalCore5DataMpu (OsPhysicalCoreMpu): OsPhysicalCoreMpuId=0, OsPhysicalCoreMpuMaxRegions=18, OsPhysicalCoreMpuType=DATA
            OsPhysicalCore5CodeMpu (OsPhysicalCoreMpu): OsPhysicalCoreMpuId=1, OsPhysicalCoreMpuMaxRegions=10, OsPhysicalCoreMpuType=CODE
        6 x OsHardwareTimer, all with OsHardwareTimerSize=32, OsHardwareTimerUnit=FRT, OsHardwareTimerType=STM:
          STM0: OsHardwareTimerBaseAddress=4026535936, OsHardwareTimerId=0
            STM0_Ch0 (OsHardwareTimerChannel): OsHardwareTimerChannelIntSource=768, OsHardwareTimerChannelOffset=0, OsHardwareTimerChannelId=0
            STM0_Ch1 (OsHardwareTimerChannel): OsHardwareTimerChannelIntSource=772, OsHardwareTimerChannelOffset=1, OsHardwareTimerChannelId=1
          STM1: OsHardwareTimerBaseAddress=4026536192, OsHardwareTimerId=1
            STM1_Ch0 (OsHardwareTimerChannel): OsHardwareTimerChannelIntSource=776, OsHardwareTimerChannelOffset=0, OsHardwareTimerChannelId=0
            STM1_Ch1 (OsHardwareTimerChannel): OsHardwareTimerChannelIntSource=780, OsHardwareTimerChannelOffset=1, OsHardwareTimerChannelId=1
          STM2: OsHardwareTimerBaseAddress=4026536448, OsHardwareTimerId=2
            STM2_Ch0 (OsHardwareTimerChannel): OsHardwareTimerChannelIntSource=784, OsHardwareTimerChannelOffset=0, OsHardwareTimerChannelId=0
            STM2_Ch1 (OsHardwareTimerChannel): OsHardwareTimerChannelIntSource=788, OsHardwareTimerChannelOffset=1, OsHardwareTimerChannelId=1
          STM3: OsHardwareTimerBaseAddress=4026536704, OsHardwareTimerId=3
            STM3_Ch0 (OsHardwareTimerChannel): OsHardwareTimerChannelIntSource=792, OsHardwareTimerChannelOffset=0, OsHardwareTimerChannelId=0
            STM3_Ch1 (OsHardwareTimerChannel): OsHardwareTimerChannelIntSource=796, OsHardwareTimerChannelOffset=1, OsHardwareTimerChannelId=1
          STM4: OsHardwareTimerBaseAddress=4026536960, OsHardwareTimerId=4
            STM4_Ch0 (OsHardwareTimerChannel): OsHardwareTimerChannelIntSource=800, OsHardwareTimerChannelOffset=0, OsHardwareTimerChannelId=0
            STM4_Ch1 (OsHardwareTimerChannel): OsHardwareTimerChannelIntSource=804, OsHardwareTimerChannelOffset=1, OsHardwareTimerChannelId=1
          STM5: OsHardwareTimerBaseAddress=4026537216, OsHardwareTimerId=5
            STM5_Ch0 (OsHardwareTimerChannel): OsHardwareTimerChannelIntSource=808, OsHardwareTimerChannelOffset=0, OsHardwareTimerChannelId=0
            STM5_Ch1 (OsHardwareTimerChannel): OsHardwareTimerChannelIntSource=812, OsHardwareTimerChannelOffset=1, OsHardwareTimerChannelId=1
        AURIXTC3XX_IR (OsSystemIntCtrl): OsSystemIntCtrlMaxPrios=255, OsSystemIntCtrlPrioOrder=ASC, OsSystemIntCtrlMaxSources=8192, OsSystemIntCtrlBaseAddress=4026757120
        GPT (OsHardwareTimer): OsHardwareTimerSize=16, OsHardwareTimerUnit=PIT, OsHardwareTimerBaseAddress=4026537984, OsHardwareTimerId=0, OsHardwareTimerType=PIT
          GPT_Ch0 (OsHardwareTimerChannel): OsHardwareTimerChannelIntSource=744, OsHardwareTimerChannelOffset=0, OsHardwareTimerChannelId=0
          GPT_Ch1 (OsHardwareTimerChannel): OsHardwareTimerChannelIntSource=756, OsHardwareTimerChannelOffset=1, OsHardwareTimerChannelId=1
        OsMemoryRegionSpecifics
          18 x OsMemoryRegionAccess:
            PS0_R: OsMemoryRegionAccessRights=R, OsMemoryRegionAccessType=PROTECTION_SET0
            PS0_W: OsMemoryRegionAccessRights=W, OsMemoryRegionAccessType=PROTECTION_SET0
            PS0_X: OsMemoryRegionAccessRights=X, OsMemoryRegionAccessType=PROTECTION_SET0
            PS1_R: OsMemoryRegionAccessRights=R, OsMemoryRegionAccessType=PROTECTION_SET1
            PS1_W: OsMemoryRegionAccessRights=W, OsMemoryRegionAccessType=PROTECTION_SET1
            PS1_X: OsMemoryRegionAccessRights=X, OsMemoryRegionAccessType=PROTECTION_SET1
            PS2_R: OsMemoryRegionAccessRights=R, OsMemoryRegionAccessType=PROTECTION_SET2
            PS2_W: OsMemoryRegionAccessRights=W, OsMemoryRegionAccessType=PROTECTION_SET2
            PS2_X: OsMemoryRegionAccessRights=X, OsMemoryRegionAccessType=PROTECTION_SET2
            PS3_R: OsMemoryRegionAccessRights=R, OsMemoryRegionAccessType=PROTECTION_SET3
            PS3_W: OsMemoryRegionAccessRights=W, OsMemoryRegionAccessType=PROTECTION_SET3
            PS3_X: OsMemoryRegionAccessRights=X, OsMemoryRegionAccessType=PROTECTION_SET3
            PS4_R: OsMemoryRegionAccessRights=R, OsMemoryRegionAccessType=PROTECTION_SET4
            PS4_W: OsMemoryRegionAccessRights=W, OsMemoryRegionAccessType=PROTECTION_SET4
            PS4_X: OsMemoryRegionAccessRights=X, OsMemoryRegionAccessType=PROTECTION_SET4
            PS5_R: OsMemoryRegionAccessRights=R, OsMemoryRegionAccessType=PROTECTION_SET5
            PS5_W: OsMemoryRegionAccessRights=W, OsMemoryRegionAccessType=PROTECTION_SET5
            PS5_X: OsMemoryRegionAccessRights=X, OsMemoryRegionAccessType=PROTECTION_SET5
        DMA (OsInterruptSupportedType):
          OsInterruptSupportedTypeSeparateSources = false
          OsInterruptSupportedTypeSeparatePriority = true
          OsInterruptSupportedTypeIsMapped = false
          OsInterruptSupportedTypePostActionRequired = false
    OSDEFAULTAPPMODE (OsAppMode)
    OS_APPMODE_ANY (OsAppMode)
    OsCore0 (OsCore):
      OsCoreIsAutostart = true
      OsCoreIsAutosar = true
      OsCoreEntrySymbol = _start_tc0
      OsCorePhysicalCoreRef = Core0
      OsCoreEcucCoreRef = EcucCoreDefinition
      OsCoreIdleTask = IdleTask_OsCore0
      OsCoreSystemApplication = SystemApplication_OsCore0
      OsCoreStacks:
        OsCoreKernelStackSize = 1024
        OsCoreStartupStackSize = 1024
        OsCoreShutdownStackSize = 1024
        OsCoreErrorStackSize = 1024
        OsCoreProtectionStackSize = 1024
        OsCoreInitStackSize = 1024
    IdleTask_OsCore0 (OsTask):
      OsTaskActivation = 1
      OsTaskPriority = 4294967295
      OsTaskSchedule = FULL
      OsTaskStackSharing = false
      OsTaskStackSize = 1024
      OsTaskType = AUTO
      OsTaskUsesFpu = false
      OsTaskAccessingApplication = SystemApplication_OsCore0
      OsTaskAutostart: OsTaskAppModeRef=OS_APPMODE_ANY
    SystemApplication_OsCore0 (OsApplication):
      OsTrusted = true
      OsTrustedApplicationDelayTimingViolationCall = false
      OsTrustedApplicationWithProtection = false
      OsApplicationIsPrivileged = true
      OsAppUseTrustedFunctionStubs = false
      OsApplicationCoreRef = EcucCoreDefinition
      OsAppTaskRef = IdleTask_OsCore0
      OsAppCounterRef = SystemTimer
      OsAppIsrRef = CounterIsr_SystemTimer
      OsAppTaskRef = Default_Init_Task
      OsAppTaskRef = Default_Init_Task_Trusted
      OsApplicationHooks: OsAppErrorHook=false, OsAppShutdownHook=false, OsAppStartupHook=false
    CounterIsr_SystemTimer (OsIsr):
      OsIsrInterruptPriority = 20
      OsIsrCategory = CATEGORY_2
      OsIsrInterruptType = EXTERNAL
      OsIsrInterruptSource = 768
      OsIsrStackSize = 1024
      OsIsrEnableNesting = false
      OsIsrUsesFpu = false
      OsIsrInitialEnableInterruptSource = false
      OsIsrSpecialFunctionName = Os_TimerPfrtIsr
    Default_Init_Task (OsTask):
      OsTaskActivation = 1
      OsTaskPriority = 50
      OsTaskSchedule = FULL
      OsTaskStackSharing = false
      OsTaskStackSize = 1024
      OsTaskType = BASIC
      OsTaskUsesFpu = false
      OsTaskAccessingApplication = SystemApplication_OsCore0
      OsTaskAutostart: OsTaskAppModeRef=OSDEFAULTAPPMODE
    Default_Init_Task_Trusted (OsTask):
      OsTaskActivation = 1
      OsTaskPriority = 49
      OsTaskSchedule = FULL
      OsTaskStackSharing = false
      OsTaskStackSize = 1024
      OsTaskType = BASIC
      OsTaskUsesFpu = false
      OsTaskAccessingApplication = SystemApplication_OsCore0
      OsTaskAutostart: OsTaskAppModeRef=OSDEFAULTAPPMODE
    OsResource: OsResourceProperty=STANDARD, OsResourceAccessingApplication=SystemApplication_OsCore0, OsResourceAccessingApplication=OsApplication_OsCore0
    OsApplication_OsCore0 (OsApplication):
      OsTrusted = true
      OsTrustedApplicationDelayTimingViolationCall = false
      OsTrustedApplicationWithProtection = false
      OsApplicationIsPrivileged = true
      OsAppUseTrustedFunctionStubs = false
      OsApplicationCoreRef = EcucCoreDefinition
      OsAppTaskRef = swc_init
      OsAppTaskRef = Os/swc_task
      OsAppTaskRef = Os/bsw_task
      OsAppAlarmRef = Rte_Al_TE2_bsw_task_0_10ms
      OsAppAlarmRef = Rte_Al_TE_swc_test_swc_test_10ms
      OsAppAlarmRef = Rte_Al_TE_swc_test_swc_test_500ms
      OsAppCounterRef = OsCounterCAN0
      OsAppAlarmRef = Rte_Al_TE2_bsw_task_0_20ms
      OsAppIsrRef = CanIsr_0
      OsApplicationHooks: OsAppErrorHook=false, OsAppShutdownHook=false, OsAppStartupHook=false
    3 x OsTask, all with OsTaskActivation=1, OsTaskSchedule=FULL, OsTaskStackSharing=false, OsTaskStackSize=1024, OsTaskType=AUTO, OsTaskUsesFpu=false, OsTaskAccessingApplication=SystemApplication_OsCore0:
      swc_init: OsTaskPriority=48
      swc_task: OsTaskPriority=30, OsTaskEventRef=Rte_Ev_Run_swc_test_swc_test_10ms, OsTaskEventRef=Rte_Ev_Run_swc_test_swc_test_500ms
      bsw_task: OsTaskPriority=29, OsTaskResourceRef=OsResource, OsTaskEventRef=Rte_Ev_Cyclic2_bsw_task_0_10ms, OsTaskEventRef=Rte_Ev_Cyclic2_bsw_task_0_20ms
    3 x OsAlarm, all with OsAlarmCounterRef=SystemTimer, OsAlarmAccessingApplication=SystemApplication_OsCore0:
      Rte_Al_TE2_bsw_task_0_10ms
        OsAlarmAction
          OsAlarmSetEvent: OsAlarmSetEventRef=Rte_Ev_Cyclic2_bsw_task_0_10ms, OsAlarmSetEventTaskRef=Os/bsw_task
      Rte_Al_TE_swc_test_swc_test_10ms
        OsAlarmAction
          OsAlarmSetEvent: OsAlarmSetEventRef=Rte_Ev_Run_swc_test_swc_test_10ms, OsAlarmSetEventTaskRef=Os/swc_task
      Rte_Al_TE_swc_test_swc_test_500ms
        OsAlarmAction
          OsAlarmSetEvent: OsAlarmSetEventRef=Rte_Ev_Run_swc_test_swc_test_500ms, OsAlarmSetEventTaskRef=Os/swc_task
    Rte_Ev_Run_swc_test_swc_test_10ms (OsEvent)
    Rte_Ev_Run_swc_test_swc_test_500ms (OsEvent)
    OsCounterCAN0 (OsCounter):
      OsCounterMaxAllowedValue = 1073741823
      OsCounterMinCycle = 1
      OsCounterTicksPerBase = 1
      OsCounterType = SOFTWARE
      OsSecondsPerTick = 0.001
      OsCounterAccessingApplication = SystemApplication_OsCore0
    Rte_Al_TE2_bsw_task_0_20ms (OsAlarm): OsAlarmCounterRef=SystemTimer, OsAlarmAccessingApplication=SystemApplication_OsCore0
      OsAlarmAction
        OsAlarmSetEvent: OsAlarmSetEventRef=Rte_Ev_Cyclic2_bsw_task_0_20ms, OsAlarmSetEventTaskRef=Os/bsw_task
    Rte_Ev_Cyclic2_bsw_task_0_10ms (OsEvent)
    Rte_Ev_Cyclic2_bsw_task_0_20ms (OsEvent)
    CanIsr_0 (OsIsr):  # /ActiveEcuC/Can PLAIN_TEXT Can messages event (for a specific controllers)
      OsIsrInterruptPriority = 50
      OsIsrCategory = CATEGORY_2
      OsIsrInterruptType = EXTERNAL
      OsIsrInterruptSource = 1456
      OsIsrStackSize = 1024
      OsIsrEnableNesting = false
      OsIsrUsesFpu = false
      OsIsrInitialEnableInterruptSource = true
