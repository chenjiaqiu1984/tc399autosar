AUTOSAR XML (schema 00048)
package /ResourceM
  module config ResourceM: implementation-config-variant=VARIANT-PRE-COMPILE
    ResourceMMcalConfig_0 (ResourceMMcalConfig): ResourceMMasterCore=CORE0, ResourceMNumberOfActiveCores=6
      ResourceMMcalCore_0 (ResourceMMcalCore): ResourceMCoreID=CORE0
