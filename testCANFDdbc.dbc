VERSION ""

NS_ :

BS_:

BU_: testNode testEcu

BO_ 102 RxMessage1: 64 testNode
 SG_ Txsignal6 : 8|8@1- (1,0) [0|0] ""  testEcu
 SG_ Txsignal5 : 0|8@1- (1,0) [0|0] ""  testEcu

BO_ 51 TxMessage3: 32 testEcu
 SG_ Txsignal1 : 0|8@1- (1,0) [0|0] ""  testNode

BO_ 34 TxMessage22: 8 testEcu
 SG_ Txsignal2 : 0|8@1- (1,0) [0|0] ""  testNode

BO_ 17 TxMessage1: 64 testEcu
 SG_ Txsignal4 : 8|8@1- (1,0) [0|0] ""  testNode
 SG_ Txsignal3 : 0|8@1- (1,0) [0|0] ""  testNode

BA_DEF_ BO_  "CANFD_BRS" ENUM  "0","1";
BA_DEF_  "DBName" STRING ;
BA_DEF_  "BusType" STRING ;
BA_DEF_ BO_  "VFrameFormat" ENUM  "StandardCAN","ExtendedCAN","reserved","reserved","reserved","reserved","reserved","reserved","reserved","reserved","reserved","reserved","reserved","reserved","StandardCAN_FD","ExtendedCAN_FD";
BA_DEF_DEF_  "CANFD_BRS" "1";
BA_DEF_DEF_  "DBName" "";
BA_DEF_DEF_  "BusType" "";
BA_DEF_DEF_  "VFrameFormat" "StandardCAN";
BA_ "BusType" "CAN FD";
BA_ "DBName" "testCANFDdbc";
BA_ "VFrameFormat" BO_ 102 14;
BA_ "VFrameFormat" BO_ 51 14;
BA_ "VFrameFormat" BO_ 34 14;
BA_ "VFrameFormat" BO_ 17 14;
