AUTOSAR XML (schema 00046)
package /AURIX2G/EcucDefs
  module config Smu_Rec: definition=Smu
  bsw implementation Smu_Impl: programming-language=C, behavior=SmuBehavior, recommended-configuration=Smu_Rec, vendor-specific-module-def=Smu
