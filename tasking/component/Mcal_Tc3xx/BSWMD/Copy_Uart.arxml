AUTOSAR XML (schema 00046)
package /AURIX2G/EcucDefs
  module definition Uart [0..1]: post-build-variant-support=true, variants post-build  # Configuration of the UART Module.
    container UartGeneral  # General configuration (parameters) of the UART driver software module.
      boolean UartDevErrorDetect: origin=INFINEON_AURIX2G, set at pre-compile, default-value=false  # Switches the Development Error Detection and Notification ON or OFF.
      boolean UartRunTimeErrorDetect: origin=INFINEON_AURIX2G, set at pre-compile, default-value=true  # Switches the Runtime Error Detection and Notification ON or OFF.
      boolean UartSafetyEnable: origin=INFINEON_AURIX2G, set at pre-compile, default-value=true  # Enable/Disable safety feature in Uart driver
      boolean UartVersionInfoApi: origin=INFINEON_AURIX2G, set at pre-compile, default-value=false  # Switches the Uart_GetVersionInfo function ON or OFF.
      boolean UartInitCheckApi: origin=INFINEON_AURIX2G, set at pre-compile, default-value=false  # Switches the Uart_InitCheck function ON or OFF.
      boolean UartDeInitApi: origin=INFINEON_AURIX2G, set at pre-compile, default-value=false  # Switches the Uart_Deinit function ON or OFF.
      boolean UartStreamingRecvModeApi: origin=INFINEON_AURIX2G, set at pre-compile, default-value=false  # Switches the Uart_StartStreaming and Uart_StopStreaming functions ON or OFF.
      boolean UartAbortReadApi: origin=INFINEON_AURIX2G, set at pre-compile, default-value=false  # Switches the Uart_AbortRead function ON or OFF.
      boolean UartAbortWriteApi: origin=INFINEON_AURIX2G, set at pre-compile, default-value=false  # Switches the Uart_AbortWrite function ON or OFF.
      enumeration UartCsrClksel: {ASCLINF, ASCLINS}, origin=INFINEON_AURIX2G, set at pre-compile, default-value=ASCLINF  # This parameter selects the Baud Rate Logic Clock for the Uart Driver.
      boolean UartSleepEnable: origin=INFINEON_AURIX2G, set at pre-compile, default-value=false  # Enable/Disable parameter for the ASCLIN Hw module Sleep triggered by SCU
      integer UartIndex: 0..255, origin=INFINEON_AURIX2G, set at pre-compile, default-value=0  # Specifies the InstanceId of this module instance.
      enumeration UartInitDeInitApiMode: {MCAL_SUPERVISOR, MCAL_USER1}, origin=INFINEON_AURIX2G, set at pre-compile, default-value=MCAL_SUPERVISOR  # Defines the privilege mode in which the Initialization and De-initialization APIs would operate.
      integer UartTimeoutCount: 100..4294967295, origin=INFINEON_AURIX2G, set at pre-compile, default-value=4294967295  # Specifies the maximum time in nanoseconds to wait for hardware timeout errors(Reported as hardware access error).
      float UartMainFunctionReadPeriod: 0.0..10.0, origin=INFINEON_AURIX2G, set at pre-compile, default-value=0.005  # Specifies the period of main function Uart_MainFunction_Read in seconds. Uart driver does not require this information but the BSW scheduler.
      float UartMainFunctionWritePeriod: 0.0..10.0, origin=INFINEON_AURIX2G, set at pre-compile, default-value=0.005  # Specifies the period of main function Uart_MainFunction_Write in seconds. Uart driver does not require this information but the BSW scheduler.
      reference UartClockRef: origin=INFINEON_AURIX2G, set at pre-compile, destination=McuClockReferencePointConfig  # This parameter refers to the system clock configured by MCU driver.This reference is used for BaudRate computation.
    container UartConfigSet  # This container contains the Channel configuration of the Uart driver. This container is a MultipleConfigurationContainer, i.e. this container and its sub-containers exit once per configuration set.
      container UartChannel [1..12]: multiplicity set at pre-compile  # This container contains the configuration (parameters) of the UART Controller(s).
        integer UartBaudRate: 1000..6250000, origin=INFINEON_AURIX2G, post-build-variant-value=true, set at post-build, default-value=9600  # Specifies the baud rate in bits per second of the UART channel. This parameter shall be disabled when 'UartAutoCalcBaudParams' is false
        enumeration UartHwUnit: {ASCLIN0, ASCLIN1, ASCLIN2, ASCLIN3, ASCLIN4, ASCLIN5, ASCLIN6, ASCLIN7, ASCLIN8, ASCLIN9, ASCLIN10, ASCLIN11}, origin=INFINEON_AURIX2G, post-build-variant-value=true, set at post-build, default-value=ASCLIN0  # This parameter selects the hardware unit used by Uart channel.
        integer UartChannelId: 0..11, origin=INFINEON_AURIX2G, post-build-variant-value=true, set at post-build, symbolic-name-value=true, default-value=0  # Identifies the UART channel.
        boolean UartAutoCalcBaudParams: origin=INFINEON_AURIX2G, post-build-variant-value=true, set at post-build, default-value=true  # Enable/Disable Automatic calculation of Asclin Baudrate params UartChanBaudNumerator, UartChanBaudDenominator, UartChanBaudPrescalar,UartChanBaudOVERSAMPLING
        integer UartChanBaudNumerator: 1..4095, origin=INFINEON_AURIX2G, post-build-variant-value=true, set at post-build, default-value=24  # Specifies the BRG register numerator value used for Baudrate calculation. The value configured in this parameter will be written to the BRG.NUMERATOR register field. This parameter will be disabled when 'UartAutoCalcBaudParams' is true
        integer UartChanBaudDenominator: 1..4095, origin=INFINEON_AURIX2G, post-build-variant-value=true, set at post-build, default-value=1000  # Specifies the BRG register Denominator value used for Baudrate calculation. The value configured in this parameter will be written to the BRG.DENOMINATOR register field.This parameter will be disabled when 'UartAutoCalcBaudParams' is true
        integer UartChanBaudPrescalar: 0..4095, origin=INFINEON_AURIX2G, post-build-variant-value=true, set at post-build, default-value=4  # Specifies the BITCON register Prescalar value used for Baudrate calculation. The value configured in this parameter will be written to the BITCON.PRESCALAR register field.This parameter will be disabled when 'UartAutoCalcBaudParams' is true
        integer UartChanBaudOverSampling: 3..15, origin=INFINEON_AURIX2G, post-build-variant-value=true, set at post-build, default-value=9  # Specifies the BITCON register Oversampling value used for Baudrate calculation.The value configured in this parameter will be written to the BITCON.OVERSAMPLING register field. This parameter will be disabled when 'UartAutoCalcBaudParams' is true
        enumeration UartRxPinSelection: {SELECT_A_PORT14_PIN1, SELECT_B_PORT15_PIN3, SELECT_C_PORT01_PIN8, SELECT_D_PORT33_PIN10, SELECT_E_PORT13_PIN11, SELECT_A_PORT15_PIN1, SELECT_B_PORT15_PIN5, SELECT_C_PORT20_PIN9, SELECT_D_PORT14_PIN8, SELECT_E_PORT11_PIN10, SELECT_F_PORT33_PIN13, SELECT_G_PORT02_PIN3, SELECT_A_PORT14_PIN3, SELECT_B_PORT02_PIN1, SELECT_C_PORT02_PIN10, SELECT_D_PORT10_PIN6, SELECT_E_PORT33_PIN8, SELECT_F_PORT32_PIN6, SELECT_G_PORT02_PIN0, SELECT_A_PORT15_PIN7, SELECT_B_PORT11_PIN0, SELECT_C_PORT20_PIN3, SELECT_D_PORT32_PIN2, SELECT_E_PORT00_PIN1, SELECT_F_PORT21_PIN6, SELECT_H_PORT13_PIN12, SELECT_A_PORT00_PIN12, SELECT_B_PORT34_PIN2, SELECT_C_PORT22_PIN6, SELECT_D_PORT22_PIN9, SELECT_A_PORT00_PIN6, SELECT_B_PORT33_PIN4, SELECT_C_PORT22_PIN3, SELECT_D_PORT14_PIN15, SELECT_A_PORT23_PIN3, SELECT_B_PORT01_PIN0, SELECT_C_PORT32_PIN6, SELECT_D_PORT10_PIN9, SELECT_E_PORT22_PIN0, SELECT_F_PORT23_PIN1, SELECT_A_PORT14_PIN15, SELECT_B_PORT01_PIN8, SELECT_C_PORT23_PIN2, SELECT_D_PORT13_PIN11, SELECT_E_PORT22_PIN1, SELECT_F_PORT22_PIN4, SELECT_A_PORT02_PIN9, SELECT_B_PORT02_PIN10, SELECT_C_PORT33_PIN1, SELECT_D_PORT33_PIN6, SELECT_E_PORT34_PIN5, SELECT_A_PORT01_PIN5, SELECT_B_PORT01_PIN7, SELECT_C_PORT14_PIN7, SELECT_D_PORT14_PIN9, SELECT_E_PORT20_PIN6, SELECT_F_PORT20_PIN7, SELECT_A_PORT00_PIN4, SELECT_B_PORT00_PIN8, SELECT_C_PORT13_PIN0, SELECT_D_PORT13_PIN1, SELECT_A_PORT10_PIN0, SELECT_B_PORT10_PIN4, SELECT_C_PORT21_PIN0, SELECT_D_PORT21_PIN1, SELECT_E_PORT21_PIN2, SELECT_F_PORT21_PIN5}, origin=INFINEON_AURIX2G, post-build-variant-value=true, set at post-build, default-value=SELECT_A_PORT14_PIN1  # Selects the alternate input for the RX signal for the given Uart channel
        boolean UartCTSEnable: origin=INFINEON_AURIX2G, post-build-variant-value=true, set at post-build, default-value=false  # Switch to enable the CTS signal .
        enumeration UartCTSPinSelection: {SELECT_CTS_A_PORT14_PIN9, SELECT_CTS_A_PORT20_PIN7, SELECT_CTS_B_PORT32_PIN4, SELECT_CTS_A_PORT10_PIN7, SELECT_CTS_B_PORT33_PIN5, SELECT_CTS_A_PORT00_PIN12, NONE}, origin=INFINEON_AURIX2G, post-build-variant-value=true, set at post-build, default-value=SELECT_CTS_A_PORT14_PIN9  # Selects the alternate input for the CTS signal for the given Uart channel
        enumeration UartCTSPolarity: {LOW, HIGH}, origin=INFINEON_AURIX2G, post-build-variant-value=true, set at post-build, default-value=HIGH  # This parameter defines the active level or the RTS and CTS signals. Active means ready/clear to send.
        integer UartDataLength: 2..16, origin=INFINEON_AURIX2G, post-build-variant-value=true, set at post-build, default-value=8  # Specifies the number of bits to be transmitted or recieved.
        integer UartStopBits: 1..2, origin=INFINEON_AURIX2G, post-build-variant-value=true, set at post-build, default-value=1  # Specifies the number of stop bits Range is one or two.
        enumeration UartParityBit: {NOPARITY, ODDPARITY, EVENPARITY}, origin=INFINEON_AURIX2G, post-build-variant-value=true, set at post-build, default-value=NOPARITY  # This parameter selects the parity even or odd or no parity.
        enumeration UartTxChannelMode: {POLLING, INTERRUPT}, origin=INFINEON_AURIX2G, set at pre-compile, default-value=INTERRUPT  # This parameter selects the Tx channel mode polling or interrupt.
        enumeration UartRxChannelMode: {POLLING, INTERRUPT}, origin=INFINEON_AURIX2G, set at pre-compile, default-value=INTERRUPT  # This parameter selects the Rx channel mode polling or interrupt.
        container UartNotification  # This container contains the Notification function pointers .
          function name UartTransmitNotifPtr: origin=INFINEON_AURIX2G, post-build-variant-value=true, set at post-build, default-value=NULL_PTR  # This parameter is a reference to a notification function.
          function name UartReceiveNotifPtr: origin=INFINEON_AURIX2G, post-build-variant-value=true, set at post-build, default-value=NULL_PTR  # This parameter is a reference to a notification function.
          function name UartAbortTransmitNotifPtr: origin=INFINEON_AURIX2G, post-build-variant-value=true, set at post-build, default-value=NULL_PTR  # This parameter is a reference to a notification function.
          function name UartAbortReceiveNotifPtr: origin=INFINEON_AURIX2G, post-build-variant-value=true, set at post-build, default-value=NULL_PTR  # This parameter is a reference to a notification function.
          function name UartStreamingRecvNotifPtr: origin=INFINEON_AURIX2G, post-build-variant-value=true, set at post-build, default-value=NULL_PTR  # This parameter is a reference to a notification function.
    container CommonPublishedInformation  # Common container, aggregated by all modules. It contains published information about vendor and versions.
      integer ArMajorVersion: 0..255, origin=INFINEON_AURIX2G, set at published-information, default-value=4  # Major version number of AUTOSAR specification on which the appropriate implementation is based on.
      integer ArMinorVersion: 0..255, origin=INFINEON_AURIX2G, set at published-information, default-value=4  # Minor version number of AUTOSAR specification on which the appropriate implementation is based on.
      integer ArPatchVersion: 0..255, origin=INFINEON_AURIX2G, set at published-information, default-value=0  # Patch level version number of AUTOSAR specification on which the appropriate implementation is based on.
      integer SwMajorVersion: 0..255, origin=INFINEON_AURIX2G, set at published-information, default-value=20  # Major version number of the vendor specific implementation of the module. The numbering is vendor specific.
      integer SwMinorVersion: 0..255, origin=INFINEON_AURIX2G, set at published-information, default-value=25  # Minor version number of the vendor specific implementation of the module. The numbering is vendor specific.
      integer SwPatchVersion: 0..255, origin=INFINEON_AURIX2G, set at published-information, default-value=0  # Patch level version number of the vendor specific implementation of the module. The numbering is vendor specific.
      integer ModuleId: 0..65535, origin=INFINEON_AURIX2G, set at published-information, default-value=255  # Module ID of this module from Module List
      integer VendorId: 0..65535, origin=INFINEON_AURIX2G, set at published-information, default-value=17  # Vendor ID of the dedicated implementation of this module according to the AUTOSAR vendor list
      string Release: origin=INFINEON_AURIX2G, set at published-information, default-value=_TRICORE_TC399  # Aurix2G derivative used for the implementation
