AUTOSAR XML (schema 00046)
package /AURIX2G/EcucDefs
  module config Irq_Rec: definition=Irq
  bsw implementation Irq_Impl: programming-language=C, behavior=IrqBehavior, recommended-configuration=Irq_Rec, vendor-specific-module-def=Irq
