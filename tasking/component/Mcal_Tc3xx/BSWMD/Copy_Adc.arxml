AUTOSAR XML (schema 00046)
package /AURIX2G/EcucDefs
  module definition Adc [0..1]: post-build-variant-support=true, refined-module-def=Adc, variants post-build  # Configuration of the Adc (Analog Digital Conversion) module.
    container AdcConfigSet  # This container contains the configuration parameters and sub containers of the AUTOSAR Adc module.
      boolean AdcSyncClockDisable: origin=INFINEON_AURIX2G, post-build-variant-value=true, set at post-build, default-value=false  # This parameter determines whether the analog clock is generated in synchronized/unsynchronized mode. The configuration of the Converter Control (CONVCTRL) clock is done by the MCU driver
      reference AdcSystemClock: origin=INFINEON_AURIX2G, post-build-variant-value=true, set at post-build, destination=McuClockReferencePointConfig  # This parameter refers to the system clock configured by the MCU driver. With this system clock, the reload value corresponding to the configured timer is calculated for the timer triggered ADC groups.
      container AdcGlobalInputClass [2..2]  # This container defines the Global Input Class for A-D conversion
        integer AdcChSampleTime: 0..31, origin=INFINEON_AURIX2G, post-build-variant-value=true, set at post-build, default-value=0  # This parameter defines the number of additional clock cycles to be added to the minimum sample phase of 2 sample clock cycles.
        enumeration AdcChPreChargeClkCycles: {ADC_INPUT_PRECHARGE_CYCLES_0, ADC_INPUT_PRECHARGE_CYCLES_8, ADC_INPUT_PRECHARGE_CYCLES_16, ADC_INPUT_PRECHARGE_CYCLES_32}, origin=INFINEON_AURIX2G, post-build-variant-value=true, set at post-build, default-value=ADC_INPUT_PRECHARGE_CYCLES_0  # This parameter defines the number of analog input precharge clock cycles for standard conversions.
        enumeration AdcChConvMode: {ADC_NOISE_REDUCTION_STEPS_0, ADC_NOISE_REDUCTION_STEPS_1, ADC_NOISE_REDUCTION_STEPS_3, ADC_NOISE_REDUCTION_STEPS_7}, origin=INFINEON_AURIX2G, post-build-variant-value=true, set at post-build, default-value=ADC_NOISE_REDUCTION_STEPS_0  # This parameter defines the noise reduction level for Standard Conversions.
        boolean AdcChSESPSEnable: origin=INFINEON_AURIX2G, post-build-variant-value=true, set at post-build, default-value=false  # This parameter defines whether Spread Early Sample Point for Standard Conversions is enabled/disabled.
        integer AdcEmuxChSampleTime: 0..31, origin=INFINEON_AURIX2G, post-build-variant-value=true, set at post-build, default-value=0  # This parameter defines the number of additional clock cycles to be added to the minimum sample phase of 2 sample clock cycles for EMUX conversions.
        enumeration AdcEmuxChPreChargeClkCycles: {ADC_INPUT_PRECHARGE_CYCLES_0, ADC_INPUT_PRECHARGE_CYCLES_8, ADC_INPUT_PRECHARGE_CYCLES_16, ADC_INPUT_PRECHARGE_CYCLES_32}, origin=INFINEON_AURIX2G, post-build-variant-value=true, set at post-build, default-value=ADC_INPUT_PRECHARGE_CYCLES_0  # This parameter defines the number of analog input precharge clock cycles for EMUX conversions.
        enumeration AdcEmuxChConvMode: {ADC_NOISE_REDUCTION_STEPS_0, ADC_NOISE_REDUCTION_STEPS_1, ADC_NOISE_REDUCTION_STEPS_3, ADC_NOISE_REDUCTION_STEPS_7}, origin=INFINEON_AURIX2G, post-build-variant-value=true, set at post-build, default-value=ADC_NOISE_REDUCTION_STEPS_0  # This parameter defines the noise reduction level for EMUX conversions.
        boolean AdcEmuxChSESPSEnable: origin=INFINEON_AURIX2G, post-build-variant-value=true, set at post-build, default-value=false  # This parameter defines whether Spread Early Sample Point for EMUX conversions is enabled/disabled.
      container AdcHwUnit [1..12]: multiplicity set at pre-compile  # This container contains the Driver configuration (parameters) depending on grouping of channels
        enumeration AdcClockSource [0..1]: {ADC_SYSTEM_CLK}, multiplicity set at post-build, post-build-variant-multiplicity=true, post-build-variant-value=true, set at post-build, default-value=ADC_SYSTEM_CLK  # The ADC module specific clock input for the ADC. This parameter is not used for AURIX 2G. The clock source for the complete EVADC IP can be selected through node Adc/AdcSystemClock
        enumeration AdcHwUnitId: {HWUNIT_ADC0, HWUNIT_ADC1, HWUNIT_ADC2, HWUNIT_ADC3, HWUNIT_ADC4, HWUNIT_ADC5, HWUNIT_ADC6, HWUNIT_ADC7, HWUNIT_ADC8, HWUNIT_ADC9, HWUNIT_ADC10, HWUNIT_ADC11}, set at pre-compile, default-value=HWUNIT_ADC0  # Description: Numeric ID of the HW Unit. This symbolic name allows accessing Hw Unit data. Enumeration literals are defined vendor specific.
        boolean AdcIdlePrechargeEnable: origin=INFINEON_AURIX2G, post-build-variant-value=true, set at post-build, default-value=false  # This parameter determines whether precharge of the sampling capacitor is enabled or not.
        boolean AdcInputBufferEnable: origin=INFINEON_AURIX2G, post-build-variant-value=true, set at post-build, default-value=false  # This parameter determines whether input buffering is enabled or not. If enabled buffering time is selected via AIPS(AdcChPreChargeClkCycles).
        enumeration AdcPrechargeReference: {ADC_VDD_VSM_USED, ADC_VDD_VSM_NOT_USED}, origin=INFINEON_AURIX2G, post-build-variant-value=true, set at post-build, default-value=ADC_VDD_VSM_USED  # This parameter determines whether VDDM/VSSM is used for pre-charging or not.
        enumeration AdcReferencePrechargePhases: {ADC_PRECHARGE_PHASE_1, ADC_PRECHARGE_PHASE_2}, origin=INFINEON_AURIX2G, post-build-variant-value=true, set at post-build, default-value=ADC_PRECHARGE_PHASE_1  # This parameter determines the precharge clock phases for the reference input.
        enumeration AdcCalibrationSampleTime: {ADC_CAL_TIME_2_TIMES_TADCI, ADC_CAL_TIME_4_TIMES_TADCI, ADC_CAL_TIME_6_TIMES_TADCI, ADC_CAL_TIME_8_TIMES_TADCI}, origin=INFINEON_AURIX2G, post-build-variant-value=true, set at post-build, default-value=ADC_CAL_TIME_2_TIMES_TADCI  # This parameter determines the calibration sample time.
        boolean AdcPostCalibrationDisable: origin=INFINEON_AURIX2G, post-build-variant-value=true, set at post-build, default-value=false  # This parameter determines whether the post calibration is enabled or disabled.
        integer AdcAnalogClockSyncDelay: 0..7, origin=INFINEON_AURIX2G, post-build-variant-value=true, set at post-build, default-value=0  # This parameter determines analog clock synchronization delay.
        boolean AdcSampleSyncEnable: origin=INFINEON_AURIX2G, post-build-variant-value=true, set at post-build, default-value=false  # This parameter determines whether the Adc Sample Time Synchronization is enabled or disabled.
        boolean AdcMSBDoubleClkEnable: origin=INFINEON_AURIX2G, post-build-variant-value=true, set at post-build, default-value=false  # This parameter determines the number of clock cycles for MSB conversions.
        enumeration AdcRequestSource{0..2}ConvMode: {ADC_WAIT_FOR_START_MODE, ADC_CANCEL_INJECT_REPEAT_MODE}, origin=INFINEON_AURIX2G, post-build-variant-value=true, set at post-build, default-value=ADC_WAIT_FOR_START_MODE  # This parameter determines conversion start mode for a request source.
        enumeration AdcSyncConvMode: {ADC_STAND_ALONE, ADC_SYNC_MASTER, ADC_SYNC_SLAVE}, origin=INFINEON_AURIX2G, post-build-variant-value=true, set at post-build, default-value=ADC_STAND_ALONE  # Determines whether the HW groups operates in Stand-Alone or Master/Slave Sync Mode.
        integer AdcPrescale: 2..32, post-build-variant-value=true, set at post-build, default-value=4  # This parameter defines the divider for generating the analog internal clock (fADCDI) from fADC.
        container AdcHwUnitInputClass [2..2]  # This container defines the Hw unit input class for A-D conversion
          integer AdcChSampleTime: 0..31, origin=INFINEON_AURIX2G, post-build-variant-value=true, set at post-build, default-value=0  # This parameter defines the number of additional clock cycles to be added to the minimum sample phase of 2 sample clock cycles.
          enumeration AdcChPreChargeClkCycles: {ADC_INPUT_PRECHARGE_CYCLES_0, ADC_INPUT_PRECHARGE_CYCLES_8, ADC_INPUT_PRECHARGE_CYCLES_16, ADC_INPUT_PRECHARGE_CYCLES_32}, origin=INFINEON_AURIX2G, post-build-variant-value=true, set at post-build, default-value=ADC_INPUT_PRECHARGE_CYCLES_0  # This parameter defines the number of analog input precharge clock cycles for standard conversions.
          enumeration AdcChConvMode: {ADC_NOISE_REDUCTION_STEPS_0, ADC_NOISE_REDUCTION_STEPS_1, ADC_NOISE_REDUCTION_STEPS_3, ADC_NOISE_REDUCTION_STEPS_7}, origin=INFINEON_AURIX2G, post-build-variant-value=true, set at post-build, default-value=ADC_NOISE_REDUCTION_STEPS_0  # This parameter defines the noise reduction level for Standard Conversions.
          boolean AdcChSESPSEnable: origin=INFINEON_AURIX2G, post-build-variant-value=true, set at post-build, default-value=false  # This parameter defines whether Spread Early Sample Point for Standard Conversions is enabled/disabled.
          integer AdcEmuxChSampleTime: 0..31, origin=INFINEON_AURIX2G, post-build-variant-value=true, set at post-build, default-value=0  # This parameter defines the number of additional clock cycles to be added to the minimum sample phase of 2 sample clock cycles for EMUX conversions.
          enumeration AdcEmuxChPreChargeClkCycles: {ADC_INPUT_PRECHARGE_CYCLES_0, ADC_INPUT_PRECHARGE_CYCLES_8, ADC_INPUT_PRECHARGE_CYCLES_16, ADC_INPUT_PRECHARGE_CYCLES_32}, origin=INFINEON_AURIX2G, post-build-variant-value=true, set at post-build, default-value=ADC_INPUT_PRECHARGE_CYCLES_0  # This parameter defines the number of analog input precharge clock cycles for EMUX conversions.
          enumeration AdcEmuxChConvMode: {ADC_NOISE_REDUCTION_STEPS_0, ADC_NOISE_REDUCTION_STEPS_1, ADC_NOISE_REDUCTION_STEPS_3, ADC_NOISE_REDUCTION_STEPS_7}, origin=INFINEON_AURIX2G, post-build-variant-value=true, set at post-build, default-value=ADC_NOISE_REDUCTION_STEPS_0  # This parameter defines the noise reduction level for EMUX conversions.
          boolean AdcEmuxChSESPSEnable: origin=INFINEON_AURIX2G, post-build-variant-value=true, set at post-build, default-value=false  # This parameter defines whether Spread Early Sample Point for EMUX conversions is enabled/disabled.
        container AdcChannel [1..255]: multiplicity set at pre-compile  # This container contains the channel configuration (parameters) depending on the hardware capability. This value will be assigned to the symbolic name derived of the AdcChannel container short name. Channel ID 0xFF is considered as invalid
          integer AdcChannelConvTime [0..1]: 0..9223372036854775807, multiplicity set at post-build, post-build-variant-multiplicity=true, post-build-variant-value=true, set at post-build, default-value=0  # Configuration of conversion time, i.e. the time during which the analogue value is converted into digital representation, (in clock cycles) for each channel, if supported by hardware.
          integer AdcChannelHighLimit [0..1]: 0..4095, multiplicity set at post-build, post-build-variant-multiplicity=true, post-build-variant-value=true, set at post-build, default-value=4095  # High limit - used for limit checking.
          integer AdcChannelId: 0..254, set at pre-compile, default-value=0  # This parameter defines the assignment of the channel to the physical ADC hardware channel.
          boolean AdcChannelLimitCheck [0..1]: multiplicity set at post-build, post-build-variant-multiplicity=true, post-build-variant-value=true, set at post-build, default-value=false  # Enables or disables limit checking for an ADC channel.
          integer AdcChannelLowLimit [0..1]: 0..4095, multiplicity set at post-build, post-build-variant-multiplicity=true, post-build-variant-value=true, set at post-build, default-value=0  # Low limit - used for limit checking.
          enumeration AdcChannelRangeSelect [0..1]: {ADC_RANGE_ALWAYS, ADC_RANGE_BETWEEN, ADC_RANGE_NOT_BETWEEN, ADC_RANGE_NOT_OVER_HIGH, ADC_RANGE_NOT_UNDER_LOW, ADC_RANGE_OVER_HIGH, ADC_RANGE_UNDER_LOW}, multiplicity set at post-build, post-build-variant-multiplicity=true, post-build-variant-value=true, set at post-build, default-value=ADC_RANGE_ALWAYS  # In case of active limit checking: defines which conversion values are taken into account related to the boarders defined with AdcChannelLowLimit and AdcChannelHighLimit.
          enumeration AdcChannelRefVoltsrcHigh [0..1]: {ADC_USES_VREF, ADC_USES_CH0}, multiplicity set at post-build, post-build-variant-multiplicity=true, post-build-variant-value=true, set at post-build, default-value=ADC_USES_VREF  # Upper reference voltage source for each channel.
          enumeration AdcChannelRefVoltsrcLow [0..1]: {ADC_USES_VAGND}, multiplicity set at post-build, post-build-variant-multiplicity=true, post-build-variant-value=true, set at post-build, default-value=ADC_USES_VAGND  # Lower reference voltage source for each channel.
          integer AdcChannelResolution [0..1]: 1..63, multiplicity set at post-build, post-build-variant-multiplicity=true, post-build-variant-value=true, set at post-build, default-value=12  # Channel resolution in bits.
          integer AdcChannelSampTime [0..1]: 0..9223372036854775807, multiplicity set at post-build, post-build-variant-multiplicity=true, post-build-variant-value=true, set at post-build, default-value=0  # Configuration of sampling time, i.e. the time during which the value is sampled, (in clock cycles) for each channel, if supported by hardware.
          enumeration AdcAnChannelNum: {G0CH0, G0CH1, G0CH2, G0CH3, G0CH4, G0CH5, G0CH6, G0CH7, G1CH0, G1CH1, G1CH2, G1CH3, G1CH4, G1CH5, G1CH6, G1CH7, G2CH0, G2CH1, G2CH2, G2CH3, G2CH4, G2CH5, G2CH6, G2CH7, G3CH0, G3CH1, G3CH2, G3CH3, G3CH4, G3CH5, G3CH6, G3CH7, G4CH0, G4CH1, G4CH2, G4CH3, G4CH4, G4CH5, G4CH6, G4CH7, G5CH0, G5CH1, G5CH2, G5CH3, G5CH4, G5CH5, G5CH6, G5CH7, G6CH0, G6CH1, G6CH2, G6CH3, G6CH4, G6CH5, G6CH6, G6CH7, G7CH0, G7CH1, G7CH2, G7CH3, G7CH4, G7CH5, G7CH6, G7CH7, G8CH0, G8CH1, G8CH2, G8CH3, G8CH4, G8CH5, G8CH6, G8CH7, G8CH8, G8CH9, G8CH10, G8CH11, G8CH12, G8CH13, G8CH14, G8CH15, G9CH0, G9CH1, G9CH2, G9CH3, G9CH4, G9CH5, G9CH6, G9CH7, G9CH8, G9CH9, G9CH10, G9CH11, G9CH12, G9CH13, G9CH14, G9CH15, G10CH0, G10CH1, G10CH2, G10CH3, G10CH4, G10CH5, G10CH6, G10CH7, G10CH8, G10CH9, G10CH10, G10CH11, G11CH0, G11CH1, G11CH2, G11CH3, G11CH4, G11CH5, G11CH6, G11CH7, G11CH8, G11CH9, G11CH10, G11CH11, G11CH12, G11CH13, G11CH14, G11CH15}, origin=INFINEON_AURIX2G, set at post-build, default-value=G0CH0  # Analog Input Channel Number.There are upto 8 analog inputs for each Primary Kernel and upto 16 analog inputs for each Secondary Kernel.
          enumeration AdcInputClassSelection: {ADC_HWUNIT_CLASS_0, ADC_HWUNIT_CLASS_1, ADC_GLOBAL_CLASS_0, ADC_GLOBAL_CLASS_1}, origin=INFINEON_AURIX2G, post-build-variant-value=true, set at post-build, default-value=ADC_HWUNIT_CLASS_0  # defines the input class for the analog channel. Input class determines the channel conversion properties like sample time and data conversion mode for each channel.
          boolean AdcSyncConvChannelEnable: origin=INFINEON_AURIX2G, post-build-variant-value=true, set at post-build, default-value=false  # Enables the synchronous conversion for this channel.Conversion of this channel will trigger conversion for the same analog channel number on slave HW groups also.
          boolean AdcBWDEnable: origin=INFINEON_AURIX2G, post-build-variant-value=true, set at post-build, default-value=false  # Enables or disables the broken wire detection feature for the channel.
          enumeration AdcBWDPrechargeLevel: {ADC_BWD_PRECH_VAGND, ADC_BWD_PRECH_VAREF}, origin=INFINEON_AURIX2G, post-build-variant-value=true, set at post-build, default-value=ADC_BWD_PRECH_VAGND  # Parameter determines the VAREF/VAGND pre-charging for the broken wire detection channel.
          boolean AdcPullDownDiagnosticEnable: origin=INFINEON_AURIX2G, post-build-variant-value=true, set at post-build, default-value=false  # Enables or disables the Pull Down diagnostics feature for the channel.
          boolean AdcMultiplexerDiagnosticEnable: origin=INFINEON_AURIX2G, post-build-variant-value=true, set at post-build, default-value=false  # Enables or disables the Multiplexer diagnostics feature for the channel.
          enumeration AdcMultiplexerDiagnosticLevel: {ADC_MD_PULL_DOWN, ADC_MD_PULL_UP}, origin=INFINEON_AURIX2G, post-build-variant-value=true, set at post-build, default-value=ADC_MD_PULL_DOWN  # Parameter determines the Multiplexer diagnostics level for the channel.
          boolean AdcConverterDiagnosticEnable: origin=INFINEON_AURIX2G, post-build-variant-value=true, set at post-build, default-value=false  # Enables or disables the Converter diagnostics feature for the channel.
          enumeration AdcConverterDiagnosticsLevel: {ADC_CD_PULL_DEVICE_VDDM, ADC_CD_PULL_DEVICE_VSSM, ADC_CD_PULL_DEVICE_HALF_VDDM, ADC_CD_PULL_DEVICE_TWOTHIRD_VDDM}, origin=INFINEON_AURIX2G, post-build-variant-value=true, set at post-build, default-value=ADC_CD_PULL_DEVICE_VDDM  # Parameter determines the Converter diagnostics level for the channel.
        container AdcGroup [1..32]: multiplicity set at pre-compile  # This container contains the Group configuration (parameters).
          enumeration AdcGroupAccessMode: {ADC_ACCESS_MODE_SINGLE, ADC_ACCESS_MODE_STREAMING}, post-build-variant-value=true, set at post-build, default-value=ADC_ACCESS_MODE_SINGLE  # Type of access mode to group conversion results.
          enumeration AdcGroupConversionMode: {ADC_CONV_MODE_CONTINUOUS, ADC_CONV_MODE_ONESHOT}, post-build-variant-value=true, set at post-build, default-value=ADC_CONV_MODE_ONESHOT  # Type of conversion mode supported by the driver.
          integer AdcGroupId: 0..383, set at pre-compile, symbolic-name-value=true, default-value=0  # Numeric Id of the ADC channel group. This value will be assigned to the symbolic name derived of the AdcGroup containers short name. The range of IDs for each ADC Hw Unit: ADC0: 0 to 31, ADC1: 32 to 63, ADC2: 64 to 95, ADC3: 96 to 127, ADC4: 128 to 159, ADC5: 160 to 191, ADC6: 192 to 223, ADC7: 224 to 255, ADC8: 256 to 287 ADC9: 288 to 319, ADC10: 320 to 351, ADC11: 352 to 383 Recommendation : Use AUTO-CALCULATE-VALUE option for all nodes AdcGroupId
          integer AdcGroupPriority [0..1]: 0..255, multiplicity set at post-build, post-build-variant-multiplicity=true, post-build-variant-value=true, set at post-build, default-value=0  # Priority level of the AdcGroup.
          enumeration AdcGroupReplacement [0..1]: {ADC_GROUP_REPL_ABORT_RESTART, ADC_GROUP_REPL_SUSPEND_RESUME}, multiplicity set at post-build, post-build-variant-multiplicity=true, post-build-variant-value=true, set at post-build, default-value=ADC_GROUP_REPL_ABORT_RESTART  # Replacement mechanism, which is used on ADC group level, if a group conversion is interrupted by a group which has a higher priority.
          enumeration AdcGroupTriggSrc: {ADC_TRIGG_SRC_HW, ADC_TRIGG_SRC_SW}, post-build-variant-value=true, set at post-build, default-value=ADC_TRIGG_SRC_SW  # Type of source event that starts a group conversion.
          enumeration AdcHwTrigSignal [0..1]: {ADC_HW_TRIG_BOTH_EDGES, ADC_HW_TRIG_FALLING_EDGE, ADC_HW_TRIG_RISING_EDGE}, multiplicity set at post-build, post-build-variant-multiplicity=true, post-build-variant-value=true, set at post-build, default-value=ADC_HW_TRIG_RISING_EDGE  # Configures on which edge of the hardware trigger signal the driver should react, i.e. start the conversion (only if supported by the ADC hardware).
          integer AdcHwTrigTimer [0..1]: 0..1023, multiplicity set at post-build, post-build-variant-multiplicity=true, post-build-variant-value=true, set at post-build, default-value=0  # Reload value of the ADC module embedded timer (only if supported by ADC hardware).
          function name AdcNotification [0..1]: multiplicity set at post-build, post-build-variant-multiplicity=true, post-build-variant-value=true, set at post-build, default-value=IoHwAb_AdcNotification0  # Callback function for each group
          enumeration AdcStreamingBufferMode: {ADC_STREAM_BUFFER_CIRCULAR, ADC_STREAM_BUFFER_LINEAR}, post-build-variant-value=true, set at post-build, default-value=ADC_STREAM_BUFFER_LINEAR  # Configure streaming buffer as "linear buffer" (i.e. the ADC Driver stops the conversion as soon as the stream buffer is full) or as "ring buffer" (wraps around if the end of the stream buffer is reached).
          integer AdcStreamingNumSamples: 1..255, post-build-variant-value=true, set at post-build, default-value=1  # Number of ADC values to be acquired per channel in streaming access mode.
          enumeration AdcHwExtTrigSelect: {ADC_TRIG_NONE, ADC_TRIG_0_GxREQTRA_CCU60_SR3, ADC_TRIG_1_GxREQTRB_CCU61_SR3, ADC_TRIG_2_GxREQTRC_HSPDM, ADC_TRIG_3_GxREQTRD_UNUSED, ADC_TRIG_4_GxREQTRE_UNUSED, ADC_TRIG_5_GxREQTRF_UNUSED, ADC_TRIG_6_GxREQTRG_GTM_ADCx_TRIG4, ADC_TRIG_7_GxREQTRH_ERUIOUTx, ADC_TRIG_8_GxREQTRI_GTM_ADCx_TRIG0, ADC_TRIG_9_GxREQTRJ_GTM_ADCx_TRIG1, ADC_TRIG_10_GxREQTRK_GTM_ADCx_TRIG2, ADC_TRIG_11_GxREQTRL_GTM_ADCx_TRIG3, ADC_TRIG_12_GxREQTRM_EVADC_UNUSED, ADC_TRIG_13_GxREQTRN_EVADC_UNUSED, ADC_TRIG_14_GxREQTRO_EVADC_UNUSED, ADC_TRIG_15_GxREQTRP_GxREQGTySEL}, origin=INFINEON_AURIX2G, post-build-variant-value=true, set at post-build, default-value=ADC_TRIG_NONE  # This parameter configures the HW trigger source for the group.
          enumeration AdcHwExtGateSelect: {ADC_GATE_NONE, ADC_GATE_0_GxREQGTA_GTM_ADCx_TRIG0, ADC_GATE_1_GxREQGTB_GTM_ADCx_TRIG1, ADC_GATE_2_GxREQGTC_CCU6061_TRIG0, ADC_GATE_3_GxREQGTD_CCU6061_TRIG1, ADC_GATE_4_GxREQGTE_CCU6061_TRIG2, ADC_GATE_5_GxREQGTF_UNUSED, ADC_GATE_6_GxREQGTG_GTM_ADCx_TRIG4, ADC_GATE_7_GxREQGTH_UNUSED, ADC_GATE_8_GxREQGTI_UNUSED, ADC_GATE_9_GxREQGTJ_UNUSED, ADC_GATE_10_GxREQGTK_GTM_ADCx_TRIG2, ADC_GATE_11_GxREQGTL_GTM_ADCx_TRIG3, ADC_GATE_12_GxREQGTM_ERUPDOUTx, ADC_GATE_13_GxREQGTN_UNUSED, ADC_GATE_14_GxREQGTO_UNUSED}, origin=INFINEON_AURIX2G, post-build-variant-value=true, set at post-build, default-value=ADC_GATE_NONE  # This parameter configures the HW gating source for the group.
          enumeration AdcHwGateSignal: {ADC_GATE_LVL_HIGH, ADC_GATE_LVL_LOW}, origin=INFINEON_AURIX2G, post-build-variant-value=true, set at post-build, default-value=ADC_GATE_LVL_HIGH  # This parameter configures the HW gating signal level.
          integer AdcChannel0Alias: 0..31, origin=INFINEON_AURIX2G, post-build-variant-value=true, set at post-build, default-value=0  # This parameter configures the alias channel to be used for Channel 0.
          integer AdcChannel1Alias: 0..31, origin=INFINEON_AURIX2G, post-build-variant-value=true, set at post-build, default-value=1  # This parameter configures the alias channel to be used for Channel 1.
          boolean AdcEmuxChGroup: origin=INFINEON_AURIX2G, post-build-variant-value=true, set at post-build, default-value=false  # This parameter defines whether Group is EMUX or not.
          integer AdcEmuxStartSelection: 0..7, origin=INFINEON_AURIX2G, post-build-variant-value=true, set at post-build, default-value=0  # This parameter defines the EMUX start selection.
          integer AdcResRegDefinition [1..16]: 0..15, multiplicity set at post-build, origin=INFINEON_AURIX2G, post-build-variant-multiplicity=true, post-build-variant-value=true, set at post-build, default-value=0  # This parameter defines the result register used for storing the result of this particular ADC conversion. This value of this parameter should be in descending order for the nodes of AdcGroupDefinition.
          reference AdcGroupDefinition [1..16]: multiplicity set at post-build, post-build-variant-multiplicity=true, post-build-variant-value=true, set at post-build, destination=AdcChannel  # Assignment of AdcChannels to a AdcGroups.
          reference AdcGroupEcucPartitionRef [0..*]: scope=ECU, multiplicity set at pre-compile, post-build-variant-multiplicity=true, post-build-variant-value=true, set at pre-compile, destination=EcucPartition  # Maps an ADC channel group to zero or multiple ECUC partitions to limit the access to this channel group. The ECUC partitions referenced are a subset of the ECUC partitions where the ADC driver is mapped to. Tags: atp.Status=draft
          container EruTriggerConfig [0..1]: multiplicity set at post-build, post-build-variant-multiplicity=true  # This container configures the parameters for ERU triggering
            enumeration AdcEruErsInputPin: {ERS_REQ0A_PORTS_P15_4_SEL0, ERS_REQ0B_CCU60_COUT60_SEL1, ERS_REQ0C_PORTS_P10_7_SEL2, ERS_REQ0D_MSC0_FCLP_SEL3, ERS_REQ0E_STM5_STMIR0_SEL4, ERS_REQ0F_Reserved_SEL5, ERS_REQ1A_PORTS_P14_3_SEL0, ERS_REQ1B_CCU61_COUT60_SEL1, ERS_REQ1C_PORTS_P10_8_SEL2, ERS_REQ1D_STM0_STMIR0_SEL3, ERS_REQ1E_Reserved_SEL4, ERS_REQ1F_Reserved_SEL5, ERS_REQ2A_PORTS_P10_2_SEL0, ERS_REQ2B_PORTS_P02_1_SEL1, ERS_REQ2C_PORTS_P00_4_SEL2, ERS_REQ2D_ERAY0_MT_SEL3, ERS_REQ2E_Reserved_SEL4, ERS_REQ2F_Reserved_SEL5, ERS_REQ3A_PORTS_P10_3_SEL0, ERS_REQ3B_PORTS_P14_1_SEL1, ERS_REQ3C_PORTS_P02_0_SEL2, ERS_REQ3D_STM1_STMIR0_SEL3, ERS_REQ3E_Reserved_SEL4, ERS_REQ3F_Reserved_SEL5, ERS_REQ4A_PORTS_P33_7_SEL0, ERS_REQ4B_GTM_TOM0_12_SEL1, ERS_REQ4C_GPT120_T3OUT_SEL2, ERS_REQ4D_PORTS_P15_5_SEL3, ERS_REQ4E_Reserved_SEL4, ERS_REQ4F_Reserved_SEL5, ERS_REQ5A_PORTS_P15_8_SEL0, ERS_REQ5B_GTM_TOM1_12_SEL1, ERS_REQ5C_GPT120_T6OUT_SEL2, ERS_REQ5D_STM2_STMIR0_SEL3, ERS_REQ5E_Reserved_SEL4, ERS_REQ5F_Reserved_SEL5, ERS_REQ6A_PORTS_P20_0_SEL0, ERS_REQ6B_PORTS_ESR0_SEL1, ERS_REQ6C_Reserved_SEL2, ERS_REQ6D_PORTS_P11_10_SEL3, ERS_REQ6E_STM3_STMIR0_SEL4, ERS_REQ6F_GTM_TOM2_12_SEL5, ERS_REQ7A_PORTS_P20_9_SEL0, ERS_REQ7B_PORTS_ESR1_SEL1, ERS_REQ7C_PORTS_P15_1_SEL2, ERS_REQ7D_ERAY1_MT_SEL3, ERS_REQ7E_STM4_STMIR0_SEL4, ERS_REQ7F_GTM_TOM3_12_SEL5}, origin=INFINEON_AURIX2G, post-build-variant-value=true, set at post-build, default-value=ERS_REQ0A_PORTS_P15_4_SEL0  # This parameter determines the input pin for the selected ERS
            reference AdcEruErsRef: origin=INFINEON_AURIX2G, post-build-variant-value=true, set at post-build, destination=McuEruChannelInputLineConf  # This parameter is a reference to the ERU container in the MCU. It lists down all the ERU-ERS channels available.
            reference AdcEruOguRef: origin=INFINEON_AURIX2G, post-build-variant-value=true, set at post-build, destination=McuEruChannelOutputUnitConf  # This parameter is a reference to the ERU container in the MCU. It lists down all the ERU-OGU channels available. The OGUs available is dependent on the AdcHwUnitId.
          container EruGatingConfig [0..1]: multiplicity set at post-build, post-build-variant-multiplicity=true  # This container configures the parameters for ERU Gating
            enumeration AdcEruErsInputPin: {ERS_REQ0A_PORTS_P15_4_SEL0, ERS_REQ0B_CCU60_COUT60_SEL1, ERS_REQ0C_PORTS_P10_7_SEL2, ERS_REQ0D_MSC0_FCLP_SEL3, ERS_REQ0E_STM5_STMIR0_SEL4, ERS_REQ0F_Reserved_SEL5, ERS_REQ1A_PORTS_P14_3_SEL0, ERS_REQ1B_CCU61_COUT60_SEL1, ERS_REQ1C_PORTS_P10_8_SEL2, ERS_REQ1D_STM0_STMIR0_SEL3, ERS_REQ1E_Reserved_SEL4, ERS_REQ1F_Reserved_SEL5, ERS_REQ2A_PORTS_P10_2_SEL0, ERS_REQ2B_PORTS_P02_1_SEL1, ERS_REQ2C_PORTS_P00_4_SEL2, ERS_REQ2D_ERAY0_MT_SEL3, ERS_REQ2E_Reserved_SEL4, ERS_REQ2F_Reserved_SEL5, ERS_REQ3A_PORTS_P10_3_SEL0, ERS_REQ3B_PORTS_P14_1_SEL1, ERS_REQ3C_PORTS_P02_0_SEL2, ERS_REQ3D_STM1_STMIR0_SEL3, ERS_REQ3E_Reserved_SEL4, ERS_REQ3F_Reserved_SEL5, ERS_REQ4A_PORTS_P33_7_SEL0, ERS_REQ4B_GTM_TOM0_12_SEL1, ERS_REQ4C_GPT120_T3OUT_SEL2, ERS_REQ4D_PORTS_P15_5_SEL3, ERS_REQ4E_Reserved_SEL4, ERS_REQ4F_Reserved_SEL5, ERS_REQ5A_PORTS_P15_8_SEL0, ERS_REQ5B_GTM_TOM1_12_SEL1, ERS_REQ5C_GPT120_T6OUT_SEL2, ERS_REQ5D_STM2_STMIR0_SEL3, ERS_REQ5E_Reserved_SEL4, ERS_REQ5F_Reserved_SEL5, ERS_REQ6A_PORTS_P20_0_SEL0, ERS_REQ6B_PORTS_ESR0_SEL1, ERS_REQ6C_Reserved_SEL2, ERS_REQ6D_PORTS_P11_10_SEL3, ERS_REQ6E_STM3_STMIR0_SEL4, ERS_REQ6F_GTM_TOM2_12_SEL5, ERS_REQ7A_PORTS_P20_9_SEL0, ERS_REQ7B_PORTS_ESR1_SEL1, ERS_REQ7C_PORTS_P15_1_SEL2, ERS_REQ7D_ERAY1_MT_SEL3, ERS_REQ7E_STM4_STMIR0_SEL4, ERS_REQ7F_GTM_TOM3_12_SEL5}, origin=INFINEON_AURIX2G, post-build-variant-value=true, set at post-build, default-value=ERS_REQ0A_PORTS_P15_4_SEL0  # This parameter determines the input pin for the selected ERS
            reference AdcEruErsRef: origin=INFINEON_AURIX2G, post-build-variant-value=true, set at post-build, destination=McuEruChannelInputLineConf  # This parameter is a reference to the ERU container in the MCU. It lists down all the ERU-ERS channels available.
            reference AdcEruOguRef: origin=INFINEON_AURIX2G, post-build-variant-value=true, set at post-build, destination=McuEruChannelOutputUnitConf  # This parameter is a reference to the ERU container in the MCU. It lists down all the ERU-OGU channels available. The OGUs available is dependent on the AdcHwUnitId.
          container GtmTriggerTimerConfig [0..1]: multiplicity set at pre-compile  # Choose GTM TOM/ATOM channel which will be used by this AdcGroup for TRIGGER. Referred timer channel in MCU should have TomChannelUsage/ AtomChannelUsage as USED_BY_ADC_DRIVER
            enumeration GtmTimerClockSelect: {GTM_FIXED_CLOCK_0, GTM_FIXED_CLOCK_1, GTM_FIXED_CLOCK_2, GTM_FIXED_CLOCK_3, GTM_FIXED_CLOCK_4, GTM_CONFIGURABLE_CLOCK_0, GTM_CONFIGURABLE_CLOCK_1, GTM_CONFIGURABLE_CLOCK_2, GTM_CONFIGURABLE_CLOCK_3, GTM_CONFIGURABLE_CLOCK_4, GTM_CONFIGURABLE_CLOCK_5, GTM_CONFIGURABLE_CLOCK_6, GTM_CONFIGURABLE_CLOCK_7}, origin=INFINEON_AURIX2G, post-build-variant-value=true, set at post-build, default-value=GTM_FIXED_CLOCK_0  # This parameter decides the Clock Source for TOM/ATOM timer.
            integer GtmTimerTimePeriod: 0..65536000, origin=INFINEON_AURIX2G, post-build-variant-value=true, set at post-build, default-value=20000  # This parameter is used for selecting the time period of the GTM timer in micro seconds.
            integer GtmTimerCM0Ticks: 0..16777215, origin=INFINEON_AURIX2G, post-build-variant-value=true, set at post-build, default-value=0  # This parameter specifies the Period Compare value (CM0) for the TOM/ATOM Channel in ticks.
            choice reference GtmTimerUsed: scope=ECU, origin=INFINEON_AURIX2G, set at pre-compile, destination=[McuGtmTomChannelAllocationConf, McuGtmAtomChannelAllocationConf]  # This parameter lists all the GTM timer channels (TOM/ATOM).
          container GtmGatingTimerConfig [0..1]: multiplicity set at pre-compile  # Choose GTM TOM/ATOM channel which will be used by this AdcGroup for GATING. Referred timer channel in MCU should have TomChannelUsage/ AtomChannelUsage as USED_BY_ADC_DRIVER
            enumeration GtmTimerClockSelect: {GTM_FIXED_CLOCK_0, GTM_FIXED_CLOCK_1, GTM_FIXED_CLOCK_2, GTM_FIXED_CLOCK_3, GTM_FIXED_CLOCK_4, GTM_CONFIGURABLE_CLOCK_0, GTM_CONFIGURABLE_CLOCK_1, GTM_CONFIGURABLE_CLOCK_2, GTM_CONFIGURABLE_CLOCK_3, GTM_CONFIGURABLE_CLOCK_4, GTM_CONFIGURABLE_CLOCK_5, GTM_CONFIGURABLE_CLOCK_6, GTM_CONFIGURABLE_CLOCK_7}, origin=INFINEON_AURIX2G, post-build-variant-value=true, set at post-build, default-value=GTM_FIXED_CLOCK_0  # This parameter decides the Clock Source for TOM/ATOM timer.
            integer GtmTimerTimePeriod: 0..65536000, origin=INFINEON_AURIX2G, post-build-variant-value=true, set at post-build, default-value=20000  # This parameter is used for selecting the time period of the GTM timer in micro seconds.
            integer GtmTimerCM0Ticks: 0..16777215, origin=INFINEON_AURIX2G, post-build-variant-value=true, set at post-build, default-value=0  # This parameter specifies the Period Compare value (CM0) for the TOM/ATOM Channel in ticks.
            choice reference GtmTimerUsed: scope=ECU, origin=INFINEON_AURIX2G, set at pre-compile, destination=[McuGtmTomChannelAllocationConf, McuGtmAtomChannelAllocationConf]  # This parameter lists all the GTM timer channels (TOM/ATOM).
    container AdcDemEventParameterRefs [0..1]: multiplicity set at pre-compile  # Container for the references to DemEventParameter elements which shall be invoked using the API Mcal_Wrapper_Dem_SetEventStatus API in case the corresponding error occurs. The EventId is taken from the referenced DemEventParameter's DemEventId symbolic name.
      reference AdcClcFailureNotification [0..1]: multiplicity set at pre-compile, origin=INFINEON_AURIX2G, set at pre-compile, requires-symbolic-name-value=true, destination=DemEventParameter  # Reference to configured DEM event to report CLC Failure.
      reference AdcConvStopTimeNotification [0..1]: multiplicity set at pre-compile, origin=INFINEON_AURIX2G, set at pre-compile, requires-symbolic-name-value=true, destination=DemEventParameter  # Reference to configured DEM event to report, wait counts configured at AdcMaxChConvTimeCount to stop the conversion is not sufficient.
    container AdcGeneral  # General configuration (parameters) of the ADC Driver software module.
      boolean AdcDeInitApi: set at pre-compile, default-value=false  # Adds / removes the service Adc_DeInit() from the code.
      boolean AdcDevErrorDetect: set at pre-compile, default-value=false  # Switches the Default Error Tracer (Det) detection and notification ON or OFF.
      boolean AdcSafetyEnable: origin=INFINEON_AURIX2G, set at pre-compile, default-value=true  # Enable/Disable the Safety check and all associated notifications.
      boolean AdcRunTimeErrorDetect: origin=INFINEON_AURIX2G, set at pre-compile, default-value=true  # Switches the Default Error Tracer (Det) detection and notification ON or OFF.
      boolean AdcMultiCoreErrorDetect: origin=INFINEON_AURIX2G, set at pre-compile, default-value=false  # Adds / removes the Multicore error detection feature from the code.
      boolean AdcInitCheckApi: origin=INFINEON_AURIX2G, set at pre-compile, default-value=false  # Adds / removes the service Adc_InitCheck() from the code.
      boolean AdcEnableLimitCheck: set at pre-compile, default-value=false  # Enables or disables limit checking feature in the ADC driver.
      boolean AdcEnableQueuing: set at pre-compile, default-value=false  # Determines, if the queuing mechanism is active in case of priority mechanism disabled.
      boolean AdcEnableStartStopGroupApi: set at pre-compile, default-value=false  # Adds / removes the services Adc_StartGroupConversion() and Adc_StopGroupConversion() from the code.
      boolean AdcGrpNotifCapability: set at pre-compile, default-value=false  # Determines, if the group notification mechanism (the functions to enable and disable the notifications) is available at runtime.
      boolean AdcHwTriggerApi: set at pre-compile, default-value=false  # Adds / removes the services Adc_EnableHardwareTrigger() and Adc_DisableHardwareTrigger() from the code.
      boolean AdcReadGroupApi: set at pre-compile, default-value=false  # Adds / removes the service Adc_ReadGroup() and from the code.
      boolean AdcVersionInfoApi: set at pre-compile, default-value=false  # Adds / removes the service Adc_GetVersionInfo() from the code.
      boolean AdcStartupCalibApi: origin=INFINEON_AURIX2G, set at pre-compile, default-value=false  # Adds / removes the service Adc_GetStartupCalStatus() and Adc_TriggerStartupCal() from the code.
      boolean AdcTriggerOneConversionEnable: origin=INFINEON_AURIX2G, set at pre-compile, default-value=false  # This parameter enables the execution of one dummy conversion for each configured HW unit, before start-up calibration is triggered in the API Adc_TriggerStartupCal(). Refer Errata ADC_TC.083
      boolean AdcSyncConvEnable: origin=INFINEON_AURIX2G, set at pre-compile, default-value=false  # Enables the synchronous conversions across ADC HW groups.
      boolean AdcLowPowerStatesSupport [0..1]: multiplicity set at pre-compile, set at pre-compile, default-value=false  # Adds / removes all power state management related APIs (ADC_SetPowerState, ADC_GetCurrentPowerState, ADC_GetTargetPowerState, ADC_PreparePowerState), indicating if the HW offers low power state management.
      boolean AdcPowerStateAsynchTransitionMode [0..1]: multiplicity set at pre-compile, set at pre-compile, default-value=false  # Enables / disables support of the ADCDriver to the asynchronous power state transition.
      enumeration AdcPriorityImplementation: {ADC_PRIORITY_NONE, ADC_PRIORITY_HW, ADC_PRIORITY_HW_SW}, set at pre-compile, default-value=ADC_PRIORITY_NONE  # Determines whether a priority mechanism is available for prioritization of the conversion requests and if available, the type of prioritization mechanism. The selection applies for groups with trigger source software and trigger source hardware. Two
      enumeration AdcResultHandlingImplementation: {ADC_INTERRUPT_MODE_RESULT_HANDLING, ADC_DMA_MODE_RESULT_HANDLING}, origin=INFINEON_AURIX2G, set at pre-compile, default-value=ADC_INTERRUPT_MODE_RESULT_HANDLING  # Determines the result handling mode for the ADC driver.ADC_INTERRUPT_MODE_RESULT_HANDLING: Conversion results are transferred in the Request Source ISR (AUTOSAR Mode). ADC_DMA_MODE_RESULT_HANDLING: Conversion results are transferred using a DMA channel.
      enumeration AdcResultAlignment: {ADC_ALIGN_LEFT, ADC_ALIGN_RIGHT}, set at pre-compile, default-value=ADC_ALIGN_RIGHT  # Alignment of ADC raw results in ADC result buffer (left/right alignment).
      integer AdcMaxChConvTimeCount: 0..16962, origin=INFINEON_AURIX2G, set at pre-compile, default-value=0  # On stop of conversion request, the ongoing channel conversion in the A/D converter cannot be stopped immediately. Instead the software needs to wait for the channel conversion to get over. Inorder to ensure the converter is idle, a wait on coverter status polling is required and its maximum wait time is defined by the value entered in the AdcMaxChConvTimeCount
      enumeration AdcSleepMode: {ADC_SLEEP_MODE_ACCEPT, ADC_SLEEP_MODE_REJECT}, origin=INFINEON_AURIX2G, set at pre-compile, default-value=ADC_SLEEP_MODE_ACCEPT  # This parameter determines whether, ADC Driver accepts or rejects the sleep mode request from SCU.
      enumeration AdcSupplyVoltage: {ADC_VOLTAGE_CONTROLLED_BY_SUPPLY, ADC_VOLTAGE_5V, ADC_VOLTAGE_3P3V}, origin=INFINEON_AURIX2G, set at pre-compile, default-value=ADC_VOLTAGE_CONTROLLED_BY_SUPPLY  # This parameter adjusts the analog circuitry to the selected supply voltage.
      enumeration AdcRuntimeApiMode: {ADC_MCAL_SUPERVISOR, ADC_MCAL_USER1}, origin=INFINEON_AURIX2G, set at pre-compile, default-value=ADC_MCAL_SUPERVISOR  # Defines the privilege mode in which the runtime APIs would operate.
      enumeration AdcInitDeInitApiMode: {ADC_MCAL_SUPERVISOR, ADC_MCAL_USER1}, origin=INFINEON_AURIX2G, set at pre-compile, default-value=ADC_MCAL_SUPERVISOR  # Defines the privilege mode in which the Initialization and De-initialization APIs would operate.
      boolean AdcEmuxEnable: origin=INFINEON_AURIX2G, set at pre-compile, default-value=false  # Determines, if the EMUX is used.
      enumeration AdcEmuxGroupInterface0: {HWUNIT_ADC0, HWUNIT_ADC1, HWUNIT_ADC2, HWUNIT_ADC3, HWUNIT_ADC4, HWUNIT_ADC5, HWUNIT_ADC6, HWUNIT_ADC7, HWUNIT_ADC8, HWUNIT_ADC9, HWUNIT_ADC10, HWUNIT_ADC11}, origin=INFINEON_AURIX2G, set at pre-compile, default-value=HWUNIT_ADC0  # Description: Numeric ID of the HW Unit. This symbolic name allows accessing Hw Unit data. Enumeration literals are defined vendor specific.
      enumeration AdcEmuxGroupInterface1: {HWUNIT_ADC0, HWUNIT_ADC1, HWUNIT_ADC2, HWUNIT_ADC3, HWUNIT_ADC4, HWUNIT_ADC5, HWUNIT_ADC6, HWUNIT_ADC7, HWUNIT_ADC8, HWUNIT_ADC9, HWUNIT_ADC10, HWUNIT_ADC11}, origin=INFINEON_AURIX2G, set at pre-compile, default-value=HWUNIT_ADC1  # Description: Numeric ID of the HW Unit. This symbolic name allows accessing Hw Unit data. Enumeration literals are defined vendor specific.
      reference AdcEcucPartitionRef [0..*]: scope=ECU, multiplicity set at pre-compile, post-build-variant-multiplicity=true, post-build-variant-value=true, set at pre-compile, destination=EcucPartition  # Maps the ADC driver to zero or multiple ECUC partitions to make the driver API available in the according partition. Tags: atp.Status=draft
      reference AdcKernelEcucPartitionRef [0..1]: scope=ECU, multiplicity set at pre-compile, post-build-variant-multiplicity=true, post-build-variant-value=true, set at pre-compile, destination=EcucPartition  # Maps the ADC kernel to zero or one ECUC partitions to assign the driver kernel to a certain core. The ECUC partition referenced is a subset of the ECUC partitions where the ADC driver is mapped to. Tags: atp.Status=draft
      container AdcPowerStateConfig [0..4]: multiplicity set at pre-compile  # Each instance of this parameter defines a power state and the callback to be called when this power state is reached.
        integer AdcPowerState: 0..3, set at pre-compile, symbolic-name-value=true, default-value=0  # Each instance of this parameter describes a different power state supported by the ADC HW. It should be defined by the HW supplier and used by the ADCDriver to reference specific HW configurations which set the ADC HW module in the referenced power state.
        function name AdcPowerStateReadyCbkRef: set at pre-compile, default-value=NULL_PTR  # Each instance of this parameter contains a reference to a power mode callback defined in a CDD or IoHwAbs component.
    container AdcPublishedInformation  # Additional published parameters not covered by Common Published Information. Note that these parameters have "PUBLISHED-INFORMATION" configuration class setting, since they are published information.
      boolean AdcChannelValueSigned: set at published-information, default-value=false  # Information whether the result value of the ADC driver has sign information (true) or not (false). If the result shall be interpreted as signed value it shall apply to C-language rules.
      boolean AdcGroupFirstChannelFixed: set at published-information, default-value=false  # Information whether the first channel of an ADC Channel group can be configured (false) or is fixed (true) to a value determined by the ADC HW Unit.
      integer AdcMaxChannelResolution: 1..63, set at published-information, default-value=12  # Maximum Channel resolution in bits (does not specify accuracy).
    container CommonPublishedInformation  # Common container, aggregated by all modules. It contains published information about vendor and versions.
      integer ArMajorVersion: 0..255, origin=INFINEON_AURIX2G, set at published-information, default-value=4  # Major version number of AUTOSAR specification on which the appropriate implementation is based on.
      integer ArMinorVersion: 0..255, origin=INFINEON_AURIX2G, set at published-information, default-value=4  # Minor version number of AUTOSAR specification on which the appropriate implementation is based on.
      integer ArPatchVersion: 0..255, origin=INFINEON_AURIX2G, set at published-information, default-value=0  # Patch level version number of AUTOSAR specification on which the appropriate implementation is based on.
      integer SwMajorVersion: 0..255, origin=INFINEON_AURIX2G, set at published-information, default-value=20  # Major version number of the vendor specific implementation of the module. The numbering is vendor specific.
      integer SwMinorVersion: 0..255, origin=INFINEON_AURIX2G, set at published-information, default-value=25  # Minor version number of the vendor specific implementation of the module. The numbering is vendor specific.
      integer SwPatchVersion: 0..255, origin=INFINEON_AURIX2G, set at published-information, default-value=0  # Patch level version number of the vendor specific implementation of the module. The numbering is vendor specific.
      integer ModuleId: 0..65535, origin=INFINEON_AURIX2G, set at published-information, default-value=123  # Module ID of this module from Module List
      integer VendorId: 0..65535, origin=INFINEON_AURIX2G, set at published-information, default-value=17  # Vendor ID of the dedicated implementation of this module according to the AUTOSAR vendor list
      string Release: origin=INFINEON_AURIX2G, set at published-information, default-value=_TRICORE_TC399  # Aurix2G derivative used for the implementation
