AUTOSAR XML (schema 00046)
package /AURIX2G/EcucDefs
  module config FlsLoader_Rec: definition=FlsLoader
  bsw implementation FlsLoader_Impl: programming-language=C, vendor-id=17, behavior=FlsLoaderBehavior, recommended-configuration=FlsLoader_Rec, vendor-specific-module-def=FlsLoader
