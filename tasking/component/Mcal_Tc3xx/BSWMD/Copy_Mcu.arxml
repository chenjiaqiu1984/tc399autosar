AUTOSAR XML (schema 00046)
package /AURIX2G/EcucDefs
  module definition Mcu [0..1]: post-build-variant-support=true, refined-module-def=Mcu, variants post-build  # Configuration of the Mcu (Microcontroller Unit) module.
    container McuGeneralConfiguration  # This container contains the configuration (parameters) of the MCU driver.
      boolean McuDevErrorDetect: set at pre-compile, default-value=false  # Switches the Default Error Tracer (Det) detection and notification ON or OFF.
      boolean McuMultiCoreErrorDetect: origin=INFINEON_AURIX2G, set at pre-compile, default-value=false  # Switches the Multicore Error detection and notification ON or OFF.
      boolean McuGetRamStateApi: set at pre-compile, default-value=false  # Pre-processor switch to enable/disable the API Mcu_GetRamState. This Api is not supported, therefore this parameter is always false. TRUE : The function Mcu_GetRamState() is enabled. FALSE: The function Mcu_GetRamState() is disabled.
      boolean McuInitClock: set at pre-compile, default-value=true  # If this parameter is set to FALSE, the clock initialization has to be disabled from the MCU driver. This concept applies when there are some write once clock registers and a bootloader is present. If this parameter is set to TRUE, the MCU driver is responsible of the clock initialization. TRUE : Mcu_InitClock API is available. FALSE: Mcu_InitClock API is not available.
      boolean McuNoPll: set at pre-compile, default-value=false  # This parameter is set True, if the H/W does not have a PLL or the PLL circuitry is enabled after the power on without S/W intervention. In this case MCU_DistributePllClock API is disabled and MCU_GetPllStatus returns MCU_PLL_STATUS_UNDEFINED. Otherwise, this parameters has to be set False TRUE : Mcu is not responsible for PLL related setup. FALSE: Mcu is responsible to setup PLLs.
      boolean McuPerformResetApi: set at pre-compile, default-value=false  # Pre-processor switch to enable / disable the use of the function Mcu_PerformReset() TRUE : The function Mcu_PerformReset() is available FALSE: The function Mcu_PerformReset() not is available
      boolean McuVersionInfoApi: set at pre-compile, default-value=false  # Pre-processor switch to enable / disable the API to read out the modules version information. TRUE : Mcu_GetVersionInfo() API is enabled FALSE: Mcu_GetVersionInfo() API is disabled
      boolean McuClearColdResetStatusApi: origin=INFINEON_AURIX2G, set at pre-compile, default-value=false  # Pre-processor switch to enable/disable the API Mcu_ClearColdResetStatus. TRUE : Enables Mcu_ClearColdResetStatus API. FALSE: Disables Mcu_ClearColdResetStatus API.
      boolean McuGpt12SleepModeEnabled: origin=INFINEON_AURIX2G, post-build-variant-value=true, set at post-build, default-value=false  # This parameter specifies if GPT12 peripheral goes into sleep mode when complete system is put into sleep mode. TRUE : Enables sleep mode for GPT12 peripheral FALSE: Disables sleep mode for GPT12 peripheral.
      boolean McuGtmSleepModeEnabled: origin=INFINEON_AURIX2G, post-build-variant-value=true, set at post-build, default-value=false  # This parameter specifies if GTM peripheral goes into sleep mode when complete system is put into sleep mode. TRUE : Enables sleep mode for GTM peripheral FALSE: Disables sleep mode for GTM peripheral.
      boolean McuCcu60SleepModeEnabled: origin=INFINEON_AURIX2G, post-build-variant-value=true, set at post-build, default-value=false  # This parameter specifies if CCU60 peripheral goes into sleep mode when complete system is put into sleep mode. TRUE : Enables sleep mode for CCU60 peripheral FALSE: Disables sleep mode for CCU60 peripheral.
      boolean McuCcu61SleepModeEnabled: origin=INFINEON_AURIX2G, post-build-variant-value=true, set at post-build, default-value=false  # This parameter specifies if CCU61 peripheral goes into sleep mode when complete system is put into sleep mode. TRUE : Enables sleep mode for CCU61 peripheral FALSE: Disables sleep mode for CCU61 peripheral.
      boolean McuIfxLpmApi: origin=INFINEON_AURIX2G, set at pre-compile, default-value=false  # This parameter Enables/Disables availability of low power mode APIs defined by IFX namely Mcu_GetCpuIdleModeInitiator, Mcu_GetCpuState, Mcu_GetWakeupCause and Mcu_ClearWakeupCause..
      boolean McuIfxTrapApi: origin=INFINEON_AURIX2G, set at pre-compile, default-value=false  # This parameter Enables/Disables availability of trap related APIs defined by IFX namely Mcu_GetTrapCause, Mcu_SetTrapRequest and Mcu_ClearTrapRequest..
      boolean McuIfxCpuCcuconApi: origin=INFINEON_AURIX2G, set at pre-compile, default-value=false  # This parameter Enables/Disables availability of Cpu Ccucon register update API defined by IFX namely Mcu_UpdateCpuCcuconReg.
      boolean McuIfxDeInitApi: origin=INFINEON_AURIX2G, set at pre-compile, default-value=false  # This parameter Enables/Disables availability of Mcu Deinitialization API - Mcu_DeInit.
      boolean McuClockSourceFailureNotification: origin=INFINEON_AURIX2G, set at pre-compile, default-value=false  # This parameter availibility of Clock failure related Production Errors notification function. ENABLED Clock failure related Production Errors are reported DISABLED Clock failure related Production Errors are not reported
      boolean McuSafetyEnable: origin=INFINEON_AURIX2G, set at pre-compile, default-value=true  # Enables/Disables safety checks and features of MCU driver
      boolean McuInitCheckApi: origin=INFINEON_AURIX2G, set at pre-compile, default-value=false  # Enables/Disables availability of Mcu_InitCheck API.
      boolean McuOscAmpRegulationEnable: origin=INFINEON_AURIX2G, set at pre-compile, default-value=false  # Enables/Disables oscillator amplitude regulation True: Oscillator amplitude regulation is Enabled. False: Oscillator amplitude regulation is Disabled.
      boolean McuOscCapacitance{0..3}Enable: origin=INFINEON_AURIX2G, set at pre-compile, default-value=false  # Enables/Disables oscillator load capacitance{0..3} True: Oscillator load capacitance{0..3} is Enabled. False: Oscillator load capacitance{0..3} is Disabled.
      integer McuMainOscillatorFrequency: 4..40, origin=INFINEON_AURIX2G, set at pre-compile, default-value=20  # This parameter defines External crystal frequency value in MHz
      integer McuSysClkFrequency: 16..40, origin=INFINEON_AURIX2G, set at pre-compile, default-value=20  # This parameter defines Sysclk frequency value in MHz
      enumeration McuSystemModeCpuCore: {CPU_SYSTEM_CORE0_SEL0, CPU_SYSTEM_CORE1_SEL1, CPU_SYSTEM_CORE2_SEL2, CPU_SYSTEM_CORE3_SEL3, CPU_SYSTEM_CORE4_SEL4, CPU_SYSTEM_CORE5_SEL5, UNANIMOUS_SYSTEM_ALL_CORES_SEL6}, origin=INFINEON_AURIX2G, set at pre-compile, default-value=CPU_SYSTEM_CORE0_SEL0  # This parameter defines core responsible to trigger system modes (sleep / standby).
      enumeration McuIdleModeCpuCore: {INDIVIDUAL_IDLE_CORES_SEL0, CPU_IDLE_CORE0_SEL1, CPU_IDLE_CORE1_SEL2, CPU_IDLE_CORE2_SEL3, CPU_IDLE_CORE3_SEL4, CPU_IDLE_CORE4_SEL5, CPU_IDLE_CORE5_SEL6}, origin=INFINEON_AURIX2G, set at pre-compile, default-value=INDIVIDUAL_IDLE_CORES_SEL0  # This parameter defines core responsible to trigger idle mode.
      enumeration McuStandbyEntryMode: {STANDBY_ENTRY_REQ_SLEEP_SEL0, STANDBY_ENTRY_ESR_SEL4}, origin=INFINEON_AURIX2G, set at pre-compile, default-value=STANDBY_ENTRY_REQ_SLEEP_SEL0  # This parameter will define standby mode entry criteria. STANDBY_ENTRY_REQ_SLEEP_SEL0: Entry to standby domain is through PMSWCR1.STBYEV. STANDBY_ENTRY_ESR_SEL4: Entry to standby mode domain is through ESR1/NMI assertion.
      enumeration McuOscillatorMode: {EXT_CRYSTAL_CERAMIC_RES_MODE_SEL0, EXT_INPUT_CLOCK_MODE_SEL2, OSC_DISABLED_MODE_SEL3}, origin=INFINEON_AURIX2G, set at pre-compile, default-value=EXT_CRYSTAL_CERAMIC_RES_MODE_SEL0  # This parameter selects ocillator mode. EXT_CRYSTAL_CERAMIC_RES_MODE_SEL0: External Crystal or Ceramic resonator mode is selected. EXT_INPUT_CLOCK_MODE_SEL2: External input clock source mode is selected. OSC_DISABLED_MODE_SEL3: Oscillator is disabled.
      enumeration McuInitDeInitApiMode: {MCU_MCAL_SUPERVISOR, MCU_MCAL_USER1}, origin=INFINEON_AURIX2G, set at pre-compile, default-value=MCU_MCAL_SUPERVISOR  # This parameter selects the operating modes for MCU initialization, de-initialization APIs
      enumeration McuRuntimeApiMode: {MCU_MCAL_SUPERVISOR, MCU_MCAL_USER1}, origin=INFINEON_AURIX2G, set at pre-compile, default-value=MCU_MCAL_SUPERVISOR  # This parameter selects the operating modes for MCU runtime APIs
      reference McuEcucPartitionRef [0..*]: scope=ECU, multiplicity set at pre-compile, post-build-variant-multiplicity=true, post-build-variant-value=true, set at pre-compile, destination=EcucPartition  # Maps the MCU driver to zero or multiple ECUC partition to make the driver API available in this partition. Tags: atp.Status=draft
    container McuModuleConfiguration  # This container contains the configuration (parameters) of the MCU driver
      enumeration McuClockSrcFailureNotification: {DISABLED, ENABLED}, post-build-variant-value=true, set at post-build, default-value=DISABLED  # Enables/Disables clock failure notification. In case this feature is not supported by HW the setting should be disabled.This parameter doesn't have any influence on the generated code file
      integer McuNumberOfMcuModes: 1..255, post-build-variant-value=true, set at post-build, derivation=informal-formula=verbatim=l-5=Number of configured McuModeSettingConf, default-value=1  # This parameter shall represent the number of Modes available for the MCU. This parameter is disabled and is included here for completeness. calculation Formula = Number of configured McuModeSettingConf. Press the Calculate button beside the parameter to automatically update the field. This parameter doesn't have any influence on the generated code file
      integer McuRamSectors: 0..4294967295, post-build-variant-value=true, set at post-build, derivation=informal-formula=verbatim=l-5=number of configured McuRamSectorSettingConf, default-value=0  # This parameter shall represent the number of RAM sectors configured for initialization for the MCU. This parameter is disabled and is included here for completeness. calculation Formula = Number of configured McuRamSectorSettingConf. Press the Calculate button beside the parameter to automatically update the field. This parameter doesn't have any influence on the generated code file
      integer McuResetSetting [0..1]: 1..255, multiplicity set at pre-compile, set at pre-compile, default-value=1  # This parameter relates to the MCU specific reset configuration. This applies to the function Mcu_PerformReset, which performs a microcontroller reset using the hardware feature of the microcontroller. This parameter is disabled and is included here for completeness.
      container McuResetSettingConf  # This container contains the configuration (parameters) of the reset settings
        enumeration McuESR0ResetConf: {MCU_ESR0_NO_RESET_SEL0, MCU_ESR0_SYSTEM_RESET_SEL1, MCU_ESR0_APPLICATION_RESET_SEL2}, origin=INFINEON_AURIX2G, post-build-variant-value=true, set at post-build, default-value=MCU_ESR0_NO_RESET_SEL0  # This parameter defines the response of ESR0 reset request. MCU_ESR0_NO_RESET_SEL0 : No reset request is triggered. MCU_ESR0_SYSTEM_RESET_SEL1 : System reset is triggered. MCU_ESR0_APPLICATION_RESET_SEL2: Application reset request is triggered.
        enumeration McuESR1ResetConf: {MCU_ESR1_NO_RESET_SEL0, MCU_ESR1_SYSTEM_RESET_SEL1, MCU_ESR1_APPLICATION_RESET_SEL2}, origin=INFINEON_AURIX2G, post-build-variant-value=true, set at post-build, default-value=MCU_ESR1_NO_RESET_SEL0  # This parameter defines the response of ESR1 reset request. MCU_ESR1_NO_RESET_SEL0 : No reset request is triggered. MCU_ESR1_SYSTEM_RESET_SEL1 : System reset request is triggered. MCU_ESR1_APPLICATION_RESET_SEL2: Application reset request is triggered.
        enumeration McuSWResetConf: {MCU_SW_NO_RESET_SEL0, MCU_SW_SYSTEM_RESET_SEL1, MCU_SW_APPLICATION_RESET_SEL2}, origin=INFINEON_AURIX2G, post-build-variant-value=true, set at post-build, default-value=MCU_SW_NO_RESET_SEL0  # This parameter defines the response of SW reset request. MCU_SW_NO_RESET_SEL0 : No reset request is triggered. MCU_SW_SYSTEM_RESET_SEL1 : System reset request is triggered. MCU_SW_APPLICATION_RESET_SEL2: Application reset request is triggered.
        enumeration McuSMUResetConf: {MCU_SMU_NO_RESET_SEL0, MCU_SMU_SYSTEM_RESET_SEL1, MCU_SMU_APPLICATION_RESET_SEL2}, origin=INFINEON_AURIX2G, post-build-variant-value=true, set at post-build, default-value=MCU_SMU_NO_RESET_SEL0  # This parameter defines the response of SMU reset request. MCU_SMU_NO_RESET_SEL0 : No reset request is triggered. MCU_SMU_SYSTEM_RESET_SEL1 : System reset request is triggered. MCU_SMU_APPLICATION_RESET_SEL2: Application reset request is triggered.
        enumeration McuSTM0ResetConf: {MCU_STM0_NO_RESET_SEL0, MCU_STM0_SYSTEM_RESET_SEL1, MCU_STM0_APPLICATION_RESET_SEL2}, origin=INFINEON_AURIX2G, post-build-variant-value=true, set at post-build, default-value=MCU_STM0_NO_RESET_SEL0  # This parameter defines the response of STM0 reset request. MCU_STM0_NO_RESET_SEL0 : No reset request is triggered. MCU_STM0_SYSTEM_RESET_SEL1 : System reset request is triggered. MCU_STM0_APPLICATION_RESET_SEL2: Application reset request is triggered.
        enumeration McuSTM{1..5}ResetConf: {MCU_STM{1..5}_NO_RESET_SEL0, MCU_STM{1..5}_SYSTEM_RESET_SEL1, MCU_STM{1..5}_APPLICATION_RESET_SEL2}, origin=INFINEON_AURIX2G, post-build-variant-value=true, set at post-build, default-value=MCU_STM{1..5}_NO_RESET_SEL0  # This parameter defines the response of STM{1..5} reset request. MCU_STM{1..5}_NO_RESET_SEL0 : No reset request is triggered. MCU_STM{1..5}_SYSTEM_RESET_SEL1 : System reset request is triggered. MCU_STM{1..5}_APPLICATION_RESET_SEL2: Application reset request is triggered. The parameter will be disabled if STM{1..5} timer doesn't exist on the HW.
        boolean McuSTM0ResetOnApplResetEnable: origin=INFINEON_AURIX2G, post-build-variant-value=true, set at post-build, default-value=true  # This parameter specifies enabling of STM0 timer reset on occurance of application reset. TRUE : STM0 timer is reset on application reset request. FALSE: STM0 timer is not reset on application reset request.
        boolean McuSTM1ResetOnApplResetEnable: origin=INFINEON_AURIX2G, post-build-variant-value=true, set at post-build, default-value=true  # This parameter specifies enabling of STM1 timer reset on occurance of application reset. TRUE : STM1 timer is reset on application reset request. FALSE: STM1 timer is not reset on application reset request. The parameter will be disabled if STM2 timer doesn't exist on the HW.
        boolean McuSTM{2..5}ResetOnApplResetEnable: origin=INFINEON_AURIX2G, post-build-variant-value=true, set at post-build, default-value=true  # This parameter specifies enabling of STM{2..5} timer reset on occurance of application reset. TRUE : STM{2..5} timer is reset on application reset request. FALSE: STM{2..5} timer is not reset on application reset request. The parameter will be disabled if STM{2..5} timer doesn't exist on the HW.
      container McuTrapSettingConf  # This container defines the configuration (parameters) of the trap settings
        boolean McuCPU0ESR0TrapEnable: origin=INFINEON_AURIX2G, post-build-variant-value=true, set at post-build, default-value=false  # This parameter specifies if ESR0 trap can be generated by CPU0. TRUE : ESR0 trap request can be generated. FALSE: ESR0 trap request can not be generated.
        boolean McuCPU{1..5}ESR0TrapEnable: origin=INFINEON_AURIX2G, post-build-variant-value=true, set at post-build, default-value=false  # This parameter specifies if ESR0 trap can be generated by CPU{1..5}. TRUE : ESR0 trap request can be generated. FALSE: ESR0 trap request can not be generated. The parameter will be disabled if CPU{1..5} doesn't exist on the HW.
        boolean McuCPU0ESR1TrapEnable: origin=INFINEON_AURIX2G, post-build-variant-value=true, set at post-build, default-value=false  # This parameter specifies if ESR1 trap can be generated by CPU0. TRUE : ESR1 trap request can be generated. FALSE: ESR1 trap request can not be generated.
        boolean McuCPU{1..5}ESR1TrapEnable: origin=INFINEON_AURIX2G, post-build-variant-value=true, set at post-build, default-value=false  # This parameter specifies if ESR1 trap can be generated by CPU{1..5}. TRUE : ESR1 trap request can be generated. FALSE: ESR1 trap request can not be generated. The parameter will be disabled if CPU{1..5} doesn't exist on the HW.
        boolean McuCPU0Trap2Enable: origin=INFINEON_AURIX2G, post-build-variant-value=true, set at post-build, default-value=false  # This parameter specifies if Trap2 trap can be generated by CPU0. TRUE : Trap2 trap request can be generated. FALSE: Trap2 trap request can not be generated.
        boolean McuCPU{1..5}Trap2Enable: origin=INFINEON_AURIX2G, post-build-variant-value=true, set at post-build, default-value=false  # This parameter specifies if Trap2 trap can be generated by CPU{1..5}. TRUE : Trap2 trap request can be generated. FALSE: Trap2 trap request can not be generated. The parameter will be disabled if CPU{1..5} doesn't exist on the HW.
        boolean McuCPU0SMUTrapEnable: origin=INFINEON_AURIX2G, post-build-variant-value=true, set at post-build, default-value=false  # This parameter specifies if SMU trap can be generated by CPU0. TRUE : SMU trap request can be generated. FALSE: SMU trap request can not be generated.
        boolean McuCPU{1..5}SMUTrapEnable: origin=INFINEON_AURIX2G, post-build-variant-value=true, set at post-build, default-value=false  # This parameter specifies if SMU trap can be generated by CPU{1..5}. TRUE : SMU trap request can be generated. FALSE: SMU trap request can not be generated. The parameter will be disabled if CPU{1..5} doesn't exist on the HW.
      container McuEruGlobalConf  # This container contains the configuration (parameters) for Global ERU settings.
        integer McuEruInputFilterRegVal: 0..4278321151, origin=INFINEON_AURIX2G, post-build-variant-value=true, set at post-build, default-value=0  # This configuration parameter enables/disables the glitch filter and also the Glitch filter pre-divider and filters depth. (Register EIFILT). In case 0 is passed for bitfields which are reserved according to the TS, the value will be masked out.
      container McuClockSettingConfig [1..256]: multiplicity set at pre-compile  # This container defines the configuration (parameters) for the MCU Clock settings.
        integer McuClockSettingId: 0..255, set at pre-compile, symbolic-name-value=true, default-value=0  # The Id of this McuClockSettingConfig to be used as argument for the API call Mcu_InitClock.
        container McuClockReferencePointConfig  # This container has sub-container for the configuration of Mcu Clock tree.
          container McuSystemPllSettingConfig  # This container contains the configuration (parameters) for the System clock settings.
            enumeration McuPllInputSrcSelection: {BACKUP_CLOCK_SRC_SELECT_SEL0, OSC_CLOCK_SRC_SELECT_SEL1, SYSCLK_SRC_SELECT_SEL2}, origin=INFINEON_AURIX2G, post-build-variant-value=true, set at post-build, default-value=OSC_CLOCK_SRC_SELECT_SEL1  # This parameter will define PLL input source. BACKUP_CLOCK_SRC_SELECT_SEL0: Backup clock selected for oscillator watchdog clock source. OSC_CLOCK_SRC_SELECT_SEL1: Oscillator clock selected for oscillator watchdog clock source. SYSCLK_SRC_SELECT_SEL2: SYSCLK pin is selected as an input source for the system and peripheral PLLs
            integer McuSystemPllPDivider: 0..7, origin=INFINEON_AURIX2G, post-build-variant-value=true, set at post-build, default-value=0  # The parameter defines P divider value for System PLL.
            integer McuSystemPllNDivider: 0..127, origin=INFINEON_AURIX2G, post-build-variant-value=true, set at post-build, default-value=29  # The parameter defines N divider value for System PLL.
            integer McuSystemPllK2Divider: 0..7, origin=INFINEON_AURIX2G, post-build-variant-value=true, set at post-build, default-value=1  # The parameter defines K2 divider value for System PLL.
            integer McuSysPllK2DivStepUpChangeDelay: 5..100, origin=INFINEON_AURIX2G, post-build-variant-value=true, set at post-build, default-value=10  # McuSysPllK2DivStepUpChangeDelay : This paramter configures the delay in micro-seconds for ramping up/down K2 div increment to reach configured system PLL frequency
            integer McuSysPllK2DivStepDownChangeDelay: 5..100, origin=INFINEON_AURIX2G, post-build-variant-value=true, set at post-build, default-value=10  # McuSysPllK2DivStepDownChangeDelay : This paramter configures the delay in micro-seconds for ramping up/down K2 div decrement to reach configured system PLL frequency
            boolean McuFmPllEnable: origin=INFINEON_AURIX2G, post-build-variant-value=true, set at post-build, default-value=false  # This parameter specifies if Frequency Modulation for system PLL is enabled. TRUE : Frequency modulation for system PLL is enabled. FALSE: Frequency modulation for system PLL is disabled.
            float McuFMPllModAmp: 0.0..2.0, origin=INFINEON_AURIX2G, post-build-variant-value=true, set at post-build, default-value=1.25  # McuFMPllModAmp : It is the value for Modulation Amplitude for system PLL Frequency modulation.For any desired Modulation Amplitude, the corresponding bitfield MODCFG[9:0] of SCU_PLLCON2 can be calculated considering oscillator frequency McuMainOscillatorFrequency, McuPllPDivider and McuPllNDivider, according to this equation:MODCFG[9:0] = (64 * McuFMPllModAmp/100 * McuMainOscillatorFrequency/McuPllPDivider * McuPllNDivider/3.6) ; units: McuFMPllModAmp [%] , McuMainOscillatorFrequency [MHz].
            float McuClockReferencePointFrequency0: 2.0E7..3.0E8, scope=ECU, origin=INFINEON_AURIX2G, post-build-variant-value=true, set at post-build, default-value=3.0E8  # This is the System PLL frequency for the specific instance of the McuClockReferencePointConfig container. The unit is Hz. Its value is calculated based on Oscillator frequency and P, N and K2 divider configuration Calculation Formula: Fpll =( (Fosc * (McuNDivider + 1)) / ((McuK2Divider+1)*(McuPDivider+1))) The McuClockReferencePointFrequency for NORMAL_MODE should be in range: 20 - 300 MHz If McuClockDistributionInpClockSel is selected as BACKUP_INPUT_CLOCK_SRC_SELECT, then manually configure this clock to Fback = 100MHz.
          container McuPeripheralPllSettingConfig  # This container contains the configuration (parameters) for the Peripheral clock settings.
            integer McuPeripheralPllPDivider: 0..7, origin=INFINEON_AURIX2G, post-build-variant-value=true, set at post-build, default-value=0  # The parameter defines P divider value for peripheral PLL.
            integer McuPeripheralPllNDivider: 0..127, origin=INFINEON_AURIX2G, post-build-variant-value=true, set at post-build, default-value=31  # The parameter defines N divider value for peripheral PLL.
            integer McuPeripheralPllK2Divider: 0..7, origin=INFINEON_AURIX2G, post-build-variant-value=true, set at post-build, default-value=1  # The parameter defines K2 divider value for peripheral PLL.
            integer McuPerPllK2DivStepUpChangeDelay: 5..100, origin=INFINEON_AURIX2G, post-build-variant-value=true, set at post-build, default-value=10  # McuPerPllK2DivStepChangeDelay : This paramter configures the delay in micro-seconds for ramping up/down K2 div to reach configured peripheral PLL frequency
            integer McuPerPllK2DivStepDownChangeDelay: 5..100, origin=INFINEON_AURIX2G, post-build-variant-value=true, set at post-build, default-value=10  # McuPerPllK2DivStepChangeDelay : This paramter configures the delay in micro-seconds for ramping up/down K2 div to reach configured peripheral PLL frequency
            integer McuPeripheralPllK3Divider: 0..7, origin=INFINEON_AURIX2G, post-build-variant-value=true, set at post-build, default-value=1  # The parameter defines K3 divider value for peripheral PLL.
            integer McuPerPllK3DivStepUpChangeDelay: 5..100, origin=INFINEON_AURIX2G, post-build-variant-value=true, set at post-build, default-value=10  # McuPerPllK3DivStepChangeDelay : This paramter configures the delay in micro-seconds for ramping up/down K3 div to reach configured peripheral PLL frequency
            integer McuPerPllK3DivStepDownChangeDelay: 5..100, origin=INFINEON_AURIX2G, post-build-variant-value=true, set at post-build, default-value=10  # McuPerPllK3DivStepChangeDelay : This paramter configures the delay in micro-seconds for ramping up/down K3 div to reach configured peripheral PLL frequency
            enumeration McuFreqSource1ClockDivSelect: {DIV_FACTOR_2_NOT_BYPASSED_SEL0, DIV_FACTOR_2_BYPASSED_SEL1}, origin=INFINEON_AURIX2G, post-build-variant-value=true, set at post-build, default-value=DIV_FACTOR_2_NOT_BYPASSED_SEL0  # This parameter defines the peripheral clock divider selection. DIV_FACTOR_2_NOT_BYPASSED_SEL0: Divider factor of two is not bypassed. (Fpll1/2 = Fsource1 ). DIV_FACTOR_2_BYPASSED_SEL1: Divider factor of two is bypassed. (Fpll1 = Fsource1).
            enumeration McuPll2DivSelect: {MCU_K3_DIV_FACTOR_NOT_BYPASSED_SEL0, MCU_K3_DIV_FACTOR_BYPASSED_SEL1}, origin=INFINEON_AURIX2G, post-build-variant-value=true, set at post-build, default-value=MCU_K3_DIV_FACTOR_NOT_BYPASSED_SEL0  # This parameter will define peripheral clock divider selection. MCU_K3_DIV_FACTOR_NOT_BYPASSED_SEL0: Divider factor for K3 is not bypassed. MCU_K3_DIV_FACTOR_BYPASSED_SEL1: Divider factor for K3 is bypassed.
            float McuClockReferencePointFrequency1: 2.0E7..3.2E8, scope=ECU, origin=INFINEON_AURIX2G, post-build-variant-value=true, set at post-build, default-value=1.6E8  # This is the peripheral PLL frequency for the specific instance of the McuClockReferencePointConfig container. It shall be given in Hz. Its value is given by Fpll =( (Fosc * (McuNDivider + 1)) / ((McuK2Divider+1)*(McuPDivider+1))). McuClockReferencePointFrequency1 = Fpll if McuFreqSource1ClockDivSelect = DIV_FACTOR_2_BYPASSED_SEL1 McuClockReferencePointFrequency1 = Fpll / 2 if McuFreqSource1ClockDivSelect = DIV_FACTOR_2_NOT_BYPASSED_SEL0 The McuClockReferencePointFrequency for NORMAL_MODE should be in range: 20 - 320 MHz If McuClockDistributionInpClockSel is selected as BACKUP_INPUT_CLOCK_SRC_SELECT, then manually configure the clock to 100 MHz.
            float McuClockReferencePointFrequency2: 2.0E7..2.0E8, origin=INFINEON_AURIX2G, post-build-variant-value=true, set at post-build, default-value=2.0E8  # This is the peripheral PLL frequency for the specific instance of the McuClockReferencePointConfig container. It shall be given in Hz. Its value is given by Fpll =( (Fosc * (McuNDivider + 1)) / (1.6 * (McuK3Divider+1)*(McuPDivider+1))) if McuPll2DivSelect = MCU_K3_DIV_FACTOR_NOT_BYPASSED_SEL0 or Fpll =( (Fosc * (McuNDivider + 1)) / (1 * (McuK3Divider+1)*(McuPDivider+1))) if McuPll2DivSelect = MCU_K3_DIV_FACTOR_BYPASSED_SEL1 The McuClockReferencePointFrequency for NORMAL_MODE should be in range: 20 - 200 MHz If McuClockDistributionInpClockSel is selected as BACKUP_INPUT_CLOCK_SRC_SELECT, then manually configure this clock to Fback = 100MHz.
          container McuPllDistributionSettingConfig  # This container contains the configuration (parameters) for PLL Distribution and frequencies to various HW modules within clock tree.
            enumeration McuClockDistributionInpClockSel: {BACKUP_INPUT_CLOCK_SRC_SELECT_SEL0, PLL_INPUT_CLOCK_SRC_SELECT_SEL1}, origin=INFINEON_AURIX2G, post-build-variant-value=true, set at post-build, default-value=PLL_INPUT_CLOCK_SRC_SELECT_SEL1  # This parameter defines clock source selection for clock distribution unit. BACKUP_INPUT_CLOCK_SRC_SELECT_SEL0: Backup clock is selected as an input to the clock distribution unit. PLL_INPUT_CLOCK_SRC_SELECT_SEL1: PLLx(x=0, 1, 2) is selected as an input clock to the clock distribution unit.
            enumeration McuLowPowerDivValue: {LOW_POWER_DIVIDER_DISABLE_SEL0, LOW_POWER_DIVIDE_BY_30_SEL1, LOW_POWER_DIVIDE_BY_60_SEL2, LOW_POWER_DIVIDE_BY_120_SEL3, LOW_POWER_DIVIDE_BY_240_SEL4}, origin=INFINEON_AURIX2G, post-build-variant-value=true, set at post-build, default-value=LOW_POWER_DIVIDER_DISABLE_SEL0  # This parameter defines whether low power divider feature is enabled or disabled. LOW_POWER_DIVIDER_DISABLE_SEL0: Low power mode is disabled. LOW_POWER_DIVIDE_BY_30_SEL1: Low power mode clock divider is set to 30. LOW_POWER_DIVIDE_BY_60_SEL2: Low power mode clock divider is set to 60. LOW_POWER_DIVIDE_BY_120_SEL3: Low power mode clock divider is set to 120. LOW_POWER_DIVIDE_BY_240_SEL4: Low power mode clock divider is set to 240.
            float McuSRIFrequency: 1.0..3.0E8, scope=ECU, origin=INFINEON_AURIX2G, post-build-variant-value=true, set at post-build, default-value=3.0E8  # This parameter defines the SRI frequency. SRI should always be in proportionate to McuClockReferencePointFrequency0. The unit is Hz.
            float McuCPU0Frequency: 1.0..3.0E8, scope=ECU, origin=INFINEON_AURIX2G, post-build-variant-value=true, set at post-build, default-value=3.0E8  # This parameter defines the CPU0 frequency. The unit is Hz. McuCPU0Frequency configuration requires adherence to the following formula. McuCPU0Frequency = McuSRIFrequency * (64 - CPU0DIV) / 64.
            float McuCPU{1..5}Frequency: 1.0..3.0E8, scope=ECU, origin=INFINEON_AURIX2G, post-build-variant-value=true, set at post-build, default-value=3.0E8  # This parameter defines the CPU{1..5} frequency. The unit is Hz. McuCPU{1..5}Frequency configuration requires adherence to the following formula. McuCPU{1..5}Frequency = McuSRIFrequency * (64 - CPU{1..5}DIV) / 64. The parameter will be disabled if CPU{1..5} doesn't exist on the HW.
            float McuSPBFrequency: 1.0..1.0E8, scope=ECU, origin=INFINEON_AURIX2G, post-build-variant-value=true, set at post-build, default-value=1.0E8  # This parameter defines the SPB frequency. SPB should always be in proportionate to McuClockReferencePointFrequency0. The unit is Hz.
            float McuFSIFrequency: 2.0E7..1.0E8, scope=ECU, origin=INFINEON_AURIX2G, post-build-variant-value=true, set at post-build, default-value=1.0E8  # This parameter specifies the intended target FSI frequency. The unit is Hz. FSI can be same as SRI. If FSI is intended to be half of SRI then SRIDIV must be either 1 or 2. If FSI is intended to be one third of SRI then SRIDIV must be either 1 or 2 default : 100MHz (Max FSI clock value wrt fSRI @ 300Mhz.)
            float McuFSI2Frequency: 1.0..3.0E8, scope=ECU, origin=INFINEON_AURIX2G, post-build-variant-value=true, set at post-build, default-value=3.0E8  # This parameter specifies the intended target FSI2 frequency. The unit is Hz. FSI2 can be same as SRI. If FSI2 is intended to be half of SRI then SRIDIV must be either 1 or 2. If FSI2 is intended to be one third of SRI then SRIDIV must be either 1 or 2 default : 300MHz (Max FSI clock value wrt fSRI @ 300Mhz.)
            float McuReferenceFrequency1: 0.0..1.0E8, scope=ECU, origin=INFINEON_AURIX2G, post-build-variant-value=true, set at post-build, default-value=1.25E7  # This parameter specifies the intended reference frequency 1 for MCDS. McuReferenceFrequency1 = McuClockReferencePointFrequency0 / 24. The unit is Hz.
            float McuReferenceFrequency2: 0.0..1.0E8, origin=INFINEON_AURIX2G, post-build-variant-value=true, set at post-build, default-value=6666667.0  # This parameter specifies the intended reference frequency 2 for MCDS. McuReferenceFrequency2 = McuClockReferencePointFrequency1 / 24. The unit is Hz.
            float McuBBBFrequency: 0.0..1.5E8, scope=ECU, origin=INFINEON_AURIX2G, post-build-variant-value=true, set at post-build, default-value=1.5E8  # This parameter specifies Back Bone Bus frequency. BBB frequency output can be stopped by configuring 0 to this configuration parameter. The unit is Hz.
            boolean McuErayClkEnable: origin=INFINEON_AURIX2G, post-build-variant-value=true, set at post-build, default-value=false  # This parameter specifies if frequencies provided for ERAY module, fERAY is enabled or not TRUE : fERAY is enabled. FALSE: fERAY is disabled. The parameter will be disabled if FlexRay IP doesn't exist on the HW.
            float McuErayFrequency: 0.0..8.0E7, scope=ECU, origin=INFINEON_AURIX2G, post-build-variant-value=true, set at post-build, default-value=8.0E7  # This parameter specifies Eray frequency. Resultant Eray frequency is always peripheral PLL frequency (McuClockReferencePointFrequency1) divided by fixed divider 2. Eray frequency has to be disabled when distribution source is selected as Back Up Frequency. The unit is Hz.
            float McuGTMFrequency: 0.0..2.0E8, scope=ECU, origin=INFINEON_AURIX2G, post-build-variant-value=true, set at post-build, default-value=2.0E8  # This parameter specifies GTM peripheral frequency. The unit is Hz. If GTM peripheral frequency to be disabled, value 0 has to be configured to this configuration parameter. GTM frequency, if enabled, is derived by dividing the FSourceGTM frequency by one of the following factors. 1, 2, 3, 4, 5, 6, 8, 10, 12, 15. FSourceGTM is derived by following formula. if GTMDIV = 1 ; then FSourceGTM = McuSPBFrequency * 2, otherwise FSourceGTM = McuClockReferencePointFrequency0 Hence, GTM has to be configured either equal to = McuSPBFrequency * 2 or fraction of McuClockReferencePointFrequency0. (Valid fraction values are 2, 3, 4, 5, 6, 8, 10, 12 and 15.) The parameter will be disabled if GTM IP doesn't exist on the HW.
            float McuSTMFrequency: 0.0..1.0E8, origin=INFINEON_AURIX2G, post-build-variant-value=true, set at post-build, default-value=1.0E8  # This parameter specifies STM peripheral frequency. The unit is Hz. If STM peripheral frequency to be disabled, value 0 has to be configured to this configuration parameter. STM frequency, if enabled, has to be divisible by McuClockReferencePointFrequency0 with one of the following dividers. 1, 2, 3, 4, 5, 6, 8, 10, 12 and 15. STM frequency can be slower or faster or equal to SPB frequency.
            enumeration McuMscClockSourceSelection: {MSC_CLOCK_SOURCE_DISABLED_SEL0, MSC_CLOCK_SOURCE_SOURCE1_SEL1, MSC_CLOCK_SOURCE_SOURCE2_SEL2}, scope=ECU, origin=INFINEON_AURIX2G, post-build-variant-value=true, set at post-build, default-value=MSC_CLOCK_SOURCE_DISABLED_SEL0  # This parameter will define the input clock source for MSC peripheral. MSC_CLOCK_SOURCE_DISABLED_SEL0: MSC peripheral frequency is disabled. MSC_CLOCK_SOURCE_SOURCE1_SEL1: McuClockReferencePointFrequency1 is used as input clock source for MSC dividers. MSC_CLOCK_SOURCE_SOURCE2_SEL2: McuClockReferencePointFrequency2 is used as input clock source for MSC dividers.
            float McuMscFrequency: 0.0..2.0E8, scope=ECU, origin=INFINEON_AURIX2G, post-build-variant-value=true, set at post-build, default-value=2.0E8  # This parameter specifies MSC peripheral frequency. The unit is Hz. This parameter is applicable only if McuMscClockSourceSelection is not MSC_CLOCK_SOURCE_DISABLED. Target frequency to be configured should be perfectly divisible by one of the following dividers 1, 2, 3, 4, 5, 6, 8, 10, 12 and 15.
            enumeration McuMCanClockSourceSelection: {MCAN_CLOCK_SOURCE_DISABLED_SEL0, MCAN_CLOCK_SOURCE_MCANI_SEL1, MCAN_CLOCK_SOURCE_OSC_SEL2}, scope=ECU, origin=INFINEON_AURIX2G, post-build-variant-value=true, set at post-build, default-value=MCAN_CLOCK_SOURCE_DISABLED_SEL0  # This parameter will define the input clock source for MCAN peripheral. MCAN_CLOCK_SOURCE_DISABLED_SEL0: MCAN peripheral frequency is disabled. MCAN_CLOCK_SOURCE_MCANI_SEL1: fMCANI frequency is used as input clock source for MCAN peripheral. MCAN_CLOCK_SOURCE_OSC_SEL2: Main oscillator frequency is used as input clock source for MCAN peripheral.
            float McuMCanFrequency: 0.0..8.0E7, scope=ECU, origin=INFINEON_AURIX2G, post-build-variant-value=true, set at post-build, default-value=8.0E7  # This parameter specifies MSC peripheral frequency. The unit is Hz. This parameter is applicable only if McuMCANClockSourceSelection is not MCAN_CLOCK_SOURCE_DISABLED_SEL0. Target frequency to be configured should be perfectly divisible by one of the following dividers 1, 2, 3, 4, 5, 6, 8, 10, 12 and 15
            float McuAscLinFastFrequency: 0.0..2.0E8, scope=ECU, origin=INFINEON_AURIX2G, post-build-variant-value=true, set at post-build, default-value=2.0E8  # This parameter specifies ASCLIN peripheral frequency. The unit is Hz. If ASCLIN peripheral frequency for fast mode to be disabled, value 0 has to be configured to this configuration parameter. If not disabled, intended target frequency to be configured should be McuClockReferencePointFrequency2 perfectly divisible by one of the following dividers 1, 2, 3, 4, 5, 6, 8, 10, 12 and 15
            enumeration McuAscLinSlowClockSourceSelection: {ASCLINS_CLOCK_SOURCE_DISABLED_SEL0, ASCLINS_CLOCK_SOURCE_ASCLINSI_SEL1, ASCLINS_CLOCK_SOURCE_OSC0_SEL2}, scope=ECU, origin=INFINEON_AURIX2G, post-build-variant-value=true, set at post-build, default-value=ASCLINS_CLOCK_SOURCE_DISABLED_SEL0  # This parameter specifies the input clock source for ASCLIN peripheral slow frequency. ASCLINS_CLOCK_SOURCE_DISABLED_SEL0: AscLin clock source is disabled. ASCLINS_CLOCK_SOURCE_ASCLINSI_SEL1: McuAscLinSlowFrequency is used as input clock source for ASCLIN dividers. ASCLINS_CLOCK_SOURCE_OSC0_SEL2: McuMainOscillatorFrequency is used as input clock source for ASCLIN dividers.
            float McuAscLinSlowFrequency: 0.0..2.0E8, origin=INFINEON_AURIX2G, post-build-variant-value=true, set at post-build, default-value=8.0E7  # This parameter specifies ASCLIN peripheral slow frequency. The unit is Hz. If ASCLIN peripheral frequency for fast mode to be disabled, value 0 has to be configured to this configuration parameter. If not disabled, intended target frequency to be configured should be McuClockReferencePointFrequency1 perfectly divisible by one of the following dividers 1, 2, 3, 4, 5, 6, 8, 10, 12 and 15
            enumeration McuQspiClockSourceSelection: {QSPI_CLOCK_SOURCE_DISABLED_SEL0, QSPI_CLOCK_SOURCE_SOURCE1_SEL1, QSPI_CLOCK_SOURCE_SOURCE2_SEL2}, scope=ECU, origin=INFINEON_AURIX2G, post-build-variant-value=true, set at post-build, default-value=QSPI_CLOCK_SOURCE_DISABLED_SEL0  # This parameter will define the input clock source for QSPI peripheral. QSPI_CLOCK_SOURCE_DISABLED_SEL0: AscLin clock source is disabled. QSPI_CLOCK_SOURCE_SOURCE1_SEL1: McuClockReferencePointFrequency1 is used as input clock source for QSPI dividers. QSPI_CLOCK_SOURCE_SOURCE2_SEL2: McuClockReferencePointFrequency2 is used as input clock source for QSPI dividers.
            float McuQspiFrequency: 0.0..2.0E8, origin=INFINEON_AURIX2G, post-build-variant-value=true, set at post-build, default-value=2.0E8  # This parameter specifies QSPI peripheral frequency. The unit is Hz. Target frequency to be configured should be perfectly divisible by one of the following dividers 1, 2, 3, 4, 5, 6, 8, 10, 12 and 15
            float McuAdcFrequency: 2.0E7..1.6E8, scope=ECU, origin=INFINEON_AURIX2G, post-build-variant-value=true, set at post-build, default-value=1.6E8  # This parameter specifies ADC peripheral frequency. The unit is Hz. This clock frequency is always equal to McuClockReferencePointFrequency1.
            enumeration McuConvCtrlPhaseSynchConf: {PHASE_SYNCH_CONST_ACTIVE_SEL0, PHASE_SYNCH_PER_FREQ_BY_2_SEL1, PHASE_SYNCH_PER_FREQ_BY_3_SEL2, PHASE_SYNCH_PER_FREQ_BY_4_SEL3, PHASE_SYNCH_PER_FREQ_BY_5_SEL4, PHASE_SYNCH_PER_FREQ_BY_6_SEL5, PHASE_SYNCH_PER_FREQ_BY_7_SEL6, PHASE_SYNCH_PER_FREQ_BY_8_SEL7, PHASE_SYNCH_PER_FREQ_BY_9_SEL8, PHASE_SYNCH_PER_FREQ_BY_10_SEL9, PHASE_SYNCH_PER_FREQ_BY_11_SEL10, PHASE_SYNCH_PER_FREQ_BY_12_SEL11, PHASE_SYNCH_PER_FREQ_BY_13_SEL12, PHASE_SYNCH_PER_FREQ_BY_14_SEL13, PHASE_SYNCH_PER_FREQ_BY_15_SEL14, PHASE_SYNCH_PER_FREQ_BY_16_SEL15}, scope=ECU, origin=INFINEON_AURIX2G, post-build-variant-value=true, set at post-build, default-value=PHASE_SYNCH_CONST_ACTIVE_SEL0  # This parameter defines the phase shift frequency divider for converter control block. This parameter is included here as this is a common across ADC and DSADC module. PHASE_SYNCH_CONST_ACTIVE_SEL0: Constant phase signal is active. PHASE_SYNCH_PER_FREQ_BY_2_SEL1: Phase synchronization is generated at fPER by 2. PHASE_SYNCH_PER_FREQ_BY_3_SEL2: Phase synchronization is generated at fPER by 3. PHASE_SYNCH_PER_FREQ_BY_4_SEL3: Phase synchronization is generated at fPER by 4. PHASE_SYNCH_PER_FREQ_BY_5_SEL4: Phase synchronization is generated at fPER by 5. PHASE_SYNCH_PER_FREQ_BY_6_SEL5: Phase synchronization is generated at fPER by 6. PHASE_SYNCH_PER_FREQ_BY_7_SEL6: Phase synchronization is generated at fPER by 7. PHASE_SYNCH_PER_FREQ_BY_8_SEL7: Phase synchronization is generated at fPER by 8. PHASE_SYNCH_PER_FREQ_BY_9_SEL8: Phase synchronization is generated at fPER by 9. PHASE_SYNCH_PER_FREQ_BY_10_SEL9: Phase synchronization is generated at fPER by 10. PHASE_SYNCH_PER_FREQ_BY_11_SEL10: Phase synchronization is generated at fPER by 11. PHASE_SYNCH_PER_FREQ_BY_12_SEL11: Phase synchronization is generated at fPER by 12. PHASE_SYNCH_PER_FREQ_BY_13_SEL12: Phase synchronization is generated at fPER by 13. PHASE_SYNCH_PER_FREQ_BY_14_SEL13: Phase synchronization is generated at fPER by 14. PHASE_SYNCH_PER_FREQ_BY_15_SEL14: Phase synchronization is generated at fPER by 15. PHASE_SYNCH_PER_FREQ_BY_16_SEL15: Phase synchronization is generated at fPER by 16.
            float McuI2CFrequency: 0.0..1.0E8, scope=ECU, origin=INFINEON_AURIX2G, post-build-variant-value=true, set at post-build, default-value=6.6666667E7  # This parameter specifies I2C peripheral frequency. The unit is Hz. McuI2CFrequency has to be divisible by McuClockReferencePointFrequency2 with the divider values specified in HW TS specification.
            boolean McuEbuClkEnable: origin=INFINEON_AURIX2G, post-build-variant-value=true, set at post-build, default-value=false  # This parameter specifies if frequencies provided for EBU module, fEBU is enabled or not TRUE : fEBU is enabled. FALSE: fEBU is disabled. The parameter will be disabled if EBU interface doesn't exist on the HW.
            float McuEbuFrequency: 2.0E7..1.6E8, scope=ECU, origin=INFINEON_AURIX2G, post-build-variant-value=true, set at post-build, default-value=1.6E8  # This parameter specifies EBU peripheral frequency. The unit is Hz. This clock frequency is always same as McuClockReferencePointFrequency1.
            float McuHsctFrequency: 0.0..4.0E8, scope=ECU, origin=INFINEON_AURIX2G, post-build-variant-value=true, set at post-build, default-value=1.0E7  # This parameter specifies HSCT frequency. The unit is Hz. This clock frequency is always same Peripheral DCO frequency / 2.
            boolean McuHspdmClkEnable: origin=INFINEON_AURIX2G, post-build-variant-value=true, set at post-build, default-value=false  # This parameter specifies if frequencies provided for HSPDM module, fHSPDM160 and fHSPDM320 are enabled or not TRUE : fHSPDM160 and fHSPDM320 are enabled. FALSE: fHSPDM160 and fHSPDM320 are disabled. The parameter will be disabled if High Speed Pulse Density Modulator IP doesn't exist on the HW.
            float McuHspdm160Frequency: 2.0E7..1.6E8, scope=ECU, origin=INFINEON_AURIX2G, post-build-variant-value=true, set at post-build, default-value=1.6E8  # This parameter specifies HSPDM160 peripheral frequency. The unit is Hz. This clock frequency is always equal to McuClockReferencePointFrequency1.
            float McuHspdm320Frequency: 2.0E7..3.2E8, scope=ECU, origin=INFINEON_AURIX2G, post-build-variant-value=true, set at post-build, default-value=3.2E8  # This parameter specifies HSPDM320 peripheral frequency. The unit is Hz. This clock frequency is always equal to fPLL1 or fBACKUP(based on McuClockDistributionInpClockSel).
            float McuAdasFrequency: 0.0..3.0E8, scope=ECU, origin=INFINEON_AURIX2G, post-build-variant-value=true, set at post-build, default-value=0.0  # This parameter Specifies the ADAS peripheral frequency in Hz.The ratio between ADAS frequency and McuClockReferencePointFrequency0 should be within the range as specified in the target specification. In order to facilitate the clearing of SRAM support hardware registers, this frequency is also configurable for non-ADAS devices. However, the default value for such devices is kept to 0, which disables the ADAS clock.
            float McuGEthFrequency: 0.0..1.5E8, scope=ECU, origin=INFINEON_AURIX2G, post-build-variant-value=true, set at post-build, default-value=1.5E8  # This parameter specifies Gigabit Ethernet peripheral frequency. McuGEthFrequency has to be divisible by McuClockReferencePointFrequency0 with the divider values specified in HW TS specification. The unit is Hz.
            float McuMcanHFrequency: 0.0..1.0E8, scope=ECU, origin=INFINEON_AURIX2G, post-build-variant-value=true, set at post-build, default-value=1.0E8  # This parameter specifies MCANH peripheral frequency. McuMcanHFrequency has to be divisible by McuClockReferencePointFrequency0 with the divider values specified in HW TS specification. The unit is Hz.
          container McuExternalClockOutputConfig  # This container defines the configuration (parameters) for External clock out of the MCU.
            boolean McuExtClock0Enable: origin=INFINEON_AURIX2G, post-build-variant-value=true, set at post-build, default-value=false  # This parameter specifies if external clock output 0 is enabled/disabled. TRUE : EXTCLK0 signal is available on external pad. FALSE: EXTCLK0 signal is not available on external pad.
            enumeration McuExtClockOutSel0: {FOUT_EXT_CLOCK0_SEL0, PLL0_EXT_CLOCK0_SEL1, PLL1_EXT_CLOCK0_SEL2, OSC0_EXT_CLOCK0_SEL3, BACKUP_EXT_CLOCK0_SEL4, PLL2_EXT_CLOCK0_SEL5, BBB_EXT_CLOCK0_SEL6, SRI_EXT_CLOCK0_SEL8, SPB_EXT_CLOCK0_SEL9, FSI_EXT_CLOCK0_SEL10, STM_EXT_CLOCK0_SEL11, GTM_EXT_CLOCK0_SEL12, FSI2_EXT_CLOCK0_SEL14, ERAY_MT0_EXT_CLOCK0_SEL15}, origin=INFINEON_AURIX2G, post-build-variant-value=true, set at post-build, default-value=FOUT_EXT_CLOCK0_SEL0  # This parameter will define clock source for external clock output 0. This parameter is included here as this is a common across ADC and DSADC module. FOUT_EXT_CLOCK0_SEL0: FOUT clock is selected. PLL0_EXT_CLOCK0_SEL1: PLL0 clock is selected. PLL1_EXT_CLOCK0_SEL2: PLL1 clock is selected. OSC0_EXT_CLOCK0_SEL3: OSC0 clock is selected. BACKUP_EXT_CLOCK0_SEL4: BACKUP clock is selected. PLL2_EXT_CLOCK0_SEL5: PLL2 clock is selected. BBB_EXT_CLOCK0_SEL6: BBB clock is selected. SRI_EXT_CLOCK0_SEL8: SRI clock is selected. SPB_EXT_CLOCK0_SEL9: SPB clock is selected. FSI_EXT_CLOCK0_SEL10: FSI clock is selected. STM_EXT_CLOCK0_SEL11: STM clock is selected. GTM_EXT_CLOCK0_SEL12: GTM clock is selected. FSI2_EXT_CLOCK0_SEL14: FSI2 clock is selected. ERAY_MT0_EXT_CLOCK0_SEL15: ERAY_MT0 clock is selected. Note: ALT mode for corresponding port pin must be configured in port driver to observe the output at a port pin.
            boolean McuExtClock1Enable: origin=INFINEON_AURIX2G, post-build-variant-value=true, set at post-build, default-value=false  # This parameter specifies if external clock output 1 is enabled/disabled. TRUE : EXTCLK1 signal is available on external pad. FALSE: EXTCLK1 signal is not available on external pad.
            boolean McuExtClock1Inverted: origin=INFINEON_AURIX2G, post-build-variant-value=true, set at post-build, default-value=false  # This parameter specifies if external clock output 1 would be inverted or not. TRUE : output signal is inverted of the actual signal for external clock source1. FALSE: output signal is not inverted of the actual signal for external clock .
            enumeration McuExtClockOutSel1: {FOUT_EXT_CLOCK1_SEL0, PLL0_EXT_CLOCK1_SEL1, PLL1_EXT_CLOCK1_SEL2, EBU_EXT_CLOCK1_SEL3, BACKUP_EXT_CLOCK1_SEL4, MCAN_EXT_CLOCK1_SEL5, ADC_EXT_CLOCK1_SEL6, QSPI_EXT_CLOCK1_SEL7, SRI_EXT_CLOCK1_SEL8, SPB_EXT_CLOCK1_SEL9, I2C_EXT_CLOCK1_SEL10, MSC_EXT_CLOCK1_SEL11, ERAY_EXT_CLOCK1_SEL12, ASCLINF_EXT_CLOCK1_SEL13, ASCLINS_EXT_CLOCK1_SEL14}, origin=INFINEON_AURIX2G, post-build-variant-value=true, set at post-build, default-value=FOUT_EXT_CLOCK1_SEL0  # This parameter will define clock source for external clock output 1. This parameter is included here as this is a common across ADC and DSADC module. FOUT_EXT_CLOCK1_SEL0: FOUT clock is selected. PLL0_EXT_CLOCK1_SEL1: PLL0 clock is selected. PLL1_EXT_CLOCK1_SEL2: PLL1 clock is selected. EBU_EXT_CLOCK1_SEL3: EBU clock is selected. BACKUP_EXT_CLOCK1_SEL4: BACKUP clock is selected. MCAN_EXT_CLOCK1_SEL5: MCAN clock is selected. ADC_EXT_CLOCK1_SEL6: ADC clock is selected. QSPI_EXT_CLOCK1_SEL7: QSPI clock is selected. SRI_EXT_CLOCK1_SEL8: SRI clock is selected. SPB_EXT_CLOCK1_SEL9: SPB clock is selected. I2C_EXT_CLOCK1_SEL10: I2C clock is selected. MSC_EXT_CLOCK1_SEL11: MSC clock is selected. ERAY_EXT_CLOCK1_SEL12: ERAY clock is selected. ASCLINF_EXT_CLOCK1_SEL13: ASCLINF clock is selected. ASCLINS_EXT_CLOCK1_SEL14: ASCLINS clock is selected. Note: ALT mode for corresponding port pin must be configured in port driver to observe the output at a port pin.
            integer McuFoutClockDiv: 1..256, origin=INFINEON_AURIX2G, post-build-variant-value=true, set at post-build, default-value=1  # This parameter specifies reload value of the divider that generates fOUT out of fSPB (fOUT = fSPB/(McuExtClock1Div)). The divider itself is cleared each time bit EN1 is cleared. The value entered by user is decremented by 1 and programmed into EXTCON.DIV1
          container McuClockMonitorConfig  # This container defines the configuration for clock monitoring MCU.
            boolean McuPll{0..2}ClockMonEnable: origin=INFINEON_AURIX2G, post-build-variant-value=true, set at post-build, default-value=false  # This parameter specifies if PLL{0..2} monitoring is enabled/disabled. TRUE : PLL{0..2} monitoring is Enabled. FALSE: PLL{0..2} monitoring is Disabled.
            boolean McuSpbClockMonEnable: origin=INFINEON_AURIX2G, post-build-variant-value=true, set at post-build, default-value=false  # This parameter specifies if SPB clock monitoring is enabled/disabled. TRUE : SPB clock monitoring is Enabled. FALSE: SPB clock monitoring is Disabled.
            boolean McuBackupClockMonEnable: origin=INFINEON_AURIX2G, post-build-variant-value=true, set at post-build, default-value=false  # This parameter specifies if Backup clock monitoring is enabled/disabled. TRUE : Backup clock monitoring is Enabled. FALSE: Backup clock monitoring is Disabled.
            boolean McuBackupClockRangeMonEnable: origin=INFINEON_AURIX2G, post-build-variant-value=true, set at post-build, default-value=false  # This parameter specifies if Backup clock range monitoring is enabled/disabled. TRUE : Backup clock range monitoring is Enabled. FALSE: Backup clock range monitoring is Disabled.
        container McuClockReferencePoint [1..256]: multiplicity set at post-build, post-build-variant-multiplicity=true  # This container defines a reference point in the Mcu Clock tree. It defines the frequencies which then can be used by other modules as an input value. Lower multiplicity is 1, as even in the simplest case (only one frequency is used), there is one frequency to be defined.
          enumeration McuClockRefSelection: {MCU_USER_DEFINED_FREQUENCY, MCU_CPU0_FREQUENCY, MCU_CPU1_FREQUENCY, MCU_CPU2_FREQUENCY, MCU_CPU3_FREQUENCY, MCU_CPU4_FREQUENCY, MCU_CPU5_FREQUENCY, MCU_SOURCE0_FREQUENCY, MCU_SOURCE1_FREQUENCY, MCU_SOURCE2_FREQUENCY, MCU_FSI_FREQUENCY, MCU_SRI_FREQUENCY, MCU_FSI2_FREQUENCY, MCU_SPB_FREQUENCY, MCU_REF_FREQUENCY_1, MCU_REF_FREQUENCY_2, MCU_BBB_FREQUENCY, MCU_ASCLINFAST_FREQUENCY, MCU_ERAY_FREQUENCY, MCU_ADAS_FREQUENCY, MCU_MSC_FREQUENCY, MCU_GETH_FREQUENCY, MCU_STM_FREQUENCY, MCU_MCANH_FREQUENCY, MCU_MCAN_FREQUENCY, MCU_EBU_FREQUENCY, MCU_QSPI_FREQUENCY, MCU_HSPDM160_FREQUENCY, MCU_ADC_FREQUENCY, MCU_I2C_FREQUENCY, MCU_ASCLINSLOW_FREQUENCY, MCU_HSPDM320_FREQUENCY, MCU_GTM_FREQUENCY, MCU_HSCT_FREQUENCY}, origin=INFINEON_AURIX2G, post-build-variant-value=true, set at post-build, default-value=MCU_USER_DEFINED_FREQUENCY  # This parameter selects the source of clock reference, based on which McuClockReferencePointFrequency is populated with frequency. If user selected MCU_USER_DEFINED_FREQUENCY, the value has to be entered by the user in parameter McuClockReferencePointFrequency.
          float McuClockReferencePointFrequency: 0.0..3.2E8, scope=ECU, post-build-variant-value=true, set at post-build, default-value=0.0  # This is the frequency for the specific instance of the McuClockReferencePoint container. It shall be given in Hz.
      container McuDemEventParameterRefs [0..1]: multiplicity set at pre-compile  # Container for the references to DemEventParameter elements which shall be invoked using the API Mcal_Wrapper_Dem_SetEventStatus API in case the corresponding error occurs. The EventId is taken from the referenced DemEventParameter's DemEventId symbolic name. The standardized errors are provided in the container and can be extended by vendor specific error references.
        reference MCU_E_CLOCK_FAILURE [0..1]: multiplicity set at pre-compile, set at pre-compile, requires-symbolic-name-value=true, destination=DemEventParameter  # Reference to configured DEM event to report Clock source failure.
      container McuModeSettingConf [1..3]: multiplicity set at pre-compile  # This container contains the configuration (parameters) for the Mode setting of the MCU.
        integer McuMode: 0..2, set at pre-compile, symbolic-name-value=true, default-value=0  # The parameter represents the MCU Mode settings. 0 : IDLE mode is selected. 1 : SLEEP mode is selected. 2: STANDBY mode is selected.
        boolean McuEvrcLPMOnSleepReqEnable: origin=INFINEON_AURIX2G, post-build-variant-value=true, set at post-build, default-value=false  # This parameter enables EVRC low power mode in sleep mode. TRUE: Entering into Low power mode for EVRC on sleep mode request is enabled. FALSE: Entering into Low power mode for EVRC on sleep mode request is disabled.
        container McuStdbyModeSettingConf  # This container contains the configuration (parameters) for the MCU Standby Mode setting.
          boolean McuStdbyModePortTriStateEnable: origin=INFINEON_AURIX2G, post-build-variant-value=true, set at post-build, default-value=false  # This parameter specifies if pads is in tristate while in standby mode. TRUE: Tristate is enabled for port pins while in standby mode. FALSE: Tristate is disabled for port pins while in standby mode.
          boolean McuStdbyModeESR0TriStateEnable: origin=INFINEON_AURIX2G, post-build-variant-value=true, set at post-build, default-value=false  # This parameter specifies if ESR0 is in tristate while in standby mode. TRUE: Tristate is enabled for ESR0 while in standby mode. FALSE: Tristate is disabled for ESR0 while in standby mode.
          boolean McuStdbyModeWakeupFromPORST: origin=INFINEON_AURIX2G, post-build-variant-value=true, set at post-build, default-value=false  # This parameter specifies wakeup configramtion from PORST. TRUE: Wakeup from standby mode via PORST is enabled. FALSE: Wakeup from standby mode via PORST is disabled.
          boolean McuStdbyModePORSTFilterEnable: origin=INFINEON_AURIX2G, post-build-variant-value=true, set at post-build, default-value=false  # This parameter specifies if PORST digital filter is enabled or disabled. TRUE: PORST digital filter is enabled. FALSE: PORST digital filter is disabled.
          boolean McuStdbyModeWakeupFromEVR: origin=INFINEON_AURIX2G, post-build-variant-value=true, set at post-build, default-value=false  # This parameter specifies if wakeup from standby mode is enabled via EVR. TRUE: Wakeup from standby mode via EVR is enabled. FALSE: Wakeup from standby mode via EVR is disabled.
          boolean McuStdbyModeWakeupFromSCR: origin=INFINEON_AURIX2G, post-build-variant-value=true, set at post-build, default-value=false  # This parameter specifies if wakeup from standby mode via standby controller is enabled. TRUE: Wakeup from standby mode via standby controller is enabled. FALSE: Wakeup from standby mode via standby controller is disabled.
          enumeration McuStdbyModeClkSelection: {SCR_CLOCK_SEL0, SCR_CLOCK_SEL1}, origin=INFINEON_AURIX2G, post-build-variant-value=true, set at post-build, default-value=SCR_CLOCK_SEL0  # The parameter specifies the active oscillator clock during standby mode operation. This parameter is kept disabled as Standby controller is not in scope of the Mcu driver and responsibility lies on user to configure it. SCR_CLOCK_SEL0 : Selecting this option configures PMSWCR4.SCRCLKSEL to 0. 100 MHz clock is enabled or disabled based on request from SCR in standby mode. SCR_CLOCK_SEL1 : Selecting this option configures PMSWCR4.SCRCLKSEL to 1. 100 MHz clock is always available.
          enumeration McuStdbyModeBlankingFilterDelay: {DELAY_0_MS_SEL0, DELAY_2_5_MS_SEL1, DELAY_5_MS_SEL2, DELAY_10_MS_SEL3, DELAY_20_MS_SEL4, DELAY_40_MS_SEL5, DELAY_80_MS_SEL6, DELAY_160_MS_SEL7, DELAY_320_MS_SEL8, DELAY_640_MS_SEL9, DELAY_1280_MS_SEL10, DELAY_2560_MS_SEL11, DELAY_5120_MS_SEL12, DELAY_10240_MS_SEL13}, origin=INFINEON_AURIX2G, post-build-variant-value=true, set at post-build, default-value=DELAY_0_MS_SEL0  # The parameter specifies the delay for blanking filter. DELAY_0_MS_SEL0 : No delay. DELAY_2_5_MS_SEL1 : selected delay is 2.5 ms. DELAY_5_MS_SEL2 : selected delay is 5 ms. DELAY_10_MS_SEL3 : selected delay is 10 ms. DELAY_20_MS_SEL4 : selected delay is 20 ms. DELAY_40_MS_SEL5 : selected delay is 40 ms. DELAY_80_MS_SEL6 : selected delay is 80 ms. DELAY_160_MS_SEL7 : selected delay is 160 ms. DELAY_320_MS_SEL8 : selected delay is 320 ms. DELAY_640_MS_SEL9 : selected delay is 640 ms. DELAY_1280_MS_SEL10 : selected delay is 1280 ms. DELAY_2560_MS_SEL11 : selected delay is 2560 ms. DELAY_5120_MS_SEL12 : selected delay is 5120 ms. DELAY_10240_MS_SEL13 : selected delay is 10240 ms. This can be set only when McuStdbyModeWakeupFromEVR = true.
          enumeration McuStdbyModeRamEnable: {MCU_STANDBYRAM_DISABLED_SEL0, MCU_STANDBYRAM_CPU0_BLK0_SEL1, MCU_STANDBYRAM_CPU0_BLK0_BLK1_SEL2, MCU_STANDBYRAM_CPU1_BLK0_BLK1_SEL4, MCU_STANDBYRAM_CPU0_CPU1_BLK0_BLK1_SEL7, MCU_STANDBYRAM_CPU0_BLK0_NONCACHED_SEL1, MCU_STANDBYRAM_CPU0_BLK0_BLK1_NONCACHED_SEL2, MCU_STANDBYRAM_CPU1_BLK0_BLK1_NONCACHED_SEL4, MCU_STANDBYRAM_CPU0_CPU1_BLK0_BLK1_NONCACHED_SEL7}, origin=INFINEON_AURIX2G, set at pre-compile, default-value=MCU_STANDBYRAM_DISABLED_SEL0  # This parameter enables dLMU0/dLMU1 powered up in sleep mode. MCU_STANDBYRAM_DISABLED_SEL0 : Standby ram is disabled. MCU_STANDBYRAM_CPU0_BLK0_SEL1 : standby ram is enabled as dLMU0 cached. MCU_STANDBYRAM_CPU0_BLK0_BLK1_SEL2 : standby ram is enabled as dLMU0 BLK0 and BLK1 cached. MCU_STANDBYRAM_CPU1_BLK0_BLK1_SEL4 : standby ram is enabled as dLMU1 BLK0 and BLK1 cached. MCU_STANDBYRAM_CPU0_CPU1_BLK0_BLK1_SEL7 : standby ram is enabled as dLMU0 and dLMU1 cached. MCU_STANDBYRAM_CPU0_BLK0_NONCACHED_SEL1 : standby ram is enabled as dLMU0 non-cached. MCU_STANDBYRAM_CPU0_BLK0_BLK1_NONCACHED_SEL2 : standby ram is enabled as dLMU0 BLK0 and BLK1 non-cached. MCU_STANDBYRAM_CPU1_BLK0_BLK1_NONCACHED_SEL4 : standby ram is enabled as dLMU1 BLK0 and BLK1 non-cached. MCU_STANDBYRAM_CPU0_CPU1_BLK0_BLK1_NONCACHED_SEL7 : standby ram is enabled as dLMU0 and dLMU1 non-cached. Only BLK0 addresses (start of dLMU0/1) are supported right in respective selections.
          container McuStdbyModeESR0Conf  # This container defines the configuration (parameters) for ESR0 in standby mode.
            boolean McuStdbyModeESR0WakeupEnable: origin=INFINEON_AURIX2G, post-build-variant-value=true, set at post-build, default-value=false  # This parameter specifies if wakeup from standby mode is enabled via ESR0. TRUE: Wakeup from standby mode through ESR0 is enabled. FALSE: Wakeup from standby mode through ESR0 is disabled.
            boolean McuStdbyModeESR0FltEnable: origin=INFINEON_AURIX2G, post-build-variant-value=true, set at post-build, default-value=false  # This parameter specifies if digital filter is enabled for ESR0 to wakeup from standby mode. TRUE : Digital filter is enabled for ESR0 wakeup from standby mode. FALSE: Digital filter is disabled for ESR0 wakeup from standby mode.
            enumeration McuStdbyModeESR0EdgeDetection: {ESR0_TRIG_RISING_EDGE_SEL1, ESR0_TRIG_FALLING_EDGE_SEL2, ESR0_TRIG_RISING_FALLING_EDGE_SEL3}, origin=INFINEON_AURIX2G, post-build-variant-value=true, set at post-build, default-value=ESR0_TRIG_RISING_EDGE_SEL1  # The parameter specifies if trigger is generated on rising edge detection, falling edge detection or both. ESR0_TRIG_RISING_EDGE_SEL1: A trigger is generated on rising edge detection. ESR0_TRIG_FALLING_EDGE_SEL2: A trigger is generated on falling edge detection. ESR0_TRIG_RISING_FALLING_EDGE_SEL3: A trigger is generated on both rising edge detection and falling edge detection.
          container McuStdbyModeESR1Conf  # This container contains the configuration (parameters) for the ESR1 configuration in Mcu standby mode.
            boolean McuStdbyModeESR1WakeupEnable: origin=INFINEON_AURIX2G, post-build-variant-value=true, set at post-build, default-value=false  # This parameter specifies if wakeup from standby mode is enabled via ESR1. TRUE: Wakeup from standby mode through ESR1 is enabled. FALSE: Wakeup from standby mode through ESR1 is disabled.
            boolean McuStdbyModeESR1FltEnable: origin=INFINEON_AURIX2G, post-build-variant-value=true, set at post-build, default-value=false  # This parameter specifies if digital filter is enabled for ESR1 to wakeup from standby mode. TRUE: Digital filter is enabled for ESR1 wakeup from standby mode. FALSE: Digital filter is disabled for ESR1 wakeup from standby mode.
            enumeration McuStdbyModeESR1EdgeDetection: {ESR1_TRIG_RISING_EDGE_SEL1, ESR1_TRIG_FALLING_EDGE_SEL2, ESR1_TRIG_RISING_FALLING_EDGE_SEL3}, origin=INFINEON_AURIX2G, post-build-variant-value=true, set at post-build, default-value=ESR1_TRIG_RISING_EDGE_SEL1  # The parameter specifies if trigger is generated on rising edge detection, falling edge detection or both. ESR1_TRIG_RISING_EDGE_SEL1: A trigger is generated on rising edge detection. ESR1_TRIG_FALLING_EDGE_SEL2: A trigger is generated on falling edge detection. ESR1_TRIG_RISING_FALLING_EDGE_SEL3: A trigger is generated on both rising edge detection and falling edge detection.
          container McuStdbyModePinAConf  # This container contains the configuration (parameters) for standby PinA mode.
            boolean McuStdbyModePinAWakeupEnable: origin=INFINEON_AURIX2G, post-build-variant-value=true, set at post-build, default-value=false  # This parameter specifies if wakeup from standby mode is enabled via PINA. TRUE: Wakeup from standby mode through PINA is enabled. FALSE: Wakeup from standby mode through PINA is disabled.
            boolean McuStdbyModePinAFltEnable: origin=INFINEON_AURIX2G, post-build-variant-value=true, set at post-build, default-value=false  # This parameter specifies if digital filter is enabled for PINA to wakeup from standby mode. TRUE: Digital filter is enabled for PINA wakeup from standby mode. FALSE: Digital filter is disabled for PINA wakeup from standby mode.
            enumeration McuStdbyModePinAEdgeDetection: {PINA_TRIG_RISING_EDGE_SEL1, PINA_TRIG_FALLING_EDGE_SEL2, PINA_TRIG_RISING_FALLING_EDGE_SEL3}, origin=INFINEON_AURIX2G, post-build-variant-value=true, set at post-build, default-value=PINA_TRIG_RISING_EDGE_SEL1  # The parameter specifies if trigger is generated on rising edge detection, falling edge detection or both. PINA_TRIG_RISING_EDGE_SEL1: A trigger is generated on rising edge detection. PINA_TRIG_FALLING_EDGE_SEL2: A trigger is generated on falling edge detection. PINA_TRIG_RISING_FALLING_EDGE_SEL3: A trigger is generated on both rising edge detection and falling edge detection.
          container McuStdbyModePinBConf  # This container contains the configuration (parameters) for PinB MCU standby mode.
            boolean McuStdbyModePinBWakeupEnable: origin=INFINEON_AURIX2G, post-build-variant-value=true, set at post-build, default-value=false  # This parameter specifies if wakeup from standby mode is enabled via PINB. TRUE : Wakeup from standby mode through PINB is enabled. FALSE: Wakeup from standby mode through PINB is disabled.
            boolean McuStdbyModePinBFltEnable: origin=INFINEON_AURIX2G, post-build-variant-value=true, set at post-build, default-value=false  # This parameter specifies if digital filter is enabled for PINB to wakeup from standby mode. TRUE: Digital filter is enabled for PINB wakeup from standby mode. FALSE: Digital filter is disabled for PINB wakeup from standby mode.
            enumeration McuStdbyModePinBEdgeDetection: {PINB_TRIG_RISING_EDGE_SEL1, PINB_TRIG_FALLING_EDGE_SEL2, PINB_TRIG_RISING_FALLING_EDGE_SEL3}, origin=INFINEON_AURIX2G, post-build-variant-value=true, set at post-build, default-value=PINB_TRIG_RISING_EDGE_SEL1  # The parameter specifies if trigger is generated on rising edge detection, falling edge detection or both. PINB_TRIG_RISING_EDGE_SEL1: A trigger is generated on rising edge detection. PINB_TRIG_FALLING_EDGE_SEL2: A trigger is generated on falling edge detection. PINB_TRIG_RISING_FALLING_EDGE_SEL3: A trigger is generated on both rising edge detection and falling edge detection.
          container McuStdbyModeWakeupTimerConf  # This container contains the configuration (parameters) for Standby wakeup from timer.
            boolean McuStdbyModeWakeupTimerEnable: origin=INFINEON_AURIX2G, post-build-variant-value=true, set at post-build, default-value=false  # This parameter specifies specifies if wake up from low power mode is supported through wake up timer. TRUE: Wakeup from low power modes with wake up timer is enabled. FALSE: Wakeup from low power modes with wake up timer is disabled.
            integer McuStdbyModeWakeupTimerValue: 0..16777215, origin=INFINEON_AURIX2G, post-build-variant-value=true, set at post-build, default-value=16777215  # This parameter specifies the wakeup timer reload value
            enumeration McuStdbyModeWakeupTimerClkDiv: {WUT_70KHZ_NO_DIV_CLK_SEL0, WUT_70KHZ_DIV_CLK_SEL1}, origin=INFINEON_AURIX2G, post-build-variant-value=true, set at post-build, default-value=WUT_70KHZ_NO_DIV_CLK_SEL0  # The parameter specifies the wakeup timer clock source selection. WUT_70KHZ_NO_DIV_CLK_SEL0: wake up timer runs on 70 KHz frequency . WUT_70KHZ_DIV_CLK_SEL1: wake up timer runs on 70 KHz frequency divided by 1024 divider value.
            enumeration McuStdbyModeWakeupTimerMode: {WUT_AUTO_RELOAD_MODE_SEL0, WUT_AUTO_STOP_MODE_SEL1}, origin=INFINEON_AURIX2G, post-build-variant-value=true, set at post-build, default-value=WUT_AUTO_RELOAD_MODE_SEL0  # The parameter specifies the wakeup timer clock source selection. WUT_AUTO_RELOAD_MODE_SEL0: selected counter starts running from McuStdbyModeWakeupTimerValue downwards direction. On counter underflow, the wakeup counter value is reloaded with McuStdbyModeWakeupTimerValue again WUT_AUTO_STOP_MODE_SEL1: counter starts running from McuStdbyModeWakeupTimerValue downwards direction. On counter underflow, wakeup timer stops running.
          container McuStdbyModeVddVextConf  # This container contains the configuration (parameters) for the standby mode setting for VDD and VEXT supply.
            boolean McuStdbyModeEntryOnVEXTRampDown: origin=INFINEON_AURIX2G, post-build-variant-value=true, set at post-build, default-value=false  # This parameter specifies if the standby entry on VEXT supply ramp down is enabled or not TRUE: standby mode entry on VEXT supply ramp-down is enabled. FALSE: standby mode entry on VEXT supply ramp-down is disabled.
            boolean McuStdbyModeEntryOnVDDRampDown: origin=INFINEON_AURIX2G, post-build-variant-value=true, set at post-build, default-value=false  # This parameter specifies if the standby entry on VDD supply ramp down is enabled or not TRUE: standby mode entry on VDD supply ramp-down is enabled. FALSE: standby mode entry on VDD supply ramp-down is disabled.
            integer McuStdbyModeVextUVThres: 0..255, origin=INFINEON_AURIX2G, post-build-variant-value=true, set at post-build, default-value=117  # This parameter specifies the secondary under voltage threshold value of VEXT.(This parameter shall be configurable when McuStdbyModeEntryOnVEXTRampDown is enabled)
            enumeration McuStdbyModeVextUMMonMode: {VEXT_UV_MON_MODE_SEL0, VEXT_UV_MON_MODE_SEL1, VEXT_UV_MON_MODE_SEL2, VEXT_UV_MON_MODE_SEL3}, origin=INFINEON_AURIX2G, post-build-variant-value=true, set at post-build, default-value=VEXT_UV_MON_MODE_SEL2  # The parameter specifies the VEXT under voltage monitoring mode.(This parameter shall be configurable when McuStdbyModeEntryOnVEXTRampDown is enabled) VEXT_UV_MON_MODE_SEL0: Under voltage monitoring is inactive. VEXT_UV_MON_MODE_SEL1: An under-voltage event is triggered when the threshold is crossed in a lower to higher voltage transition. Greater than or equal compare is used. VEXT_UV_MON_MODE_SEL2: An under-voltage event is triggered when the threshold is crossed in a higher to lower voltage transition. Less than or equal compare is used. VEXT_UV_MON_MODE_SEL3: An under-voltage event is triggered when the threshold is crossed in either direction. Less than or equal compare is used.
            integer McuStdbyModeVddUVThres: 0..255, origin=INFINEON_AURIX2G, post-build-variant-value=true, set at post-build, default-value=184  # This parameter specifies the secondary under voltage threshold value of VDD. (This parameter shall be configurable when McuStdbyModeEntryOnVDDRampDown is enabled)
            enumeration McuStdbyModeVddUMMonMode: {VDD_UV_MON_MODE_SEL0, VDD_UV_MON_MODE_SEL1, VDD_UV_MON_MODE_SEL2, VDD_UV_MON_MODE_SEL3}, origin=INFINEON_AURIX2G, post-build-variant-value=true, set at post-build, default-value=VDD_UV_MON_MODE_SEL2  # The parameter specifies the VDD under voltage monitoring mode. (This parameter shall be configurable when McuStdbyModeEntryOnVDDRampDown is enabled) VDD_UV_MON_MODE_SEL0: Under voltage monitoring is inactive. VDD_UV_MON_MODE_SEL1: An under-voltage event is triggered when the threshold is crossed in a lower to higher voltage transition. Greater than or equal compare is used. VDD_UV_MON_MODE_SEL2: An under-voltage event is triggered when the threshold is crossed in a higher to lower voltage transition. Less than or equal compare is used. VDD_UV_MON_MODE_SEL3: An under-voltage event is triggered when the threshold is crossed in either direction. Less than or equal compare is used.
      container McuRamSectorSettingConf [0..256]: multiplicity set at pre-compile  # This container contains the configuration (parameters) for the RAM Sector setting.
        integer McuRamSectorSettingId: 0..255, origin=INFINEON_AURIX2G, set at pre-compile, symbolic-name-value=true, default-value=0  # The Id of this McuRamSectorSettingConf to be used as argument for the API call Mcu_InitRamSection.
        integer McuRamDefaultValue: 0..255, post-build-variant-value=true, set at post-build, default-value=0  # This parameter shall represent the Data pre-setting to be initialized
        integer McuRamSectionBaseAddress: 0..4294967295, post-build-variant-value=true, set at post-build, default-value=1879048192  # This parameter shall represent the MCU RAM section base address
        integer McuRamSectionSize: 0..4294967295, post-build-variant-value=true, set at post-build, default-value=8  # This parameter represents the MCU RAM Section size in bytes.
        integer McuRamSectionWriteSize: 0..4294967295, post-build-variant-value=true, set at post-build, default-value=8  # This parameter shall define the size in bytes of data which can be written into RAM at once.
      container McuGpt12PrescalerConf  # This container contains the prescalar configuration (parameters) for GPT12 Timer.
        enumeration Gpt1BlockPrescalerSel: {GPT1_BLOCK_NOT_USED, GPT1_PRESCALING_FACTOR_4, GPT1_PRESCALING_FACTOR_8, GPT1_PRESCALING_FACTOR_16, GPT1_PRESCALING_FACTOR_32}, origin=INFINEON_AURIX2G, post-build-variant-value=true, set at post-build, default-value=GPT1_BLOCK_NOT_USED  # The parameter specifies the divider for the clock of GPT1 Block. GPT1_BLOCK_NOT_USED : GPT1 Timer Block is not used. GPT1_PRESCALING_FACTOR_4 : GPT1 Timer Block is clocked at FGPT BY 4. GPT1_PRESCALING_FACTOR_8 : GPT1 Timer Block is clocked at FGPT BY 8. GPT1_PRESCALING_FACTOR_16 : GPT1 Timer Block is clocked at FGPT BY 16. GPT1_PRESCALING_FACTOR_32 : GPT1 Timer Block is clocked at FGPT BY 32.
        enumeration Gpt2BlockPrescalerSel: {GPT2_BLOCK_NOT_USED, GPT2_PRESCALING_FACTOR_2, GPT2_PRESCALING_FACTOR_4, GPT2_PRESCALING_FACTOR_8, GPT2_PRESCALING_FACTOR_16}, origin=INFINEON_AURIX2G, post-build-variant-value=true, set at post-build, default-value=GPT2_BLOCK_NOT_USED  # The parameter specifies the divider for the clock of GPT2 Block. GPT2_BLOCK_NOT_USED : GPT2 Block is not used. GPT2_PRESCALING_FACTOR_2 : GPT2 Timer Block is clocked at FGPT BY 2. GPT2_PRESCALING_FACTOR_4 : GPT2 Timer Block is clocked at FGPT BY 4. GPT2_PRESCALING_FACTOR_8 : GPT2 Timer Block is clocked at FGPT BY 8. GPT2_PRESCALING_FACTOR_16 : GPT2 Timer Block is clocked at FGPT BY 16.
      container GtmGlobalConfiguration  # This container contains the configuration (parameters) for Global GTM settings.
        container McuGtmClockManagementConf  # This container contains the configuration (parameters) for GTM Clock configurations.
          integer GtmCmuGlobalClockNumerator: 1..16777215, origin=INFINEON_AURIX2G, post-build-variant-value=true, set at post-build, default-value=1  # This parameter specifies the GTM global numerator value for configurable clock and fixed clock
          integer GtmCmuGlobalClockDenominator: 1..16777215, origin=INFINEON_AURIX2G, post-build-variant-value=true, set at post-build, default-value=1  # This parameter specifies the GTM global denominator value for configurable clock and fixed clock
          container GtmFixedClockSetting  # This container contains the configuration (parameters) for GTM Fixed Clock settings.
            boolean GtmCmuFixedClockEnable: origin=INFINEON_AURIX2G, post-build-variant-value=true, set at post-build, default-value=true  # This parameter specifies enable of fixed clock. TRUE: CMU fixed clock is enabled FALSE: CMU fixed clock is disabled
            enumeration GtmCmuFixedClockSel: {CMU_GLOBAL_CLOCK_SEL0, CMU_CLOCK0_SEL1, CMU_CLOCK1_SEL2, CMU_CLOCK2_SEL3, CMU_CLOCK3_SEL4, CMU_CLOCK4_SEL5, CMU_CLOCK5_SEL6, CMU_CLOCK6_SEL7, CMU_CLOCK7_SEL8}, origin=INFINEON_AURIX2G, post-build-variant-value=true, set at post-build, default-value=CMU_GLOBAL_CLOCK_SEL0  # The parameter specifies the divider for the fixed clock. CMU_GLOBAL_CLOCK_SEL0 : Global clock divider is selected. CMU_CLOCK0_SEL1 : clock0 divider is selected. CMU_CLOCK1_SEL2 : clock1 divider is selected. CMU_CLOCK2_SEL3 : clock2 divider is selected. CMU_CLOCK3_SEL4 : clock3 divider is selected. CMU_CLOCK4_SEL5 : clock4 divider is selected. CMU_CLOCK5_SEL6 : clock5 divider is selected. CMU_CLOCK6_SEL7 : clock6 divider is selected. CMU_CLOCK7_SEL8 : clock7 divider is selected.
          container GtmConfigClockSetting  # This container contains the configuration (parameters) for GTM configuration clock settings.
            boolean GtmCmuConfigClock0Enable: origin=INFINEON_AURIX2G, post-build-variant-value=true, set at post-build, default-value=true  # This parameter specifies enable of configurable Clock0. TRUE: CMU configurable Clock0 enabled FALSE: CMU configurable Clock0 is disabled
            integer GtmCmuConfigClock0Div: 0..16777215, origin=INFINEON_AURIX2G, post-build-variant-value=true, set at post-build, default-value=0  # This parameter specifies the configurable Clock0 divider value
            boolean GtmCmuConfigClock1Enable: origin=INFINEON_AURIX2G, post-build-variant-value=true, set at post-build, default-value=true  # This parameter specifies enable of configurable Clock1. TRUE : CMU configurable Clock1 enabled FALSE: CMU configurable Clock1 is disabled
            integer GtmCmuConfigClock1Div: 0..16777215, origin=INFINEON_AURIX2G, post-build-variant-value=true, set at post-build, default-value=0  # This parameter specifies the configurable Clock1 divider value
            boolean GtmCmuConfigClock2Enable: origin=INFINEON_AURIX2G, post-build-variant-value=true, set at post-build, default-value=true  # This parameter specifies enable of configurable Clock2. TRUE: CMU configurable Clock2 enabled. FALSE: CMU configurable Clock2 is disabled.
            integer GtmCmuConfigClock2Div: 0..16777215, origin=INFINEON_AURIX2G, post-build-variant-value=true, set at post-build, default-value=0  # This parameter specifies the configurable Clock2 divider value
            boolean GtmCmuConfigClock3Enable: origin=INFINEON_AURIX2G, post-build-variant-value=true, set at post-build, default-value=true  # This parameter specifies enable of configurable Clock3. TRUE: CMU configurable Clock3 enabled. FALSE: CMU configurable Clock3 is disabled
            integer GtmCmuConfigClock3Div: 0..16777215, origin=INFINEON_AURIX2G, post-build-variant-value=true, set at post-build, default-value=0  # This parameter specifies the configurable Clock3 divider value
            boolean GtmCmuConfigClock4Enable: origin=INFINEON_AURIX2G, post-build-variant-value=true, set at post-build, default-value=true  # This parameter specifies enable of configurable Clock4. TRUE: CMU configurable Clock4 enabled. FALSE: CMU configurable Clock4 is disabled.
            integer GtmCmuConfigClock4Div: 0..16777215, origin=INFINEON_AURIX2G, post-build-variant-value=true, set at post-build, default-value=0  # This parameter specifies the configurable Clock4 divider value
            boolean GtmCmuConfigClock5Enable: origin=INFINEON_AURIX2G, post-build-variant-value=true, set at post-build, default-value=true  # This parameter specifies enable of configurable Clock5. TRUE: CMU configurable Clock5 enabled. FALSE: CMU configurable Clock5 is disabled.
            integer GtmCmuConfigClock5Div: 0..16777215, origin=INFINEON_AURIX2G, post-build-variant-value=true, set at post-build, default-value=0  # This parameter specifies the configurable Clock5 divider value
            boolean GtmCmuConfigClock6Enable: origin=INFINEON_AURIX2G, post-build-variant-value=true, set at post-build, default-value=true  # This parameter specifies enable of configurable Clock6. TRUE: CMU configurable Clock6 enabled. FALSE: CMU configurable Clock6 is disabled.
            integer GtmCmuConfigClock6Div: 0..16777215, origin=INFINEON_AURIX2G, post-build-variant-value=true, set at post-build, default-value=0  # This parameter specifies the configurable Clock6 divider value
            boolean GtmCmuConfigClock7Enable: origin=INFINEON_AURIX2G, post-build-variant-value=true, set at post-build, default-value=true  # This parameter specifies enable of configurable Clock7. TRUE: CMU configurable Clock7 enabled. FALSE: CMU configurable Clock7 is disabled.
            integer GtmCmuConfigClock7Div: 0..16777215, origin=INFINEON_AURIX2G, post-build-variant-value=true, set at post-build, default-value=0  # This parameter specifies the configurable Clock7 divider value
          container GtmExtClockSetting  # This container contains the configuration (parameters) for GTM external clock settings.
            boolean GtmCmuExtClock0Enable: origin=INFINEON_AURIX2G, post-build-variant-value=true, set at post-build, default-value=false  # This parameter specifies if External Clock0 is enabled or not. TRUE : CMU External Clock0 is enabled. FALSE: CMU External Clock0 is disabled.
            integer GtmCmuExtClock0Numerator: 1..16777215, origin=INFINEON_AURIX2G, post-build-variant-value=true, set at post-build, default-value=1  # This parameter specifies the numerator value for external Clock0
            integer GtmCmuExtClock0Denominator: 1..16777215, origin=INFINEON_AURIX2G, post-build-variant-value=true, set at post-build, default-value=1  # This parameter specifies the denominator value for external Clock0
            boolean GtmCmuExtClock1Enable: origin=INFINEON_AURIX2G, post-build-variant-value=true, set at post-build, default-value=false  # This parameter specifies if External Clock1 is enabled or not. TRUE : CMU External Clock1 is enabled. FALSE: CMU External Clock1 is disabled.
            integer GtmCmuExtClock1Numerator: 1..16777215, origin=INFINEON_AURIX2G, post-build-variant-value=true, set at post-build, default-value=1  # This parameter specifies the numerator value for external Clock1
            integer GtmCmuExtClock1Denominator: 1..16777215, origin=INFINEON_AURIX2G, post-build-variant-value=true, set at post-build, default-value=1  # This parameter specifies the denominator value for external Clock1
            boolean GtmCmuExtClock2Enable: origin=INFINEON_AURIX2G, post-build-variant-value=true, set at post-build, default-value=false  # This parameter specifies if External Clock2 is enabled or not. TRUE : CMU External Clock2 is enabled. FALSE: CMU External Clock2 is disabled.
            integer GtmCmuExtClock2Numerator: 1..16777215, origin=INFINEON_AURIX2G, post-build-variant-value=true, set at post-build, default-value=1  # This parameter specifies the numerator value for external Clock2
            integer GtmCmuExtClock2Denominator: 1..16777215, origin=INFINEON_AURIX2G, post-build-variant-value=true, set at post-build, default-value=1  # This parameter specifies the denominator value for external Clock2
        container GtmClusterConf [12..12]  # This container contains the configuration (parameters) for GTM Cluster settings.
          enumeration GtmCmuClusterInputClockDividerEnable: {CLS_CLK_CFG_DISABLED_SEL0, CLS_CLK_CFG_ENABLED_WITHOUT_DIV_SEL1, CLS_CLK_CFG_ENABLED_WITH_DIV_SEL2}, origin=INFINEON_AURIX2G, post-build-variant-value=true, set at post-build, default-value=CLS_CLK_CFG_ENABLED_WITH_DIV_SEL2  # This configuration parameter enables/disables the dividing of fGTM to CMU for cluster-x. CLS_CLK_CFG_DISABLED_SEL0: Cluster x is disabled CLS_CLK_CFG_ENABLED_WITHOUT_DIV_SEL1: Cluster x is enabled without clock divider. CLS_CLK_CFG_ENABLED_WITH_DIV_SEL2: Cluster x is enabled with clock divider. The configuration value CLS0_CLK_DIV defines the primary input clock period for CMU. If CLS0_CLK_DIV is configured to a value 0b10 (i.e. clock divider 2), the maximum CMU clock frequency for all other cluster c=1..n is also limited to configured CMU clock frequency of cluster 0. NOTE: For the Clusters greater than 4, (only 100MHz capable), the allowed settings for the CLS_CLK_DIV are 00 and 10 (clock divider 2).
          container GtmClusterConfClockSetting  # This container contains the configuration (parameters) for GTM cluster clock settings.
            enumeration GtmClusterConfClock0Src: {CMU_CONF_CLOCK0_SEL0, CMU_CONF_CLOCK8_SEL1, EXT_CAPTURE_SEL2}, origin=INFINEON_AURIX2G, post-build-variant-value=true, set at post-build, default-value=CMU_CONF_CLOCK0_SEL0  # The parameter specifies specifies the input clock source for current GTM cluster sub peripheral using configurable Clock0. CMU_CONF_CLOCK0_SEL0: Configurable clock-x is used for clock. CMU_CONF_CLOCK8_SEL1: Configurable clock8 is used for clock. EXT_CAPTURE_SEL2: External capture source is used for clock.
            enumeration GtmClusterConfClock1Src: {CMU_CONF_CLOCK1_SEL0, CMU_CONF_CLOCK8_SEL1, EXT_CAPTURE_SEL2}, origin=INFINEON_AURIX2G, post-build-variant-value=true, set at post-build, default-value=CMU_CONF_CLOCK1_SEL0  # The parameter specifies specifies the input clock source for current GTM cluster sub peripheral using configurable Clock1. CMU_CONF_CLOCK1_SEL0: Configurable clock1 is used for clock. CMU_CONF_CLOCK8_SEL1: Configurable clock8 is used for clock. EXT_CAPTURE_SEL2: External capture source is used for clock.
            enumeration GtmClusterConfClock2Src: {CMU_CONF_CLOCK2_SEL0, CMU_CONF_CLOCK8_SEL1, EXT_CAPTURE_SEL2}, origin=INFINEON_AURIX2G, post-build-variant-value=true, set at post-build, default-value=CMU_CONF_CLOCK2_SEL0  # The parameter specifies specifies the input clock source for current GTM cluster sub peripheral using configurable Clock2. CMU_CONF_CLOCK2_SEL0: Configurable clock1 is used for clock. CMU_CONF_CLOCK8_SEL1: Configurable clock8 is used for clock. EXT_CAPTURE_SEL2: External capture source is used for clock.
            enumeration GtmClusterConfClock3Src: {CMU_CONF_CLOCK3_SEL0, CMU_CONF_CLOCK8_SEL1, EXT_CAPTURE_SEL2}, origin=INFINEON_AURIX2G, post-build-variant-value=true, set at post-build, default-value=CMU_CONF_CLOCK3_SEL0  # The parameter specifies specifies the input clock source for current GTM cluster sub peripheral using configurable Clock3. CMU_CONF_CLOCK3_SEL0: Configurable clock3 is used for clock. CMU_CONF_CLOCK8_SEL1: Configurable clock8 is used for clock. EXT_CAPTURE_SEL2: External capture source is used for clock.
            enumeration GtmClusterConfClock4Src: {CMU_CONF_CLOCK4_SEL0, CMU_CONF_CLOCK8_SEL1, EXT_CAPTURE_SEL2}, origin=INFINEON_AURIX2G, post-build-variant-value=true, set at post-build, default-value=CMU_CONF_CLOCK4_SEL0  # The parameter specifies specifies the input clock source for current GTM cluster sub peripheral using configurable Clock4. CMU_CONF_CLOCK4_SEL0: Configurable clock4 is used for clock. CMU_CONF_CLOCK8_SEL1: Configurable clock8 is used for clock. EXT_CAPTURE_SEL2: External capture source is used for clock.
            enumeration GtmClusterConfClock5Src: {CMU_CONF_CLOCK5_SEL0, CMU_CONF_CLOCK8_SEL1, EXT_CAPTURE_SEL2}, origin=INFINEON_AURIX2G, post-build-variant-value=true, set at post-build, default-value=CMU_CONF_CLOCK5_SEL0  # The parameter specifies specifies the input clock source for current GTM cluster sub peripheral using configurable Clock4. CMU_CONF_CLOCK5_SEL0: Configurable clock5 is used for clock. CMU_CONF_CLOCK8_SEL1: Configurable clock8 is used for clock. EXT_CAPTURE_SEL2: External capture source is used for clock.
            enumeration GtmClusterConfClock6Src: {CMU_CONF_CLOCK6_SEL0, CMU_CONF_CLOCK8_SEL1, EXT_CAPTURE_SEL2}, origin=INFINEON_AURIX2G, post-build-variant-value=true, set at post-build, default-value=CMU_CONF_CLOCK6_SEL0  # The parameter specifies specifies the input clock source for current GTM cluster sub peripheral using configurable Clock6. CMU_CONF_CLOCK6_SEL0: Configurable clock6 is used for clock. CMU_CONF_CLOCK8_SEL1: Configurable clock8 is used for clock. EXT_CAPTURE_SEL2: External capture source is used for clock.
            enumeration GtmClusterConfClock7Src: {CMU_CONF_CLOCK7_SEL0, CMU_CONF_CLOCK8_SEL1, EXT_CAPTURE_SEL2}, origin=INFINEON_AURIX2G, post-build-variant-value=true, set at post-build, default-value=CMU_CONF_CLOCK7_SEL0  # The parameter specifies specifies the input clock source for current GTM cluster sub peripheral using configurable Clock7. CMU_CONF_CLOCK7_SEL0: Configurable clock7 is used for clock. CMU_CONF_CLOCK8_SEL1: Configurable clock8 is used for clock. EXT_CAPTURE_SEL2: External capture source is used for clock.
          container GtmClusterFixedClockSetting  # This container contains the configuration (parameters) for GTM cluster fixed clock settings.
            enumeration GtmClusterFixedClockSrc: {CMU_FIXED_CLOCK0_SEL0, CMU_CONF_CLOCK8_SEL1}, origin=INFINEON_AURIX2G, post-build-variant-value=true, set at post-build, default-value=CMU_FIXED_CLOCK0_SEL0  # The parameter specifies specifies the input clock source for current GTM cluster sub peripheral using fixe Clock. CMU_FIXED_CLOCK0_SEL0: Fixed clock0 is used for clock. CMU_CONF_CLOCK8_SEL1: Configurable clock8 is used for clock. EXT_CAPTURE_SEL2: External capture source is used for clock.
        container GtmTbuChannelConf [4..4]  # This container contains the configuration (parameters) for GTM TBU channel settings.
          boolean GtmTbuChannelEnable: origin=INFINEON_AURIX2G, post-build-variant-value=true, set at post-build, default-value=false  # This parameter specifies enable TBU channel. TRUE: Channel is enabled FALSE: Channel is disabled
          enumeration GtmTbuChClockSourceSelection: {CMU_CLOCK0_SEL0, CMU_CLOCK1_SEL1, CMU_CLOCK2_SEL2, CMU_CLOCK3_SEL3, CMU_CLOCK4_SEL4, CMU_CLOCK5_SEL5, CMU_CLOCK6_SEL6, CMU_CLOCK7_SEL7}, origin=INFINEON_AURIX2G, post-build-variant-value=true, set at post-build, default-value=CMU_CLOCK0_SEL0  # This parameter will defines configurable clock source selection for the corresponding TBU channel. CMU_CLOCK0_SEL0 : Clock0 is selected as source. CMU_CLOCK1_SEL1 : Clock1 is selected as source. CMU_CLOCK2_SEL2 : Clock2 is selected as source. CMU_CLOCK3_SEL3 : Clock3 is selected as source. CMU_CLOCK4_SEL4 : Clock4 is selected as source. CMU_CLOCK5_SEL5 : Clock5 is selected as source. CMU_CLOCK6_SEL6 : Clock6 is selected as source. CMU_CLOCK7_SEL7 : Clock7 is selected as source.
          enumeration GtmTbuChResolutionSel: {TBU_CH_LOWER_COUNT_BITS_SEL0, TBU_CH_UPPER_COUNT_BITS_SEL1}, origin=INFINEON_AURIX2G, post-build-variant-value=true, set at post-build, default-value=TBU_CH_LOWER_COUNT_BITS_SEL0  # This parameter defines the resolution of time base values given by TBU_CH0_BASE. TBU_CH_LOWER_COUNT_BITS_SEL0 : 0 __ 23 bits of TBU_CH0_BASE is considered. TBU_CH_UPPER_COUNT_BITS_SEL1 : 3 __ 26 bits of TBU_CH0_BASE is considered.
          enumeration GtmTbuChMode: {FREE_RUNNING_COUNTER_SEL0, FORWARD_BACKWARD_SEL1}, origin=INFINEON_AURIX2G, post-build-variant-value=true, set at post-build, default-value=FREE_RUNNING_COUNTER_SEL0  # This parameter defines TBU channle run mode. FREE_RUNNING_COUNTER_SEL0 : TBU channel is in free running counter mode. FORWARD_BACKWARD_SEL1 : TBU channel is in forward backward counter mode. (default for TBU channel 3)
          enumeration GtmTbuChModuloCntrSel: {TBU_CH1_SEL0, TBU_CH2_SEL1}, origin=INFINEON_AURIX2G, post-build-variant-value=true, set at post-build, default-value=TBU_CH1_SEL0  # This parameter defines TBU channle run mode. TBU_CH1_SEL0 : TBU_CH1 values used. TBU_CH2_SEL1 : TBU_CH2 values used.
        container GtmTomGlobalConf [6..6]  # This container contains the configuration (parameters) for GTM TOM unit global settings.
          container GtmTomGroupConf [2..2]  # This container contains the configuration (parameters) for GTM TOM group settings.
            container GtmTomActionTimeBaseUnitConf  # This container contains the configuration (parameters) for GTM TOM group time base settings.
              enumeration GtmTomActionTimeBaseSelection: {TOM_ACT_TB_TBU_TS0, TOM_ACT_TB_TBU_TS1, TOM_ACT_TB_TBU_TS2}, origin=INFINEON_AURIX2G, post-build-variant-value=true, set at post-build, default-value=TOM_ACT_TB_TBU_TS0  # This parameter specifies time base selected to compare with value configured in GtmTomActionTimeBaseValue. TOM_ACT_TB_TBU_TS0 : TBU_TS0 is used as reference time base for TOM group. TOM_ACT_TB_TBU_TS1 : TBU_TS1 is used as reference time base for TOM group. TOM_ACT_TB_TBU_TS2 : TBU_TS2 is used as reference time base for TOM group.
              integer GtmTomActionTimeBaseValue: 1..16777215, origin=INFINEON_AURIX2G, post-build-variant-value=true, set at post-build, default-value=1  # This parameter specifies the time base value for TOM group channel level trigger
          container GtmTomChannelConf [16..16]  # This container contains the configuration (parameters) for GTM TOM channel settings.
            boolean GtmTomChResetCn0OnTriggerEnable: origin=INFINEON_AURIX2G, post-build-variant-value=true, set at post-build, default-value=false  # This parameter specifies enables/disables Tom channel counter Cn0 value is reset on global trigger from any of the trigger sources. TRUE: Resetting of Tom channel Cn0 on global trigger from any trigger source is enabled. FALSE: Resetting of Tom channel Cn0 on global trigger from any trigger source is disabled.
            boolean GtmTomChInternalTriggerEnable: origin=INFINEON_AURIX2G, post-build-variant-value=true, set at post-build, default-value=false  # This parameter specifies enables/disables internal trigger from channel 0 of the corresponding group channel number. TRUE: Enable internal trigger from channel 0 or 8 (based on the TGC a channel belong to). FALSE: Disable internal trigger from channel 0 or 8 (based on the TGC a channel belong to)
            enumeration GtmTimerPortPinSelect: {NONE, TOUT0_SELE_4_PORT02_PIN0, TOUT106_SELE_4_PORT10_PIN4, TOUT109_SELA_0_PORT10_PIN7, TOUT151_SELG_6_PORT02_PIN12, TOUT17_SELE_4_PORT00_PIN8, TOUT18_SELA_0_PORT00_PIN9, TOUT25_SELE_4_PORT33_PIN3, TOUT26_SELA_0_PORT33_PIN4, TOUT32_SELA_0_PORT33_PIN10, TOUT34_SELE_4_PORT33_PIN12, TOUT51_SELF_5_PORT21_PIN0, TOUT53_SELA_0_PORT21_PIN2, TOUT61_SELF_5_PORT20_PIN3, TOUT72_SELE_4_PORT15_PIN1, TOUT76_SELA_0_PORT15_PIN5, TOUT77_SELA_0_PORT15_PIN6, TOUT7_SELE_4_PORT02_PIN7, TOUT85_SELA_0_PORT14_PIN5, TOUT87_SELA_0_PORT14_PIN7, TOUT91_SELE_4_PORT13_PIN0, TOUT9_SELE_4_PORT00_PIN0, TOUT103_SELA_0_PORT10_PIN1, TOUT107_SELE_4_PORT10_PIN5, TOUT10_SELE_4_PORT00_PIN1, TOUT116_SELG_6_PORT02_PIN9, TOUT14_SELE_4_PORT00_PIN5, TOUT19_SELA_0_PORT00_PIN10, TOUT1_SELE_4_PORT02_PIN1, TOUT22_SELE_4_PORT33_PIN0, TOUT27_SELA_0_PORT33_PIN5, TOUT30_SELE_4_PORT33_PIN8, TOUT31_SELA_0_PORT33_PIN9, TOUT35_SELE_4_PORT33_PIN13, TOUT39_SELG_6_PORT32_PIN3, TOUT4_SELE_4_PORT02_PIN4, TOUT52_SELF_5_PORT21_PIN1, TOUT54_SELA_0_PORT21_PIN3, TOUT57_SELE_4_PORT21_PIN6, TOUT73_SELE_4_PORT15_PIN2, TOUT78_SELA_0_PORT15_PIN7, TOUT86_SELA_0_PORT14_PIN6, TOUT90_SELE_4_PORT14_PIN10, TOUT92_SELE_4_PORT13_PIN1, TOUT104_SELA_0_PORT10_PIN2, TOUT107_SELA_0_PORT10_PIN5, TOUT108_SELE_4_PORT10_PIN6, TOUT117_SELG_6_PORT02_PIN10, TOUT11_SELE_4_PORT00_PIN2, TOUT143_SELG_6_PORT33_PIN14, TOUT15_SELE_4_PORT00_PIN6, TOUT20_SELA_0_PORT00_PIN11, TOUT23_SELE_4_PORT33_PIN1, TOUT28_SELA_0_PORT33_PIN6, TOUT2_SELE_4_PORT02_PIN2, TOUT33_SELA_0_PORT33_PIN11, TOUT40_SELG_6_PORT32_PIN4, TOUT55_SELA_0_PORT21_PIN4, TOUT58_SELE_4_PORT21_PIN7, TOUT5_SELE_4_PORT02_PIN5, TOUT74_SELE_4_PORT15_PIN3, TOUT79_SELA_0_PORT15_PIN8, TOUT88_SELA_0_PORT14_PIN8, TOUT93_SELE_4_PORT13_PIN2, TOUT105_SELA_0_PORT10_PIN3, TOUT108_SELA_0_PORT10_PIN6, TOUT109_SELE_4_PORT10_PIN7, TOUT118_SELG_6_PORT02_PIN11, TOUT12_SELE_4_PORT00_PIN3, TOUT144_SELG_6_PORT33_PIN15, TOUT16_SELE_4_PORT00_PIN7, TOUT21_SELA_0_PORT00_PIN12, TOUT24_SELE_4_PORT33_PIN2, TOUT29_SELA_0_PORT33_PIN7, TOUT38_SELA_0_PORT32_PIN2, TOUT3_SELE_4_PORT02_PIN3, TOUT42_SELG_6_PORT23_PIN1, TOUT56_SELA_0_PORT21_PIN5, TOUT59_SELE_4_PORT20_PIN0, TOUT60_SELE_4_PORT20_PIN1, TOUT6_SELE_4_PORT02_PIN6, TOUT71_SELE_4_PORT15_PIN0, TOUT75_SELE_4_PORT15_PIN4, TOUT80_SELA_0_PORT14_PIN0, TOUT89_SELA_0_PORT14_PIN9, TOUT94_SELE_4_PORT13_PIN3, TOUT0_SELG_6_PORT02_PIN0, TOUT102_SELA_0_PORT10_PIN0, TOUT10_SELG_6_PORT00_PIN1, TOUT124_SELF_5_PORT11_PIN8, TOUT143_SELE_4_PORT33_PIN14, TOUT147_SELE_4_PORT34_PIN2, TOUT1_SELG_6_PORT02_PIN1, TOUT22_SELA_0_PORT33_PIN0, TOUT29_SELE_4_PORT33_PIN7, TOUT30_SELA_0_PORT33_PIN8, TOUT36_SELE_4_PORT32_PIN0, TOUT37_SELE_4_PORT32_PIN1, TOUT39_SELA_0_PORT32_PIN3, TOUT53_SELG_6_PORT21_PIN2, TOUT54_SELG_6_PORT21_PIN3, TOUT56_SELE_4_PORT21_PIN5, TOUT57_SELA_0_PORT21_PIN6, TOUT64_SELF_5_PORT20_PIN8, TOUT65_SELF_5_PORT20_PIN9, TOUT72_SELG_6_PORT15_PIN1, TOUT73_SELG_6_PORT15_PIN2, TOUT81_SELA_0_PORT14_PIN1, TOUT89_SELE_4_PORT14_PIN9, TOUT8_SELG_6_PORT02_PIN8, TOUT90_SELA_0_PORT14_PIN10, TOUT94_SELG_6_PORT13_PIN3, TOUT95_SELF_5_PORT11_PIN2, TOUT96_SELG_6_PORT11_PIN3, TOUT9_SELG_6_PORT00_PIN0, TOUT110_SELA_0_PORT10_PIN8, TOUT11_SELG_6_PORT00_PIN2, TOUT121_SELG_6_PORT11_PIN4, TOUT128_SELG_6_PORT12_PIN0, TOUT12_SELG_6_PORT00_PIN3, TOUT144_SELE_4_PORT33_PIN15, TOUT148_SELE_4_PORT34_PIN3, TOUT23_SELA_0_PORT33_PIN1, TOUT26_SELE_4_PORT33_PIN4, TOUT27_SELG_6_PORT33_PIN5, TOUT28_SELG_6_PORT33_PIN6, TOUT2_SELG_6_PORT02_PIN2, TOUT32_SELE_4_PORT33_PIN10, TOUT37_SELG_6_PORT32_PIN1, TOUT3_SELG_6_PORT02_PIN3, TOUT40_SELA_0_PORT32_PIN4, TOUT53_SELE_4_PORT21_PIN2, TOUT55_SELG_6_PORT21_PIN4, TOUT56_SELG_6_PORT21_PIN5, TOUT58_SELA_0_PORT21_PIN7, TOUT66_SELF_5_PORT20_PIN10, TOUT67_SELF_5_PORT20_PIN11, TOUT74_SELG_6_PORT15_PIN3, TOUT76_SELG_6_PORT15_PIN5, TOUT77_SELF_5_PORT15_PIN6, TOUT82_SELA_0_PORT14_PIN2, TOUT87_SELE_4_PORT14_PIN7, TOUT91_SELA_0_PORT13_PIN0, TOUT96_SELF_5_PORT11_PIN3, TOUT97_SELF_5_PORT11_PIN6, TOUT106_SELA_0_PORT10_PIN4, TOUT129_SELG_6_PORT12_PIN1, TOUT13_SELG_6_PORT00_PIN4, TOUT149_SELE_4_PORT34_PIN4, TOUT14_SELG_6_PORT00_PIN5, TOUT24_SELA_0_PORT33_PIN2, TOUT27_SELE_4_PORT33_PIN5, TOUT29_SELG_6_PORT33_PIN7, TOUT30_SELG_6_PORT33_PIN8, TOUT31_SELE_4_PORT33_PIN9, TOUT38_SELE_4_PORT32_PIN2, TOUT40_SELE_4_PORT32_PIN4, TOUT42_SELA_0_PORT23_PIN1, TOUT48_SELG_6_PORT22_PIN1, TOUT49_SELG_6_PORT22_PIN2, TOUT4_SELG_6_PORT02_PIN4, TOUT54_SELE_4_PORT21_PIN3, TOUT59_SELA_0_PORT20_PIN0, TOUT5_SELG_6_PORT02_PIN5, TOUT68_SELF_5_PORT20_PIN12, TOUT69_SELF_5_PORT20_PIN13, TOUT78_SELF_5_PORT15_PIN7, TOUT80_SELE_4_PORT14_PIN0, TOUT82_SELE_4_PORT14_PIN2, TOUT83_SELA_0_PORT14_PIN3, TOUT86_SELE_4_PORT14_PIN6, TOUT91_SELG_6_PORT13_PIN0, TOUT92_SELA_0_PORT13_PIN1, TOUT97_SELG_6_PORT11_PIN6, TOUT98_SELF_5_PORT11_PIN9, TOUT99_SELF_5_PORT11_PIN10, TOUT100_SELF_5_PORT11_PIN11, TOUT101_SELF_5_PORT11_PIN12, TOUT119_SELG_6_PORT11_PIN0, TOUT123_SELG_6_PORT11_PIN7, TOUT130_SELG_6_PORT22_PIN4, TOUT150_SELE_4_PORT34_PIN5, TOUT15_SELG_6_PORT00_PIN6, TOUT16_SELG_6_PORT00_PIN7, TOUT25_SELA_0_PORT33_PIN3, TOUT28_SELE_4_PORT33_PIN6, TOUT31_SELG_6_PORT33_PIN9, TOUT32_SELG_6_PORT33_PIN10, TOUT33_SELE_4_PORT33_PIN11, TOUT39_SELE_4_PORT32_PIN3, TOUT42_SELE_4_PORT23_PIN1, TOUT45_SELA_0_PORT23_PIN4, TOUT50_SELG_6_PORT22_PIN3, TOUT55_SELE_4_PORT21_PIN4, TOUT6_SELG_6_PORT02_PIN6, TOUT70_SELF_5_PORT20_PIN14, TOUT71_SELG_6_PORT15_PIN0, TOUT79_SELF_5_PORT15_PIN8, TOUT7_SELG_6_PORT02_PIN7, TOUT81_SELE_4_PORT14_PIN1, TOUT84_SELA_0_PORT14_PIN4, TOUT84_SELE_4_PORT14_PIN4, TOUT88_SELE_4_PORT14_PIN8, TOUT92_SELG_6_PORT13_PIN1, TOUT93_SELA_0_PORT13_PIN2, TOUT93_SELG_6_PORT13_PIN2, TOUT0_SELA_0_PORT02_PIN0, TOUT48_SELA_0_PORT22_PIN1, TOUT51_SELA_0_PORT21_PIN0, TOUT8_SELA_0_PORT02_PIN8, TOUT94_SELA_0_PORT13_PIN3, TOUT95_SELA_0_PORT11_PIN2, TOUT9_SELA_0_PORT00_PIN0, TOUT10_SELA_0_PORT00_PIN1, TOUT11_SELA_0_PORT00_PIN2, TOUT1_SELA_0_PORT02_PIN1, TOUT47_SELA_0_PORT22_PIN0, TOUT52_SELA_0_PORT21_PIN1, TOUT12_SELA_0_PORT00_PIN3, TOUT2_SELA_0_PORT02_PIN2, TOUT41_SELA_0_PORT23_PIN0, TOUT46_SELA_0_PORT23_PIN5, TOUT96_SELA_0_PORT11_PIN3, TOUT13_SELA_0_PORT00_PIN4, TOUT3_SELA_0_PORT02_PIN3, TOUT43_SELA_0_PORT23_PIN2, TOUT49_SELA_0_PORT22_PIN2, TOUT97_SELA_0_PORT11_PIN6, TOUT14_SELA_0_PORT00_PIN5, TOUT44_SELA_0_PORT23_PIN3, TOUT4_SELA_0_PORT02_PIN4, TOUT50_SELA_0_PORT22_PIN3, TOUT98_SELA_0_PORT11_PIN9, TOUT15_SELA_0_PORT00_PIN6, TOUT5_SELA_0_PORT02_PIN5, TOUT99_SELA_0_PORT11_PIN10, TOUT100_SELA_0_PORT11_PIN11, TOUT16_SELA_0_PORT00_PIN7, TOUT6_SELA_0_PORT02_PIN6, TOUT101_SELA_0_PORT11_PIN12, TOUT17_SELA_0_PORT00_PIN8, TOUT42_SELB_1_PORT23_PIN1, TOUT7_SELA_0_PORT02_PIN7, TOUT0_SELF_5_PORT02_PIN0, TOUT17_SELF_5_PORT00_PIN8, TOUT18_SELB_1_PORT00_PIN9, TOUT25_SELF_5_PORT33_PIN3, TOUT26_SELB_1_PORT33_PIN4, TOUT32_SELB_1_PORT33_PIN10, TOUT34_SELF_5_PORT33_PIN12, TOUT68_SELA_0_PORT20_PIN12, TOUT75_SELF_5_PORT15_PIN4, TOUT76_SELB_1_PORT15_PIN5, TOUT77_SELB_1_PORT15_PIN6, TOUT7_SELF_5_PORT02_PIN7, TOUT85_SELB_1_PORT14_PIN5, TOUT8_SELB_1_PORT02_PIN8, TOUT9_SELB_1_PORT00_PIN0, TOUT10_SELB_1_PORT00_PIN1, TOUT116_SELE_4_PORT02_PIN9, TOUT11_SELB_1_PORT00_PIN2, TOUT14_SELF_5_PORT00_PIN5, TOUT19_SELB_1_PORT00_PIN10, TOUT1_SELF_5_PORT02_PIN1, TOUT22_SELF_5_PORT33_PIN0, TOUT242_SELA_0_PORT15_PIN10, TOUT245_SELG_6_PORT15_PIN13, TOUT27_SELB_1_PORT33_PIN5, TOUT30_SELF_5_PORT33_PIN8, TOUT31_SELB_1_PORT33_PIN9, TOUT35_SELF_5_PORT33_PIN13, TOUT39_SELH_7_PORT32_PIN3, TOUT4_SELF_5_PORT02_PIN4, TOUT69_SELA_0_PORT20_PIN13, TOUT72_SELF_5_PORT15_PIN1, TOUT78_SELB_1_PORT15_PIN7, TOUT86_SELB_1_PORT14_PIN6, TOUT117_SELE_4_PORT02_PIN10, TOUT12_SELB_1_PORT00_PIN3, TOUT143_SELH_7_PORT33_PIN14, TOUT15_SELF_5_PORT00_PIN6, TOUT20_SELB_1_PORT00_PIN11, TOUT23_SELF_5_PORT33_PIN1, TOUT243_SELA_0_PORT15_PIN11, TOUT246_SELG_6_PORT15_PIN14, TOUT28_SELB_1_PORT33_PIN6, TOUT2_SELF_5_PORT02_PIN2, TOUT33_SELB_1_PORT33_PIN11, TOUT40_SELH_7_PORT32_PIN4, TOUT41_SELF_5_PORT23_PIN0, TOUT5_SELF_5_PORT02_PIN5, TOUT70_SELA_0_PORT20_PIN14, TOUT73_SELF_5_PORT15_PIN2, TOUT79_SELB_1_PORT15_PIN8, TOUT118_SELE_4_PORT02_PIN11, TOUT13_SELB_1_PORT00_PIN4, TOUT144_SELH_7_PORT33_PIN15, TOUT16_SELF_5_PORT00_PIN7, TOUT21_SELB_1_PORT00_PIN12, TOUT244_SELA_0_PORT15_PIN12, TOUT247_SELG_6_PORT15_PIN15, TOUT24_SELF_5_PORT33_PIN2, TOUT29_SELB_1_PORT33_PIN7, TOUT38_SELB_1_PORT32_PIN2, TOUT3_SELF_5_PORT02_PIN3, TOUT43_SELG_6_PORT23_PIN2, TOUT6_SELF_5_PORT02_PIN6, TOUT71_SELA_0_PORT15_PIN0, TOUT74_SELF_5_PORT15_PIN3, TOUT80_SELB_1_PORT14_PIN0, TOUT0_SELH_7_PORT02_PIN0, TOUT10_SELH_7_PORT00_PIN1, TOUT124_SELH_7_PORT11_PIN8, TOUT13_SELF_5_PORT00_PIN4, TOUT143_SELF_5_PORT33_PIN14, TOUT147_SELF_5_PORT34_PIN2, TOUT14_SELB_1_PORT00_PIN5, TOUT1_SELH_7_PORT02_PIN1, TOUT21_SELF_5_PORT00_PIN12, TOUT22_SELB_1_PORT33_PIN0, TOUT244_SELG_6_PORT15_PIN12, TOUT245_SELA_0_PORT15_PIN13, TOUT29_SELF_5_PORT33_PIN7, TOUT30_SELB_1_PORT33_PIN8, TOUT36_SELF_5_PORT32_PIN0, TOUT37_SELF_5_PORT32_PIN1, TOUT39_SELB_1_PORT32_PIN3, TOUT53_SELH_7_PORT21_PIN2, TOUT54_SELH_7_PORT21_PIN3, TOUT64_SELG_6_PORT20_PIN8, TOUT65_SELG_6_PORT20_PIN9, TOUT71_SELF_5_PORT15_PIN0, TOUT72_SELA_0_PORT15_PIN1, TOUT72_SELH_7_PORT15_PIN1, TOUT73_SELH_7_PORT15_PIN2, TOUT81_SELB_1_PORT14_PIN1, TOUT8_SELH_7_PORT02_PIN8, TOUT94_SELH_7_PORT13_PIN3, TOUT95_SELH_7_PORT11_PIN2, TOUT9_SELH_7_PORT00_PIN0, TOUT11_SELH_7_PORT00_PIN2, TOUT12_SELH_7_PORT00_PIN3, TOUT144_SELF_5_PORT33_PIN15, TOUT148_SELF_5_PORT34_PIN3, TOUT15_SELB_1_PORT00_PIN6, TOUT18_SELF_5_PORT00_PIN9, TOUT23_SELB_1_PORT33_PIN1, TOUT246_SELA_0_PORT15_PIN14, TOUT26_SELF_5_PORT33_PIN4, TOUT27_SELH_7_PORT33_PIN5, TOUT28_SELH_7_PORT33_PIN6, TOUT2_SELH_7_PORT02_PIN2, TOUT32_SELF_5_PORT33_PIN10, TOUT37_SELH_7_PORT32_PIN1, TOUT3_SELH_7_PORT02_PIN3, TOUT40_SELB_1_PORT32_PIN4, TOUT41_SELB_1_PORT23_PIN0, TOUT55_SELH_7_PORT21_PIN4, TOUT56_SELH_7_PORT21_PIN5, TOUT66_SELG_6_PORT20_PIN10, TOUT67_SELG_6_PORT20_PIN11, TOUT73_SELA_0_PORT15_PIN2, TOUT74_SELH_7_PORT15_PIN3, TOUT76_SELH_7_PORT15_PIN5, TOUT77_SELG_6_PORT15_PIN6, TOUT82_SELB_1_PORT14_PIN2, TOUT96_SELH_7_PORT11_PIN3, TOUT97_SELH_7_PORT11_PIN6, TOUT9_SELF_5_PORT00_PIN0, TOUT10_SELF_5_PORT00_PIN1, TOUT11_SELF_5_PORT00_PIN2, TOUT13_SELH_7_PORT00_PIN4, TOUT149_SELF_5_PORT34_PIN4, TOUT14_SELH_7_PORT00_PIN5, TOUT16_SELB_1_PORT00_PIN7, TOUT19_SELF_5_PORT00_PIN10, TOUT242_SELG_6_PORT15_PIN10, TOUT247_SELA_0_PORT15_PIN15, TOUT24_SELB_1_PORT33_PIN2, TOUT27_SELF_5_PORT33_PIN5, TOUT29_SELH_7_PORT33_PIN7, TOUT30_SELH_7_PORT33_PIN8, TOUT31_SELF_5_PORT33_PIN9, TOUT38_SELF_5_PORT32_PIN2, TOUT40_SELF_5_PORT32_PIN4, TOUT43_SELB_1_PORT23_PIN2, TOUT48_SELH_7_PORT22_PIN1, TOUT49_SELH_7_PORT22_PIN2, TOUT4_SELH_7_PORT02_PIN4, TOUT5_SELH_7_PORT02_PIN5, TOUT68_SELG_6_PORT20_PIN12, TOUT69_SELG_6_PORT20_PIN13, TOUT74_SELA_0_PORT15_PIN3, TOUT78_SELG_6_PORT15_PIN7, TOUT80_SELF_5_PORT14_PIN0, TOUT82_SELF_5_PORT14_PIN2, TOUT83_SELB_1_PORT14_PIN3, TOUT91_SELH_7_PORT13_PIN0, TOUT98_SELH_7_PORT11_PIN9, TOUT99_SELH_7_PORT11_PIN10, TOUT100_SELH_7_PORT11_PIN11, TOUT101_SELH_7_PORT11_PIN12, TOUT12_SELF_5_PORT00_PIN3, TOUT130_SELH_7_PORT22_PIN4, TOUT150_SELF_5_PORT34_PIN5, TOUT15_SELH_7_PORT00_PIN6, TOUT16_SELH_7_PORT00_PIN7, TOUT17_SELB_1_PORT00_PIN8, TOUT20_SELF_5_PORT00_PIN11, TOUT243_SELG_6_PORT15_PIN11, TOUT248_SELA_0_PORT13_PIN9, TOUT25_SELB_1_PORT33_PIN3, TOUT28_SELF_5_PORT33_PIN6, TOUT31_SELH_7_PORT33_PIN9, TOUT32_SELH_7_PORT33_PIN10, TOUT33_SELF_5_PORT33_PIN11, TOUT39_SELF_5_PORT32_PIN3, TOUT42_SELF_5_PORT23_PIN1, TOUT44_SELB_1_PORT23_PIN3, TOUT45_SELB_1_PORT23_PIN4, TOUT50_SELH_7_PORT22_PIN3, TOUT64_SELA_0_PORT20_PIN8, TOUT6_SELH_7_PORT02_PIN6, TOUT70_SELG_6_PORT20_PIN14, TOUT71_SELH_7_PORT15_PIN0, TOUT75_SELA_0_PORT15_PIN4, TOUT79_SELG_6_PORT15_PIN8, TOUT7_SELH_7_PORT02_PIN7, TOUT81_SELF_5_PORT14_PIN1, TOUT84_SELB_1_PORT14_PIN4, TOUT84_SELF_5_PORT14_PIN4, TOUT92_SELH_7_PORT13_PIN1, TOUT93_SELH_7_PORT13_PIN2, TOUT0_SELB_1_PORT02_PIN0, TOUT128_SELA_0_PORT12_PIN0, TOUT141_SELA_0_PORT32_PIN6, TOUT249_SELA_0_PORT13_PIN12, TOUT129_SELA_0_PORT12_PIN1, TOUT142_SELA_0_PORT32_PIN7, TOUT1_SELB_1_PORT02_PIN1, TOUT265_SELA_0_PORT10_PIN9, TOUT143_SELA_0_PORT33_PIN14, TOUT266_SELA_0_PORT10_PIN10, TOUT2_SELB_1_PORT02_PIN2, TOUT62_SELA_0_PORT20_PIN6, TOUT144_SELA_0_PORT33_PIN15, TOUT267_SELA_0_PORT10_PIN14, TOUT3_SELB_1_PORT02_PIN3, TOUT60_SELA_0_PORT20_PIN1, TOUT63_SELA_0_PORT20_PIN7, TOUT268_SELA_0_PORT10_PIN13, TOUT34_SELA_0_PORT33_PIN12, TOUT4_SELB_1_PORT02_PIN4, TOUT61_SELA_0_PORT20_PIN3, TOUT146_SELA_0_PORT34_PIN1, TOUT269_SELA_0_PORT10_PIN11, TOUT35_SELA_0_PORT33_PIN13, TOUT5_SELB_1_PORT02_PIN5, TOUT65_SELA_0_PORT20_PIN9, TOUT147_SELA_0_PORT34_PIN2, TOUT270_SELA_0_PORT10_PIN15, TOUT36_SELA_0_PORT32_PIN0, TOUT66_SELA_0_PORT20_PIN10, TOUT6_SELB_1_PORT02_PIN6, TOUT148_SELA_0_PORT34_PIN3, TOUT150_SELA_0_PORT34_PIN5, TOUT37_SELA_0_PORT32_PIN1, TOUT67_SELA_0_PORT20_PIN11, TOUT7_SELB_1_PORT02_PIN7, TOUT101_SELE_4_PORT11_PIN12, TOUT119_SELA_0_PORT11_PIN0, TOUT120_SELG_6_PORT11_PIN1, TOUT126_SELG_6_PORT11_PIN14, TOUT250_SELA_0_PORT13_PIN11, TOUT264_SELE_4_PORT13_PIN15, TOUT43_SELE_4_PORT23_PIN2, TOUT48_SELB_1_PORT22_PIN1, TOUT51_SELE_4_PORT21_PIN0, TOUT53_SELB_1_PORT21_PIN2, TOUT61_SELE_4_PORT20_PIN3, TOUT65_SELE_4_PORT20_PIN9, TOUT76_SELE_4_PORT15_PIN5, TOUT87_SELB_1_PORT14_PIN7, TOUT91_SELF_5_PORT13_PIN0, TOUT94_SELB_1_PORT13_PIN3, TOUT95_SELG_6_PORT11_PIN2, TOUT120_SELA_0_PORT11_PIN1, TOUT123_SELE_4_PORT11_PIN7, TOUT124_SELG_6_PORT11_PIN8, TOUT127_SELE_4_PORT11_PIN15, TOUT251_SELA_0_PORT13_PIN10, TOUT254_SELE_4_PORT13_PIN5, TOUT44_SELE_4_PORT23_PIN3, TOUT47_SELB_1_PORT22_PIN0, TOUT50_SELF_5_PORT22_PIN3, TOUT52_SELE_4_PORT21_PIN1, TOUT54_SELB_1_PORT21_PIN3, TOUT57_SELF_5_PORT21_PIN6, TOUT61_SELG_6_PORT20_PIN3, TOUT64_SELE_4_PORT20_PIN8, TOUT79_SELE_4_PORT15_PIN8, TOUT90_SELF_5_PORT14_PIN10, TOUT92_SELF_5_PORT13_PIN1, TOUT95_SELB_1_PORT11_PIN2, TOUT98_SELE_4_PORT11_PIN9, TOUT121_SELA_0_PORT11_PIN4, TOUT124_SELE_4_PORT11_PIN8, TOUT125_SELE_4_PORT11_PIN13, TOUT252_SELA_0_PORT13_PIN14, TOUT255_SELE_4_PORT13_PIN6, TOUT46_SELB_1_PORT23_PIN5, TOUT46_SELE_4_PORT23_PIN5, TOUT50_SELE_4_PORT22_PIN3, TOUT55_SELB_1_PORT21_PIN4, TOUT58_SELF_5_PORT21_PIN7, TOUT63_SELE_4_PORT20_PIN7, TOUT78_SELE_4_PORT15_PIN7, TOUT88_SELB_1_PORT14_PIN8, TOUT93_SELF_5_PORT13_PIN2, TOUT96_SELB_1_PORT11_PIN3, TOUT99_SELE_4_PORT11_PIN10, TOUT100_SELE_4_PORT11_PIN11, TOUT106_SELG_6_PORT10_PIN4, TOUT122_SELA_0_PORT11_PIN5, TOUT122_SELF_5_PORT11_PIN5, TOUT126_SELE_4_PORT11_PIN14, TOUT253_SELA_0_PORT13_PIN4, TOUT256_SELE_4_PORT13_PIN7, TOUT45_SELE_4_PORT23_PIN4, TOUT49_SELB_1_PORT22_PIN2, TOUT56_SELB_1_PORT21_PIN5, TOUT59_SELF_5_PORT20_PIN0, TOUT60_SELB_1_PORT20_PIN1, TOUT62_SELE_4_PORT20_PIN6, TOUT77_SELE_4_PORT15_PIN6, TOUT89_SELB_1_PORT14_PIN9, TOUT97_SELB_1_PORT11_PIN6, TOUT102_SELF_5_PORT10_PIN0, TOUT106_SELF_5_PORT10_PIN4, TOUT120_SELF_5_PORT11_PIN1, TOUT122_SELE_4_PORT11_PIN5, TOUT123_SELA_0_PORT11_PIN7, TOUT126_SELF_5_PORT11_PIN14, TOUT133_SELE_4_PORT22_PIN7, TOUT137_SELE_4_PORT22_PIN11, TOUT253_SELE_4_PORT13_PIN4, TOUT254_SELA_0_PORT13_PIN5, TOUT50_SELB_1_PORT22_PIN3, TOUT56_SELF_5_PORT21_PIN5, TOUT57_SELB_1_PORT21_PIN6, TOUT60_SELF_5_PORT20_PIN1, TOUT61_SELB_1_PORT20_PIN3, TOUT89_SELF_5_PORT14_PIN9, TOUT90_SELB_1_PORT14_PIN10, TOUT97_SELE_4_PORT11_PIN6, TOUT98_SELB_1_PORT11_PIN9, TOUT103_SELF_5_PORT10_PIN1, TOUT107_SELF_5_PORT10_PIN5, TOUT119_SELE_4_PORT11_PIN0, TOUT119_SELF_5_PORT11_PIN0, TOUT124_SELA_0_PORT11_PIN8, TOUT132_SELE_4_PORT22_PIN6, TOUT136_SELE_4_PORT22_PIN10, TOUT250_SELE_4_PORT13_PIN11, TOUT255_SELA_0_PORT13_PIN6, TOUT53_SELF_5_PORT21_PIN2, TOUT58_SELB_1_PORT21_PIN7, TOUT87_SELF_5_PORT14_PIN7, TOUT91_SELB_1_PORT13_PIN0, TOUT94_SELF_5_PORT13_PIN3, TOUT99_SELB_1_PORT11_PIN10, TOUT100_SELB_1_PORT11_PIN11, TOUT104_SELF_5_PORT10_PIN2, TOUT106_SELB_1_PORT10_PIN4, TOUT108_SELF_5_PORT10_PIN6, TOUT120_SELE_4_PORT11_PIN1, TOUT122_SELG_6_PORT11_PIN5, TOUT125_SELA_0_PORT11_PIN13, TOUT131_SELE_4_PORT22_PIN5, TOUT135_SELE_4_PORT22_PIN9, TOUT251_SELE_4_PORT13_PIN10, TOUT256_SELA_0_PORT13_PIN7, TOUT54_SELF_5_PORT21_PIN3, TOUT59_SELB_1_PORT20_PIN0, TOUT86_SELF_5_PORT14_PIN6, TOUT92_SELB_1_PORT13_PIN1, TOUT95_SELE_4_PORT11_PIN2, TOUT101_SELB_1_PORT11_PIN12, TOUT105_SELF_5_PORT10_PIN3, TOUT109_SELF_5_PORT10_PIN7, TOUT121_SELE_4_PORT11_PIN4, TOUT126_SELA_0_PORT11_PIN14, TOUT130_SELA_0_PORT22_PIN4, TOUT134_SELE_4_PORT22_PIN8, TOUT252_SELE_4_PORT13_PIN14, TOUT264_SELG_6_PORT13_PIN15, TOUT55_SELF_5_PORT21_PIN4, TOUT64_SELB_1_PORT20_PIN8, TOUT88_SELF_5_PORT14_PIN8, TOUT93_SELB_1_PORT13_PIN2, TOUT96_SELE_4_PORT11_PIN3, TOUT98_SELG_6_PORT11_PIN9, TOUT109_SELB_1_PORT10_PIN7, TOUT127_SELA_0_PORT11_PIN15, TOUT131_SELA_0_PORT22_PIN5, TOUT258_SELA_0_PORT14_PIN11, TOUT51_SELB_1_PORT21_PIN0, TOUT68_SELB_1_PORT20_PIN12, TOUT103_SELB_1_PORT10_PIN1, TOUT132_SELA_0_PORT22_PIN6, TOUT259_SELA_0_PORT14_PIN14, TOUT52_SELB_1_PORT21_PIN1, TOUT69_SELB_1_PORT20_PIN13, TOUT104_SELB_1_PORT10_PIN2, TOUT107_SELB_1_PORT10_PIN5, TOUT133_SELA_0_PORT22_PIN7, TOUT260_SELA_0_PORT14_PIN13, TOUT62_SELB_1_PORT20_PIN6, TOUT70_SELB_1_PORT20_PIN14, TOUT105_SELB_1_PORT10_PIN3, TOUT108_SELB_1_PORT10_PIN6, TOUT134_SELA_0_PORT22_PIN8, TOUT261_SELA_0_PORT14_PIN12, TOUT63_SELB_1_PORT20_PIN7, TOUT71_SELB_1_PORT15_PIN0, TOUT102_SELB_1_PORT10_PIN0, TOUT135_SELA_0_PORT22_PIN9, TOUT262_SELA_0_PORT13_PIN13, TOUT34_SELB_1_PORT33_PIN12, TOUT72_SELB_1_PORT15_PIN1, TOUT110_SELB_1_PORT10_PIN8, TOUT136_SELA_0_PORT22_PIN10, TOUT263_SELA_0_PORT14_PIN15, TOUT35_SELB_1_PORT33_PIN13, TOUT65_SELB_1_PORT20_PIN9, TOUT73_SELB_1_PORT15_PIN2, TOUT137_SELA_0_PORT22_PIN11, TOUT264_SELA_0_PORT13_PIN15, TOUT36_SELB_1_PORT32_PIN0, TOUT66_SELB_1_PORT20_PIN10, TOUT74_SELB_1_PORT15_PIN3, TOUT149_SELA_0_PORT34_PIN4, TOUT37_SELB_1_PORT32_PIN1, TOUT67_SELB_1_PORT20_PIN11, TOUT75_SELB_1_PORT15_PIN4, TOUT110_SELE_4_PORT10_PIN8, TOUT115_SELF_5_PORT01_PIN7, TOUT130_SELF_5_PORT22_PIN4, TOUT134_SELG_6_PORT22_PIN8, TOUT155_SELA_0_PORT01_PIN0, TOUT161_SELE_4_PORT01_PIN13, TOUT162_SELE_4_PORT01_PIN8, TOUT174_SELA_0_PORT31_PIN0, TOUT181_SELE_4_PORT31_PIN7, TOUT206_SELA_0_PORT25_PIN0, TOUT213_SELE_4_PORT25_PIN7, TOUT8_SELF_5_PORT02_PIN8, TOUT111_SELA_0_PORT01_PIN3, TOUT114_SELF_5_PORT01_PIN6, TOUT116_SELF_5_PORT02_PIN9, TOUT131_SELF_5_PORT22_PIN5, TOUT135_SELG_6_PORT22_PIN9, TOUT156_SELA_0_PORT01_PIN2, TOUT158_SELE_4_PORT01_PIN12, TOUT163_SELE_4_PORT01_PIN10, TOUT175_SELA_0_PORT31_PIN1, TOUT178_SELE_4_PORT31_PIN4, TOUT207_SELA_0_PORT25_PIN1, TOUT210_SELE_4_PORT25_PIN4, TOUT242_SELB_1_PORT15_PIN10, TOUT245_SELF_5_PORT15_PIN13, TOUT265_SELE_4_PORT10_PIN9, TOUT268_SELE_4_PORT10_PIN13, TOUT112_SELB_1_PORT01_PIN4, TOUT117_SELF_5_PORT02_PIN10, TOUT132_SELF_5_PORT22_PIN6, TOUT136_SELG_6_PORT22_PIN10, TOUT157_SELA_0_PORT01_PIN15, TOUT159_SELE_4_PORT01_PIN1, TOUT164_SELE_4_PORT01_PIN14, TOUT176_SELA_0_PORT31_PIN2, TOUT179_SELE_4_PORT31_PIN5, TOUT208_SELA_0_PORT25_PIN2, TOUT211_SELE_4_PORT25_PIN5, TOUT243_SELB_1_PORT15_PIN11, TOUT246_SELF_5_PORT15_PIN14, TOUT266_SELE_4_PORT10_PIN10, TOUT267_SELE_4_PORT10_PIN14, TOUT113_SELB_1_PORT01_PIN5, TOUT118_SELF_5_PORT02_PIN11, TOUT133_SELF_5_PORT22_PIN7, TOUT137_SELG_6_PORT22_PIN11, TOUT160_SELE_4_PORT01_PIN9, TOUT165_SELA_0_PORT01_PIN11, TOUT177_SELA_0_PORT31_PIN3, TOUT180_SELE_4_PORT31_PIN6, TOUT209_SELA_0_PORT25_PIN3, TOUT212_SELE_4_PORT25_PIN6, TOUT212_SELE_4_PORT26_PIN0, TOUT244_SELB_1_PORT15_PIN12, TOUT247_SELF_5_PORT15_PIN15, TOUT269_SELE_4_PORT10_PIN11, TOUT270_SELE_4_PORT10_PIN15, TOUT110_SELF_5_PORT10_PIN8, TOUT111_SELF_5_PORT01_PIN3, TOUT114_SELB_1_PORT01_PIN6, TOUT134_SELF_5_PORT22_PIN8, TOUT151_SELF_5_PORT02_PIN12, TOUT158_SELA_0_PORT01_PIN12, TOUT165_SELE_4_PORT01_PIN11, TOUT177_SELE_4_PORT31_PIN3, TOUT178_SELA_0_PORT31_PIN4, TOUT209_SELE_4_PORT25_PIN3, TOUT210_SELA_0_PORT25_PIN4, TOUT244_SELF_5_PORT15_PIN12, TOUT245_SELB_1_PORT15_PIN13, TOUT115_SELB_1_PORT01_PIN7, TOUT135_SELF_5_PORT22_PIN9, TOUT153_SELF_5_PORT02_PIN13, TOUT155_SELE_4_PORT01_PIN0, TOUT159_SELA_0_PORT01_PIN1, TOUT166_SELF_5_PORT00_PIN14, TOUT174_SELE_4_PORT31_PIN0, TOUT179_SELA_0_PORT31_PIN5, TOUT206_SELE_4_PORT25_PIN0, TOUT211_SELA_0_PORT25_PIN5, TOUT246_SELB_1_PORT15_PIN14, TOUT265_SELF_5_PORT10_PIN9, TOUT268_SELF_5_PORT10_PIN13, TOUT136_SELF_5_PORT22_PIN10, TOUT154_SELF_5_PORT02_PIN14, TOUT156_SELE_4_PORT01_PIN2, TOUT160_SELA_0_PORT01_PIN9, TOUT175_SELE_4_PORT31_PIN1, TOUT180_SELA_0_PORT31_PIN6, TOUT207_SELE_4_PORT25_PIN1, TOUT212_SELA_0_PORT25_PIN6, TOUT212_SELA_0_PORT26_PIN0, TOUT242_SELF_5_PORT15_PIN10, TOUT247_SELB_1_PORT15_PIN15, TOUT266_SELF_5_PORT10_PIN10, TOUT267_SELF_5_PORT10_PIN14, TOUT137_SELF_5_PORT22_PIN11, TOUT152_SELF_5_PORT02_PIN15, TOUT157_SELE_4_PORT01_PIN15, TOUT161_SELA_0_PORT01_PIN13, TOUT176_SELE_4_PORT31_PIN2, TOUT181_SELA_0_PORT31_PIN7, TOUT208_SELE_4_PORT25_PIN2, TOUT213_SELA_0_PORT25_PIN7, TOUT243_SELF_5_PORT15_PIN11, TOUT248_SELB_1_PORT13_PIN9, TOUT269_SELF_5_PORT10_PIN11, TOUT270_SELF_5_PORT10_PIN15, TOUT162_SELA_0_PORT01_PIN8, TOUT182_SELA_0_PORT31_PIN8, TOUT186_SELE_4_PORT31_PIN12, TOUT214_SELA_0_PORT25_PIN8, TOUT218_SELE_4_PORT25_PIN12, TOUT249_SELB_1_PORT13_PIN12, TOUT163_SELA_0_PORT01_PIN10, TOUT183_SELA_0_PORT31_PIN9, TOUT187_SELE_4_PORT31_PIN13, TOUT215_SELA_0_PORT25_PIN9, TOUT219_SELE_4_PORT25_PIN13, TOUT265_SELB_1_PORT10_PIN9, TOUT164_SELA_0_PORT01_PIN14, TOUT184_SELA_0_PORT31_PIN10, TOUT188_SELE_4_PORT31_PIN14, TOUT216_SELA_0_PORT25_PIN10, TOUT220_SELE_4_PORT25_PIN14, TOUT266_SELB_1_PORT10_PIN10, TOUT166_SELA_0_PORT00_PIN14, TOUT185_SELA_0_PORT31_PIN11, TOUT189_SELE_4_PORT31_PIN15, TOUT217_SELA_0_PORT25_PIN11, TOUT221_SELE_4_PORT25_PIN15, TOUT267_SELB_1_PORT10_PIN14, TOUT167_SELA_0_PORT00_PIN13, TOUT186_SELA_0_PORT31_PIN12, TOUT218_SELA_0_PORT25_PIN12, TOUT268_SELB_1_PORT10_PIN13, TOUT138_SELB_1_PORT23_PIN6, TOUT168_SELA_0_PORT00_PIN15, TOUT187_SELA_0_PORT31_PIN13, TOUT219_SELA_0_PORT25_PIN13, TOUT269_SELB_1_PORT10_PIN11, TOUT139_SELB_1_PORT23_PIN7, TOUT151_SELA_0_PORT02_PIN12, TOUT153_SELA_0_PORT02_PIN13, TOUT188_SELA_0_PORT31_PIN14, TOUT220_SELA_0_PORT25_PIN14, TOUT270_SELB_1_PORT10_PIN15, TOUT140_SELB_1_PORT32_PIN5, TOUT152_SELA_0_PORT02_PIN15, TOUT154_SELA_0_PORT02_PIN14, TOUT189_SELA_0_PORT31_PIN15, TOUT221_SELA_0_PORT25_PIN15, TOUT155_SELB_1_PORT01_PIN0, TOUT161_SELF_5_PORT01_PIN13, TOUT162_SELF_5_PORT01_PIN8, TOUT167_SELE_4_PORT00_PIN13, TOUT190_SELA_0_PORT30_PIN0, TOUT197_SELE_4_PORT30_PIN7, TOUT222_SELA_0_PORT24_PIN0, TOUT229_SELE_4_PORT24_PIN7, TOUT250_SELB_1_PORT13_PIN11, TOUT264_SELF_5_PORT13_PIN15, TOUT156_SELB_1_PORT01_PIN2, TOUT158_SELF_5_PORT01_PIN12, TOUT163_SELF_5_PORT01_PIN10, TOUT166_SELE_4_PORT00_PIN14, TOUT191_SELA_0_PORT30_PIN1, TOUT194_SELE_4_PORT30_PIN4, TOUT223_SELA_0_PORT24_PIN1, TOUT226_SELE_4_PORT24_PIN4, TOUT251_SELB_1_PORT13_PIN10, TOUT254_SELF_5_PORT13_PIN5, TOUT157_SELB_1_PORT01_PIN15, TOUT159_SELF_5_PORT01_PIN1, TOUT164_SELF_5_PORT01_PIN14, TOUT192_SELA_0_PORT30_PIN2, TOUT195_SELE_4_PORT30_PIN5, TOUT224_SELA_0_PORT24_PIN2, TOUT227_SELE_4_PORT24_PIN5, TOUT252_SELB_1_PORT13_PIN14, TOUT255_SELF_5_PORT13_PIN6, TOUT160_SELF_5_PORT01_PIN9, TOUT165_SELB_1_PORT01_PIN11, TOUT193_SELA_0_PORT30_PIN3, TOUT196_SELE_4_PORT30_PIN6, TOUT225_SELA_0_PORT24_PIN3, TOUT228_SELE_4_PORT24_PIN6, TOUT253_SELB_1_PORT13_PIN4, TOUT256_SELF_5_PORT13_PIN7, TOUT111_SELE_4_PORT01_PIN3, TOUT112_SELE_4_PORT01_PIN4, TOUT151_SELE_4_PORT02_PIN12, TOUT158_SELB_1_PORT01_PIN12, TOUT165_SELF_5_PORT01_PIN11, TOUT193_SELE_4_PORT30_PIN3, TOUT194_SELA_0_PORT30_PIN4, TOUT225_SELE_4_PORT24_PIN3, TOUT226_SELA_0_PORT24_PIN4, TOUT253_SELF_5_PORT13_PIN4, TOUT254_SELB_1_PORT13_PIN5, TOUT8_SELE_4_PORT02_PIN8, TOUT113_SELE_4_PORT01_PIN5, TOUT116_SELB_1_PORT02_PIN9, TOUT153_SELE_4_PORT02_PIN13, TOUT155_SELF_5_PORT01_PIN0, TOUT159_SELB_1_PORT01_PIN1, TOUT190_SELE_4_PORT30_PIN0, TOUT195_SELA_0_PORT30_PIN5, TOUT222_SELE_4_PORT24_PIN0, TOUT227_SELA_0_PORT24_PIN5, TOUT250_SELF_5_PORT13_PIN11, TOUT255_SELB_1_PORT13_PIN6, TOUT114_SELE_4_PORT01_PIN6, TOUT117_SELB_1_PORT02_PIN10, TOUT154_SELE_4_PORT02_PIN14, TOUT156_SELF_5_PORT01_PIN2, TOUT160_SELB_1_PORT01_PIN9, TOUT191_SELE_4_PORT30_PIN1, TOUT196_SELA_0_PORT30_PIN6, TOUT223_SELE_4_PORT24_PIN1, TOUT228_SELA_0_PORT24_PIN6, TOUT251_SELF_5_PORT13_PIN10, TOUT256_SELB_1_PORT13_PIN7, TOUT115_SELE_4_PORT01_PIN7, TOUT118_SELB_1_PORT02_PIN11, TOUT152_SELE_4_PORT02_PIN15, TOUT157_SELF_5_PORT01_PIN15, TOUT161_SELB_1_PORT01_PIN13, TOUT192_SELE_4_PORT30_PIN2, TOUT197_SELA_0_PORT30_PIN7, TOUT224_SELE_4_PORT24_PIN2, TOUT229_SELA_0_PORT24_PIN7, TOUT252_SELF_5_PORT13_PIN14, TOUT264_SELH_7_PORT13_PIN15, TOUT162_SELB_1_PORT01_PIN8, TOUT198_SELA_0_PORT30_PIN8, TOUT202_SELE_4_PORT30_PIN12, TOUT230_SELA_0_PORT24_PIN8, TOUT258_SELB_1_PORT14_PIN11, TOUT163_SELB_1_PORT01_PIN10, TOUT199_SELA_0_PORT30_PIN9, TOUT203_SELE_4_PORT30_PIN13, TOUT231_SELA_0_PORT24_PIN9, TOUT259_SELB_1_PORT14_PIN14, TOUT164_SELB_1_PORT01_PIN14, TOUT200_SELA_0_PORT30_PIN10, TOUT204_SELE_4_PORT30_PIN14, TOUT232_SELA_0_PORT24_PIN10, TOUT260_SELB_1_PORT14_PIN13, TOUT166_SELB_1_PORT00_PIN14, TOUT201_SELA_0_PORT30_PIN11, TOUT205_SELE_4_PORT30_PIN15, TOUT233_SELA_0_PORT24_PIN11, TOUT261_SELB_1_PORT14_PIN12, TOUT167_SELB_1_PORT00_PIN13, TOUT202_SELA_0_PORT30_PIN12, TOUT230_SELE_4_PORT24_PIN8, TOUT234_SELA_0_PORT24_PIN12, TOUT262_SELB_1_PORT13_PIN13, TOUT168_SELB_1_PORT00_PIN15, TOUT203_SELA_0_PORT30_PIN13, TOUT231_SELE_4_PORT24_PIN9, TOUT235_SELA_0_PORT24_PIN13, TOUT263_SELB_1_PORT14_PIN15, TOUT151_SELB_1_PORT02_PIN12, TOUT153_SELB_1_PORT02_PIN13, TOUT204_SELA_0_PORT30_PIN14, TOUT232_SELE_4_PORT24_PIN10, TOUT236_SELA_0_PORT24_PIN14, TOUT264_SELB_1_PORT13_PIN15, TOUT152_SELB_1_PORT02_PIN15, TOUT154_SELB_1_PORT02_PIN14, TOUT205_SELA_0_PORT30_PIN15, TOUT233_SELE_4_PORT24_PIN11, TOUT237_SELA_0_PORT24_PIN15, TOUT140_SELE_4_PORT32_PIN5, TOUT174_SELB_1_PORT31_PIN0, TOUT190_SELB_1_PORT30_PIN0, TOUT206_SELB_1_PORT25_PIN0, TOUT222_SELB_1_PORT24_PIN0, TOUT242_SELE_4_PORT15_PIN10, TOUT141_SELE_4_PORT32_PIN6, TOUT175_SELB_1_PORT31_PIN1, TOUT191_SELB_1_PORT30_PIN1, TOUT207_SELB_1_PORT25_PIN1, TOUT223_SELB_1_PORT24_PIN1, TOUT243_SELE_4_PORT15_PIN11, TOUT142_SELE_4_PORT32_PIN7, TOUT176_SELB_1_PORT31_PIN2, TOUT192_SELB_1_PORT30_PIN2, TOUT208_SELB_1_PORT25_PIN2, TOUT224_SELB_1_PORT24_PIN2, TOUT244_SELE_4_PORT15_PIN12, TOUT138_SELE_4_PORT23_PIN6, TOUT177_SELB_1_PORT31_PIN3, TOUT193_SELB_1_PORT30_PIN3, TOUT209_SELB_1_PORT25_PIN3, TOUT212_SELJ_9_PORT25_PIN6, TOUT212_SELJ_9_PORT26_PIN0, TOUT225_SELB_1_PORT24_PIN3, TOUT258_SELE_4_PORT14_PIN11, TOUT139_SELE_4_PORT23_PIN7, TOUT178_SELB_1_PORT31_PIN4, TOUT194_SELB_1_PORT30_PIN4, TOUT210_SELB_1_PORT25_PIN4, TOUT226_SELB_1_PORT24_PIN4, TOUT261_SELE_4_PORT14_PIN12, TOUT179_SELB_1_PORT31_PIN5, TOUT195_SELB_1_PORT30_PIN5, TOUT211_SELB_1_PORT25_PIN5, TOUT227_SELB_1_PORT24_PIN5, TOUT260_SELE_4_PORT14_PIN13, TOUT180_SELB_1_PORT31_PIN6, TOUT196_SELB_1_PORT30_PIN6, TOUT212_SELB_1_PORT25_PIN6, TOUT212_SELB_1_PORT26_PIN0, TOUT228_SELB_1_PORT24_PIN6, TOUT259_SELE_4_PORT14_PIN14, TOUT181_SELB_1_PORT31_PIN7, TOUT197_SELB_1_PORT30_PIN7, TOUT213_SELB_1_PORT25_PIN7, TOUT229_SELB_1_PORT24_PIN7, TOUT263_SELE_4_PORT14_PIN15, TOUT182_SELB_1_PORT31_PIN8, TOUT186_SELF_5_PORT31_PIN12, TOUT198_SELB_1_PORT30_PIN8, TOUT202_SELF_5_PORT30_PIN12, TOUT214_SELB_1_PORT25_PIN8, TOUT218_SELF_5_PORT25_PIN12, TOUT230_SELB_1_PORT24_PIN8, TOUT183_SELB_1_PORT31_PIN9, TOUT187_SELF_5_PORT31_PIN13, TOUT199_SELB_1_PORT30_PIN9, TOUT203_SELF_5_PORT30_PIN13, TOUT215_SELB_1_PORT25_PIN9, TOUT219_SELF_5_PORT25_PIN13, TOUT231_SELB_1_PORT24_PIN9, TOUT184_SELB_1_PORT31_PIN10, TOUT188_SELF_5_PORT31_PIN14, TOUT200_SELB_1_PORT30_PIN10, TOUT204_SELF_5_PORT30_PIN14, TOUT216_SELB_1_PORT25_PIN10, TOUT220_SELF_5_PORT25_PIN14, TOUT232_SELB_1_PORT24_PIN10, TOUT185_SELB_1_PORT31_PIN11, TOUT189_SELF_5_PORT31_PIN15, TOUT201_SELB_1_PORT30_PIN11, TOUT205_SELF_5_PORT30_PIN15, TOUT217_SELB_1_PORT25_PIN11, TOUT221_SELF_5_PORT25_PIN15, TOUT233_SELB_1_PORT24_PIN11, TOUT186_SELB_1_PORT31_PIN12, TOUT202_SELB_1_PORT30_PIN12, TOUT218_SELB_1_PORT25_PIN12, TOUT230_SELF_5_PORT24_PIN8, TOUT234_SELB_1_PORT24_PIN12, TOUT187_SELB_1_PORT31_PIN13, TOUT203_SELB_1_PORT30_PIN13, TOUT219_SELB_1_PORT25_PIN13, TOUT231_SELF_5_PORT24_PIN9, TOUT235_SELB_1_PORT24_PIN13, TOUT188_SELB_1_PORT31_PIN14, TOUT204_SELB_1_PORT30_PIN14, TOUT220_SELB_1_PORT25_PIN14, TOUT232_SELF_5_PORT24_PIN10, TOUT236_SELB_1_PORT24_PIN14, TOUT189_SELB_1_PORT31_PIN15, TOUT205_SELB_1_PORT30_PIN15, TOUT221_SELB_1_PORT25_PIN15, TOUT233_SELF_5_PORT24_PIN11, TOUT237_SELB_1_PORT24_PIN15}, origin=INFINEON_AURIX2G, post-build-variant-value=true, set at post-build, default-value=NONE  # This parameter decides the output port and pin for the GTM timer.
        container GtmAtomGlobalConf [12..12]  # This container contains the configuration (parameters) for GTM ATOM unit global settings.
          container GtmAtomGroupConf  # This container contains the configuration (parameters) for GTM ATOM group settings.
            container GtmAtomActionTimeBaseUnitConf  # This container contains the configuration (parameters) for GTM ATOM group time base settings.
              enumeration GtmAtomActionTimeBaseSelection: {ATOM_ACT_TB_TBU_TS0, ATOM_ACT_TB_TBU_TS1, ATOM_ACT_TB_TBU_TS2}, origin=INFINEON_AURIX2G, post-build-variant-value=true, set at post-build, default-value=ATOM_ACT_TB_TBU_TS0  # This parameter specifies time base selected to compare with value configured in GtmAtomActionTimeBaseValue. ATOM_ACT_TB_TBU_TS0 : TBU_TS0 is used as reference time base for ATOM group. ATOM_ACT_TB_TBU_TS1 : TBU_TS1 is used as reference time base for ATOM group. ATOM_ACT_TB_TBU_TS2 : TBU_TS2 is used as reference time base for ATOM group.
              integer GtmAtomActionTimeBaseValue: 1..16777215, origin=INFINEON_AURIX2G, post-build-variant-value=true, set at post-build, default-value=1  # This parameter specifies the time base value for ATOM group channel level trigger
          container GtmAtomChannelConf [8..8]  # This container contains the configuration (parameters) for GTM ATOM channel common settings.
            boolean GtmAtomChResetCn0OnTriggerEnable: origin=INFINEON_AURIX2G, post-build-variant-value=true, set at post-build, default-value=false  # This parameter specifies enables/disables Atom channel counter Cn0 value is reset on global trigger from any of the trigger sources. TRUE: Resetting of Atom channel Cn0 on global trigger from any trigger source is enabled. FALSE: Resetting of Atom channel Cn0 on global trigger from any trigger source is disabled.
            boolean GtmAtomChInternalTriggerEnable: origin=INFINEON_AURIX2G, post-build-variant-value=true, set at post-build, default-value=false  # This parameter specifies enables/disables internal trigger from channel 0 of the corresponding group channel number. TRUE: Enable internal trigger from channel 0 or 8 (based on the AGC a channel belong to). FALSE: Disable internal trigger from channel 0 or 8 (based on the AGC a channel belong to)
            enumeration GtmTimerPortPinSelect: {NONE, TOUT0_SELC_2_PORT02_PIN0, TOUT112_SELI_8_PORT01_PIN4, TOUT17_SELI_8_PORT00_PIN8, TOUT43_SELI_8_PORT23_PIN2, TOUT48_SELC_2_PORT22_PIN1, TOUT53_SELC_2_PORT21_PIN2, TOUT54_SELI_8_PORT21_PIN3, TOUT7_SELI_8_PORT02_PIN7, TOUT85_SELC_2_PORT14_PIN5, TOUT8_SELC_2_PORT02_PIN8, TOUT9_SELC_2_PORT00_PIN0, TOUT10_SELC_2_PORT00_PIN1, TOUT113_SELI_8_PORT01_PIN5, TOUT116_SELK_10_PORT02_PIN9, TOUT11_SELC_2_PORT00_PIN2, TOUT14_SELI_8_PORT00_PIN5, TOUT1_SELC_2_PORT02_PIN1, TOUT31_SELC_2_PORT33_PIN9, TOUT39_SELJ_9_PORT32_PIN3, TOUT41_SELI_8_PORT23_PIN0, TOUT47_SELC_2_PORT22_PIN0, TOUT4_SELI_8_PORT02_PIN4, TOUT50_SELK_10_PORT22_PIN3, TOUT53_SELI_8_PORT21_PIN2, TOUT54_SELC_2_PORT21_PIN3, TOUT55_SELI_8_PORT21_PIN4, TOUT57_SELK_10_PORT21_PIN6, TOUT61_SELK_10_PORT20_PIN3, TOUT84_SELC_2_PORT14_PIN4, TOUT114_SELI_8_PORT01_PIN6, TOUT117_SELK_10_PORT02_PIN10, TOUT12_SELC_2_PORT00_PIN3, TOUT15_SELI_8_PORT00_PIN6, TOUT23_SELK_10_PORT33_PIN1, TOUT2_SELC_2_PORT02_PIN2, TOUT33_SELC_2_PORT33_PIN11, TOUT40_SELJ_9_PORT32_PIN4, TOUT41_SELK_10_PORT23_PIN0, TOUT42_SELI_8_PORT23_PIN1, TOUT44_SELI_8_PORT23_PIN3, TOUT46_SELC_2_PORT23_PIN5, TOUT55_SELC_2_PORT21_PIN4, TOUT56_SELI_8_PORT21_PIN5, TOUT58_SELI_8_PORT21_PIN7, TOUT5_SELI_8_PORT02_PIN5, TOUT65_SELK_10_PORT20_PIN9, TOUT83_SELC_2_PORT14_PIN3, TOUT115_SELI_8_PORT01_PIN7, TOUT118_SELK_10_PORT02_PIN11, TOUT13_SELC_2_PORT00_PIN4, TOUT16_SELI_8_PORT00_PIN7, TOUT24_SELK_10_PORT33_PIN2, TOUT38_SELC_2_PORT32_PIN2, TOUT3_SELC_2_PORT02_PIN3, TOUT42_SELK_10_PORT23_PIN1, TOUT45_SELI_8_PORT23_PIN4, TOUT49_SELC_2_PORT22_PIN2, TOUT56_SELC_2_PORT21_PIN5, TOUT59_SELK_10_PORT20_PIN0, TOUT60_SELC_2_PORT20_PIN1, TOUT66_SELK_10_PORT20_PIN10, TOUT6_SELI_8_PORT02_PIN6, TOUT82_SELC_2_PORT14_PIN2, TOUT118_SELI_8_PORT02_PIN11, TOUT135_SELI_8_PORT22_PIN9, TOUT13_SELI_8_PORT00_PIN4, TOUT146_SELI_8_PORT34_PIN1, TOUT147_SELI_8_PORT34_PIN2, TOUT14_SELC_2_PORT00_PIN5, TOUT29_SELK_10_PORT33_PIN7, TOUT39_SELC_2_PORT32_PIN3, TOUT3_SELI_8_PORT02_PIN3, TOUT4_SELC_2_PORT02_PIN4, TOUT50_SELC_2_PORT22_PIN3, TOUT57_SELC_2_PORT21_PIN6, TOUT61_SELC_2_PORT20_PIN3, TOUT81_SELC_2_PORT14_PIN1, TOUT0_SELI_8_PORT02_PIN0, TOUT136_SELI_8_PORT22_PIN10, TOUT148_SELI_8_PORT34_PIN3, TOUT15_SELC_2_PORT00_PIN6, TOUT23_SELC_2_PORT33_PIN1, TOUT26_SELK_10_PORT33_PIN4, TOUT40_SELC_2_PORT32_PIN4, TOUT41_SELC_2_PORT23_PIN0, TOUT58_SELC_2_PORT21_PIN7, TOUT5_SELC_2_PORT02_PIN5, TOUT8_SELI_8_PORT02_PIN8, TOUT9_SELI_8_PORT00_PIN0, TOUT106_SELC_2_PORT10_PIN4, TOUT10_SELI_8_PORT00_PIN1, TOUT116_SELI_8_PORT02_PIN9, TOUT11_SELI_8_PORT00_PIN2, TOUT137_SELI_8_PORT22_PIN11, TOUT149_SELI_8_PORT34_PIN4, TOUT16_SELC_2_PORT00_PIN7, TOUT1_SELI_8_PORT02_PIN1, TOUT24_SELC_2_PORT33_PIN2, TOUT27_SELK_10_PORT33_PIN5, TOUT42_SELC_2_PORT23_PIN1, TOUT59_SELC_2_PORT20_PIN0, TOUT6_SELC_2_PORT02_PIN6, TOUT117_SELI_8_PORT02_PIN10, TOUT12_SELI_8_PORT00_PIN3, TOUT150_SELI_8_PORT34_PIN5, TOUT17_SELC_2_PORT00_PIN8, TOUT25_SELC_2_PORT33_PIN3, TOUT28_SELK_10_PORT33_PIN6, TOUT2_SELI_8_PORT02_PIN2, TOUT45_SELC_2_PORT23_PIN4, TOUT64_SELC_2_PORT20_PIN8, TOUT7_SELC_2_PORT02_PIN7, TOUT0_SELD_3_PORT02_PIN0, TOUT109_SELC_2_PORT10_PIN7, TOUT112_SELJ_9_PORT01_PIN4, TOUT17_SELJ_9_PORT00_PIN8, TOUT68_SELC_2_PORT20_PIN12, TOUT76_SELC_2_PORT15_PIN5, TOUT77_SELC_2_PORT15_PIN6, TOUT7_SELJ_9_PORT02_PIN7, TOUT87_SELC_2_PORT14_PIN7, TOUT8_SELD_3_PORT02_PIN8, TOUT9_SELD_3_PORT00_PIN0, TOUT102_SELI_8_PORT10_PIN0, TOUT103_SELC_2_PORT10_PIN1, TOUT10_SELD_3_PORT00_PIN1, TOUT113_SELJ_9_PORT01_PIN5, TOUT116_SELL_11_PORT02_PIN9, TOUT11_SELD_3_PORT00_PIN2, TOUT14_SELJ_9_PORT00_PIN5, TOUT1_SELD_3_PORT02_PIN1, TOUT31_SELD_3_PORT33_PIN9, TOUT39_SELK_10_PORT32_PIN3, TOUT4_SELJ_9_PORT02_PIN4, TOUT61_SELL_11_PORT20_PIN3, TOUT69_SELC_2_PORT20_PIN13, TOUT72_SELJ_9_PORT15_PIN1, TOUT78_SELC_2_PORT15_PIN7, TOUT79_SELC_2_PORT15_PIN8, TOUT86_SELC_2_PORT14_PIN6, TOUT104_SELC_2_PORT10_PIN2, TOUT107_SELC_2_PORT10_PIN5, TOUT110_SELI_8_PORT10_PIN8, TOUT114_SELJ_9_PORT01_PIN6, TOUT117_SELL_11_PORT02_PIN10, TOUT12_SELD_3_PORT00_PIN3, TOUT15_SELJ_9_PORT00_PIN6, TOUT23_SELL_11_PORT33_PIN1, TOUT2_SELD_3_PORT02_PIN2, TOUT33_SELD_3_PORT33_PIN11, TOUT40_SELK_10_PORT32_PIN4, TOUT41_SELL_11_PORT23_PIN0, TOUT5_SELJ_9_PORT02_PIN5, TOUT70_SELC_2_PORT20_PIN14, TOUT73_SELJ_9_PORT15_PIN2, TOUT80_SELC_2_PORT14_PIN0, TOUT105_SELC_2_PORT10_PIN3, TOUT106_SELI_8_PORT10_PIN4, TOUT108_SELC_2_PORT10_PIN6, TOUT115_SELJ_9_PORT01_PIN7, TOUT118_SELL_11_PORT02_PIN11, TOUT13_SELD_3_PORT00_PIN4, TOUT16_SELJ_9_PORT00_PIN7, TOUT24_SELL_11_PORT33_PIN2, TOUT38_SELD_3_PORT32_PIN2, TOUT3_SELD_3_PORT02_PIN3, TOUT42_SELL_11_PORT23_PIN1, TOUT60_SELD_3_PORT20_PIN1, TOUT6_SELJ_9_PORT02_PIN6, TOUT71_SELC_2_PORT15_PIN0, TOUT74_SELJ_9_PORT15_PIN3, TOUT102_SELC_2_PORT10_PIN0, TOUT105_SELI_8_PORT10_PIN3, TOUT108_SELI_8_PORT10_PIN6, TOUT118_SELJ_9_PORT02_PIN11, TOUT130_SELI_8_PORT22_PIN4, TOUT131_SELI_8_PORT22_PIN5, TOUT13_SELJ_9_PORT00_PIN4, TOUT146_SELJ_9_PORT34_PIN1, TOUT147_SELJ_9_PORT34_PIN2, TOUT14_SELD_3_PORT00_PIN5, TOUT29_SELL_11_PORT33_PIN7, TOUT39_SELD_3_PORT32_PIN3, TOUT3_SELJ_9_PORT02_PIN3, TOUT4_SELD_3_PORT02_PIN4, TOUT61_SELD_3_PORT20_PIN3, TOUT71_SELJ_9_PORT15_PIN0, TOUT72_SELC_2_PORT15_PIN1, TOUT75_SELJ_9_PORT15_PIN4, TOUT0_SELJ_9_PORT02_PIN0, TOUT109_SELI_8_PORT10_PIN7, TOUT110_SELC_2_PORT10_PIN8, TOUT132_SELI_8_PORT22_PIN6, TOUT148_SELJ_9_PORT34_PIN3, TOUT15_SELD_3_PORT00_PIN6, TOUT23_SELD_3_PORT33_PIN1, TOUT26_SELL_11_PORT33_PIN4, TOUT40_SELD_3_PORT32_PIN4, TOUT41_SELD_3_PORT23_PIN0, TOUT5_SELD_3_PORT02_PIN5, TOUT65_SELC_2_PORT20_PIN9, TOUT73_SELC_2_PORT15_PIN2, TOUT76_SELJ_9_PORT15_PIN5, TOUT77_SELJ_9_PORT15_PIN6, TOUT8_SELJ_9_PORT02_PIN8, TOUT9_SELJ_9_PORT00_PIN0, TOUT103_SELI_8_PORT10_PIN1, TOUT106_SELL_11_PORT10_PIN4, TOUT10_SELJ_9_PORT00_PIN1, TOUT116_SELJ_9_PORT02_PIN9, TOUT11_SELJ_9_PORT00_PIN2, TOUT133_SELI_8_PORT22_PIN7, TOUT149_SELJ_9_PORT34_PIN4, TOUT16_SELD_3_PORT00_PIN7, TOUT1_SELJ_9_PORT02_PIN1, TOUT24_SELD_3_PORT33_PIN2, TOUT27_SELL_11_PORT33_PIN5, TOUT42_SELD_3_PORT23_PIN1, TOUT66_SELC_2_PORT20_PIN10, TOUT6_SELD_3_PORT02_PIN6, TOUT74_SELC_2_PORT15_PIN3, TOUT78_SELJ_9_PORT15_PIN7, TOUT104_SELI_8_PORT10_PIN2, TOUT107_SELI_8_PORT10_PIN5, TOUT117_SELJ_9_PORT02_PIN10, TOUT12_SELJ_9_PORT00_PIN3, TOUT134_SELI_8_PORT22_PIN8, TOUT150_SELJ_9_PORT34_PIN5, TOUT17_SELD_3_PORT00_PIN8, TOUT25_SELD_3_PORT33_PIN3, TOUT28_SELL_11_PORT33_PIN6, TOUT2_SELJ_9_PORT02_PIN2, TOUT45_SELD_3_PORT23_PIN4, TOUT67_SELC_2_PORT20_PIN11, TOUT75_SELC_2_PORT15_PIN4, TOUT79_SELJ_9_PORT15_PIN8, TOUT7_SELD_3_PORT02_PIN7, TOUT101_SELJ_9_PORT11_PIN12, TOUT108_SELK_10_PORT10_PIN6, TOUT109_SELK_10_PORT10_PIN7, TOUT12_SELK_10_PORT00_PIN3, TOUT144_SELI_8_PORT33_PIN15, TOUT18_SELC_2_PORT00_PIN9, TOUT25_SELI_8_PORT33_PIN3, TOUT26_SELC_2_PORT33_PIN4, TOUT32_SELC_2_PORT33_PIN10, TOUT32_SELI_8_PORT33_PIN10, TOUT37_SELK_10_PORT32_PIN1, TOUT94_SELC_2_PORT13_PIN3, TOUT102_SELK_10_PORT10_PIN0, TOUT105_SELK_10_PORT10_PIN3, TOUT167_SELK_10_PORT00_PIN13, TOUT19_SELC_2_PORT00_PIN10, TOUT22_SELI_8_PORT33_PIN0, TOUT27_SELC_2_PORT33_PIN5, TOUT30_SELI_8_PORT33_PIN8, TOUT34_SELI_8_PORT33_PIN12, TOUT43_SELC_2_PORT23_PIN2, TOUT51_SELI_8_PORT21_PIN0, TOUT90_SELI_8_PORT14_PIN10, TOUT90_SELK_10_PORT14_PIN10, TOUT91_SELI_8_PORT13_PIN0, TOUT95_SELC_2_PORT11_PIN2, TOUT98_SELJ_9_PORT11_PIN9, TOUT9_SELK_10_PORT00_PIN0, TOUT103_SELK_10_PORT10_PIN1, TOUT106_SELK_10_PORT10_PIN4, TOUT10_SELK_10_PORT00_PIN1, TOUT114_SELK_10_PORT01_PIN6, TOUT138_SELK_10_PORT23_PIN6, TOUT166_SELK_10_PORT00_PIN14, TOUT20_SELC_2_PORT00_PIN11, TOUT23_SELI_8_PORT33_PIN1, TOUT28_SELC_2_PORT33_PIN6, TOUT31_SELJ_9_PORT33_PIN9, TOUT35_SELI_8_PORT33_PIN13, TOUT44_SELC_2_PORT23_PIN3, TOUT52_SELI_8_PORT21_PIN1, TOUT88_SELC_2_PORT14_PIN8, TOUT91_SELK_10_PORT13_PIN0, TOUT92_SELI_8_PORT13_PIN1, TOUT96_SELC_2_PORT11_PIN3, TOUT99_SELJ_9_PORT11_PIN10, TOUT100_SELJ_9_PORT11_PIN11, TOUT104_SELK_10_PORT10_PIN2, TOUT107_SELK_10_PORT10_PIN5, TOUT115_SELK_10_PORT01_PIN7, TOUT11_SELK_10_PORT00_PIN2, TOUT139_SELK_10_PORT23_PIN7, TOUT143_SELI_8_PORT33_PIN14, TOUT168_SELK_10_PORT00_PIN15, TOUT21_SELC_2_PORT00_PIN12, TOUT24_SELI_8_PORT33_PIN2, TOUT29_SELC_2_PORT33_PIN7, TOUT33_SELI_8_PORT33_PIN11, TOUT36_SELI_8_PORT32_PIN0, TOUT62_SELK_10_PORT20_PIN6, TOUT89_SELC_2_PORT14_PIN9, TOUT92_SELK_10_PORT13_PIN1, TOUT93_SELI_8_PORT13_PIN2, TOUT97_SELC_2_PORT11_PIN6, TOUT167_SELI_8_PORT00_PIN13, TOUT22_SELC_2_PORT33_PIN0, TOUT29_SELI_8_PORT33_PIN7, TOUT30_SELC_2_PORT33_PIN8, TOUT34_SELC_2_PORT33_PIN12, TOUT51_SELC_2_PORT21_PIN0, TOUT57_SELI_8_PORT21_PIN6, TOUT86_SELI_8_PORT14_PIN6, TOUT90_SELC_2_PORT14_PIN10, TOUT97_SELJ_9_PORT11_PIN6, TOUT98_SELC_2_PORT11_PIN9, TOUT120_SELJ_9_PORT11_PIN1, TOUT138_SELA_0_PORT23_PIN6, TOUT166_SELI_8_PORT00_PIN14, TOUT26_SELI_8_PORT33_PIN4, TOUT35_SELC_2_PORT33_PIN13, TOUT52_SELC_2_PORT21_PIN1, TOUT59_SELI_8_PORT20_PIN0, TOUT65_SELJ_9_PORT20_PIN9, TOUT87_SELI_8_PORT14_PIN7, TOUT91_SELC_2_PORT13_PIN0, TOUT94_SELJ_9_PORT13_PIN3, TOUT99_SELC_2_PORT11_PIN10, TOUT100_SELC_2_PORT11_PIN11, TOUT139_SELA_0_PORT23_PIN7, TOUT143_SELK_10_PORT33_PIN14, TOUT168_SELI_8_PORT00_PIN15, TOUT27_SELI_8_PORT33_PIN5, TOUT36_SELC_2_PORT32_PIN0, TOUT60_SELI_8_PORT20_PIN1, TOUT62_SELC_2_PORT20_PIN6, TOUT88_SELI_8_PORT14_PIN8, TOUT92_SELC_2_PORT13_PIN1, TOUT95_SELJ_9_PORT11_PIN2, TOUT101_SELC_2_PORT11_PIN12, TOUT140_SELA_0_PORT32_PIN5, TOUT144_SELK_10_PORT33_PIN15, TOUT28_SELI_8_PORT33_PIN6, TOUT37_SELC_2_PORT32_PIN1, TOUT37_SELI_8_PORT32_PIN1, TOUT61_SELI_8_PORT20_PIN3, TOUT63_SELC_2_PORT20_PIN7, TOUT89_SELI_8_PORT14_PIN9, TOUT93_SELC_2_PORT13_PIN2, TOUT96_SELJ_9_PORT11_PIN3, TOUT101_SELI_8_PORT11_PIN12, TOUT144_SELJ_9_PORT33_PIN15, TOUT17_SELK_10_PORT00_PIN8, TOUT18_SELD_3_PORT00_PIN9, TOUT25_SELJ_9_PORT33_PIN3, TOUT26_SELD_3_PORT33_PIN4, TOUT32_SELD_3_PORT33_PIN10, TOUT32_SELJ_9_PORT33_PIN10, TOUT37_SELL_11_PORT32_PIN1, TOUT63_SELK_10_PORT20_PIN7, TOUT65_SELI_8_PORT20_PIN9, TOUT76_SELI_8_PORT15_PIN5, TOUT94_SELD_3_PORT13_PIN3, TOUT111_SELC_2_PORT01_PIN3, TOUT128_SELK_10_PORT12_PIN0, TOUT14_SELK_10_PORT00_PIN5, TOUT167_SELL_11_PORT00_PIN13, TOUT19_SELD_3_PORT00_PIN10, TOUT22_SELJ_9_PORT33_PIN0, TOUT27_SELD_3_PORT33_PIN5, TOUT30_SELJ_9_PORT33_PIN8, TOUT34_SELJ_9_PORT33_PIN12, TOUT43_SELD_3_PORT23_PIN2, TOUT51_SELK_10_PORT21_PIN0, TOUT64_SELI_8_PORT20_PIN8, TOUT79_SELI_8_PORT15_PIN8, TOUT90_SELJ_9_PORT14_PIN10, TOUT90_SELL_11_PORT14_PIN10, TOUT91_SELJ_9_PORT13_PIN0, TOUT95_SELD_3_PORT11_PIN2, TOUT98_SELI_8_PORT11_PIN9, TOUT112_SELA_0_PORT01_PIN4, TOUT114_SELL_11_PORT01_PIN6, TOUT15_SELK_10_PORT00_PIN6, TOUT166_SELL_11_PORT00_PIN14, TOUT20_SELD_3_PORT00_PIN11, TOUT23_SELJ_9_PORT33_PIN1, TOUT28_SELD_3_PORT33_PIN6, TOUT31_SELK_10_PORT33_PIN9, TOUT35_SELJ_9_PORT33_PIN13, TOUT44_SELD_3_PORT23_PIN3, TOUT52_SELK_10_PORT21_PIN1, TOUT63_SELI_8_PORT20_PIN7, TOUT78_SELI_8_PORT15_PIN7, TOUT88_SELD_3_PORT14_PIN8, TOUT91_SELL_11_PORT13_PIN0, TOUT92_SELJ_9_PORT13_PIN1, TOUT96_SELD_3_PORT11_PIN3, TOUT99_SELI_8_PORT11_PIN10, TOUT100_SELI_8_PORT11_PIN11, TOUT113_SELA_0_PORT01_PIN5, TOUT115_SELL_11_PORT01_PIN7, TOUT143_SELJ_9_PORT33_PIN14, TOUT168_SELL_11_PORT00_PIN15, TOUT16_SELK_10_PORT00_PIN7, TOUT21_SELD_3_PORT00_PIN12, TOUT24_SELJ_9_PORT33_PIN2, TOUT29_SELD_3_PORT33_PIN7, TOUT33_SELJ_9_PORT33_PIN11, TOUT36_SELJ_9_PORT32_PIN0, TOUT62_SELI_8_PORT20_PIN6, TOUT62_SELL_11_PORT20_PIN6, TOUT77_SELI_8_PORT15_PIN6, TOUT89_SELD_3_PORT14_PIN9, TOUT92_SELL_11_PORT13_PIN1, TOUT93_SELJ_9_PORT13_PIN2, TOUT97_SELD_3_PORT11_PIN6, TOUT114_SELA_0_PORT01_PIN6, TOUT131_SELD_3_PORT22_PIN5, TOUT135_SELD_3_PORT22_PIN9, TOUT167_SELJ_9_PORT00_PIN13, TOUT21_SELI_8_PORT00_PIN12, TOUT22_SELD_3_PORT33_PIN0, TOUT29_SELJ_9_PORT33_PIN7, TOUT30_SELD_3_PORT33_PIN8, TOUT34_SELD_3_PORT33_PIN12, TOUT51_SELD_3_PORT21_PIN0, TOUT57_SELJ_9_PORT21_PIN6, TOUT86_SELJ_9_PORT14_PIN6, TOUT90_SELD_3_PORT14_PIN10, TOUT97_SELI_8_PORT11_PIN6, TOUT98_SELD_3_PORT11_PIN9, TOUT115_SELA_0_PORT01_PIN7, TOUT120_SELK_10_PORT11_PIN1, TOUT132_SELD_3_PORT22_PIN6, TOUT136_SELD_3_PORT22_PIN10, TOUT166_SELJ_9_PORT00_PIN14, TOUT18_SELI_8_PORT00_PIN9, TOUT26_SELJ_9_PORT33_PIN4, TOUT35_SELD_3_PORT33_PIN13, TOUT52_SELD_3_PORT21_PIN1, TOUT59_SELJ_9_PORT20_PIN0, TOUT64_SELJ_9_PORT20_PIN8, TOUT87_SELJ_9_PORT14_PIN7, TOUT91_SELD_3_PORT13_PIN0, TOUT94_SELI_8_PORT13_PIN3, TOUT94_SELK_10_PORT13_PIN3, TOUT99_SELD_3_PORT11_PIN10, TOUT100_SELD_3_PORT11_PIN11, TOUT133_SELD_3_PORT22_PIN7, TOUT137_SELD_3_PORT22_PIN11, TOUT143_SELL_11_PORT33_PIN14, TOUT168_SELJ_9_PORT00_PIN15, TOUT19_SELI_8_PORT00_PIN10, TOUT27_SELJ_9_PORT33_PIN5, TOUT36_SELD_3_PORT32_PIN0, TOUT60_SELJ_9_PORT20_PIN1, TOUT62_SELD_3_PORT20_PIN6, TOUT88_SELJ_9_PORT14_PIN8, TOUT92_SELD_3_PORT13_PIN1, TOUT95_SELI_8_PORT11_PIN2, TOUT101_SELD_3_PORT11_PIN12, TOUT134_SELD_3_PORT22_PIN8, TOUT144_SELL_11_PORT33_PIN15, TOUT20_SELI_8_PORT00_PIN11, TOUT28_SELJ_9_PORT33_PIN6, TOUT37_SELD_3_PORT32_PIN1, TOUT37_SELJ_9_PORT32_PIN1, TOUT61_SELJ_9_PORT20_PIN3, TOUT63_SELD_3_PORT20_PIN7, TOUT89_SELJ_9_PORT14_PIN9, TOUT93_SELD_3_PORT13_PIN2, TOUT96_SELI_8_PORT11_PIN3, TOUT109_SELD_3_PORT10_PIN7, TOUT39_SELI_8_PORT32_PIN3, TOUT48_SELD_3_PORT22_PIN1, TOUT53_SELD_3_PORT21_PIN2, TOUT68_SELD_3_PORT20_PIN12, TOUT76_SELD_3_PORT15_PIN5, TOUT77_SELD_3_PORT15_PIN6, TOUT85_SELD_3_PORT14_PIN5, TOUT87_SELD_3_PORT14_PIN7, TOUT87_SELK_10_PORT14_PIN7, TOUT102_SELJ_9_PORT10_PIN0, TOUT103_SELD_3_PORT10_PIN1, TOUT41_SELJ_9_PORT23_PIN0, TOUT44_SELK_10_PORT23_PIN3, TOUT47_SELD_3_PORT22_PIN0, TOUT50_SELJ_9_PORT22_PIN3, TOUT53_SELJ_9_PORT21_PIN2, TOUT54_SELD_3_PORT21_PIN3, TOUT57_SELL_11_PORT21_PIN6, TOUT69_SELD_3_PORT20_PIN13, TOUT72_SELK_10_PORT15_PIN1, TOUT78_SELD_3_PORT15_PIN7, TOUT79_SELD_3_PORT15_PIN8, TOUT84_SELD_3_PORT14_PIN4, TOUT85_SELI_8_PORT14_PIN5, TOUT86_SELD_3_PORT14_PIN6, TOUT86_SELK_10_PORT14_PIN6, TOUT104_SELD_3_PORT10_PIN2, TOUT107_SELD_3_PORT10_PIN5, TOUT110_SELJ_9_PORT10_PIN8, TOUT42_SELJ_9_PORT23_PIN1, TOUT45_SELK_10_PORT23_PIN4, TOUT46_SELD_3_PORT23_PIN5, TOUT52_SELJ_9_PORT21_PIN1, TOUT55_SELD_3_PORT21_PIN4, TOUT58_SELJ_9_PORT21_PIN7, TOUT65_SELL_11_PORT20_PIN9, TOUT70_SELD_3_PORT20_PIN14, TOUT73_SELK_10_PORT15_PIN2, TOUT80_SELD_3_PORT14_PIN0, TOUT81_SELI_8_PORT14_PIN1, TOUT83_SELD_3_PORT14_PIN3, TOUT105_SELD_3_PORT10_PIN3, TOUT106_SELJ_9_PORT10_PIN4, TOUT108_SELD_3_PORT10_PIN6, TOUT43_SELJ_9_PORT23_PIN2, TOUT46_SELK_10_PORT23_PIN5, TOUT49_SELD_3_PORT22_PIN2, TOUT51_SELJ_9_PORT21_PIN0, TOUT56_SELD_3_PORT21_PIN5, TOUT59_SELL_11_PORT20_PIN0, TOUT66_SELL_11_PORT20_PIN10, TOUT71_SELD_3_PORT15_PIN0, TOUT74_SELK_10_PORT15_PIN3, TOUT80_SELI_8_PORT14_PIN0, TOUT82_SELD_3_PORT14_PIN2, TOUT102_SELD_3_PORT10_PIN0, TOUT105_SELJ_9_PORT10_PIN3, TOUT108_SELJ_9_PORT10_PIN6, TOUT111_SELI_8_PORT01_PIN3, TOUT131_SELJ_9_PORT22_PIN5, TOUT132_SELJ_9_PORT22_PIN6, TOUT21_SELJ_9_PORT00_PIN12, TOUT264_SELJ_9_PORT13_PIN15, TOUT44_SELJ_9_PORT23_PIN3, TOUT50_SELD_3_PORT22_PIN3, TOUT56_SELJ_9_PORT21_PIN5, TOUT57_SELD_3_PORT21_PIN6, TOUT71_SELK_10_PORT15_PIN0, TOUT72_SELD_3_PORT15_PIN1, TOUT75_SELK_10_PORT15_PIN4, TOUT81_SELD_3_PORT14_PIN1, TOUT95_SELK_10_PORT11_PIN2, TOUT109_SELJ_9_PORT10_PIN7, TOUT110_SELD_3_PORT10_PIN8, TOUT116_SELA_0_PORT02_PIN9, TOUT121_SELK_10_PORT11_PIN4, TOUT128_SELJ_9_PORT12_PIN0, TOUT130_SELJ_9_PORT22_PIN4, TOUT133_SELJ_9_PORT22_PIN7, TOUT18_SELJ_9_PORT00_PIN9, TOUT45_SELJ_9_PORT23_PIN4, TOUT56_SELK_10_PORT21_PIN5, TOUT58_SELD_3_PORT21_PIN7, TOUT65_SELD_3_PORT20_PIN9, TOUT73_SELD_3_PORT15_PIN2, TOUT76_SELK_10_PORT15_PIN5, TOUT77_SELK_10_PORT15_PIN6, TOUT103_SELJ_9_PORT10_PIN1, TOUT106_SELD_3_PORT10_PIN4, TOUT117_SELA_0_PORT02_PIN10, TOUT129_SELJ_9_PORT12_PIN1, TOUT134_SELJ_9_PORT22_PIN8, TOUT139_SELJ_9_PORT23_PIN7, TOUT19_SELJ_9_PORT00_PIN10, TOUT46_SELJ_9_PORT23_PIN5, TOUT59_SELD_3_PORT20_PIN0, TOUT66_SELD_3_PORT20_PIN10, TOUT74_SELD_3_PORT15_PIN3, TOUT78_SELK_10_PORT15_PIN7, TOUT97_SELK_10_PORT11_PIN6, TOUT104_SELJ_9_PORT10_PIN2, TOUT107_SELJ_9_PORT10_PIN5, TOUT118_SELA_0_PORT02_PIN11, TOUT119_SELJ_9_PORT11_PIN0, TOUT124_SELK_10_PORT11_PIN8, TOUT135_SELJ_9_PORT22_PIN9, TOUT138_SELJ_9_PORT23_PIN6, TOUT20_SELJ_9_PORT00_PIN11, TOUT40_SELI_8_PORT32_PIN4, TOUT64_SELD_3_PORT20_PIN8, TOUT67_SELD_3_PORT20_PIN11, TOUT75_SELD_3_PORT15_PIN4, TOUT79_SELK_10_PORT15_PIN8, TOUT119_SELC_2_PORT11_PIN0, TOUT126_SELI_8_PORT11_PIN14, TOUT130_SELK_10_PORT22_PIN4, TOUT134_SELL_11_PORT22_PIN8, TOUT146_SELK_10_PORT34_PIN1, TOUT150_SELL_11_PORT34_PIN5, TOUT155_SELC_2_PORT01_PIN0, TOUT161_SELI_8_PORT01_PIN13, TOUT162_SELI_8_PORT01_PIN8, TOUT174_SELC_2_PORT31_PIN0, TOUT181_SELK_10_PORT31_PIN7, TOUT206_SELC_2_PORT25_PIN0, TOUT213_SELK_10_PORT25_PIN7, TOUT249_SELC_2_PORT13_PIN12, TOUT258_SELI_8_PORT14_PIN11, TOUT261_SELI_8_PORT14_PIN12, TOUT264_SELI_8_PORT13_PIN15, TOUT120_SELC_2_PORT11_PIN1, TOUT123_SELI_8_PORT11_PIN7, TOUT128_SELI_8_PORT12_PIN0, TOUT131_SELK_10_PORT22_PIN5, TOUT135_SELL_11_PORT22_PIN9, TOUT140_SELK_10_PORT32_PIN5, TOUT147_SELK_10_PORT34_PIN2, TOUT156_SELC_2_PORT01_PIN2, TOUT158_SELI_8_PORT01_PIN12, TOUT164_SELI_8_PORT01_PIN14, TOUT175_SELC_2_PORT31_PIN1, TOUT178_SELK_10_PORT31_PIN4, TOUT207_SELC_2_PORT25_PIN1, TOUT210_SELK_10_PORT25_PIN4, TOUT242_SELC_2_PORT15_PIN10, TOUT245_SELI_8_PORT15_PIN13, TOUT248_SELK_10_PORT13_PIN9, TOUT253_SELI_8_PORT13_PIN4, TOUT260_SELI_8_PORT14_PIN13, TOUT265_SELC_2_PORT10_PIN9, TOUT268_SELJ_9_PORT10_PIN13, TOUT121_SELC_2_PORT11_PIN4, TOUT124_SELI_8_PORT11_PIN8, TOUT132_SELK_10_PORT22_PIN6, TOUT136_SELL_11_PORT22_PIN10, TOUT141_SELK_10_PORT32_PIN6, TOUT148_SELK_10_PORT34_PIN3, TOUT152_SELI_8_PORT02_PIN15, TOUT157_SELC_2_PORT01_PIN15, TOUT159_SELI_8_PORT01_PIN1, TOUT176_SELC_2_PORT31_PIN2, TOUT179_SELK_10_PORT31_PIN5, TOUT208_SELC_2_PORT25_PIN2, TOUT211_SELK_10_PORT25_PIN5, TOUT243_SELC_2_PORT15_PIN11, TOUT246_SELI_8_PORT15_PIN14, TOUT250_SELK_10_PORT13_PIN11, TOUT254_SELI_8_PORT13_PIN5, TOUT259_SELI_8_PORT14_PIN14, TOUT266_SELC_2_PORT10_PIN10, TOUT269_SELJ_9_PORT10_PIN11, TOUT122_SELC_2_PORT11_PIN5, TOUT123_SELK_10_PORT11_PIN7, TOUT125_SELI_8_PORT11_PIN13, TOUT133_SELK_10_PORT22_PIN7, TOUT137_SELL_11_PORT22_PIN11, TOUT142_SELK_10_PORT32_PIN7, TOUT149_SELK_10_PORT34_PIN4, TOUT160_SELI_8_PORT01_PIN9, TOUT163_SELI_8_PORT01_PIN10, TOUT165_SELC_2_PORT01_PIN11, TOUT177_SELC_2_PORT31_PIN3, TOUT180_SELK_10_PORT31_PIN6, TOUT209_SELC_2_PORT25_PIN3, TOUT212_SELK_10_PORT25_PIN6, TOUT212_SELK_10_PORT26_PIN0, TOUT244_SELC_2_PORT15_PIN12, TOUT247_SELI_8_PORT15_PIN15, TOUT249_SELK_10_PORT13_PIN12, TOUT255_SELI_8_PORT13_PIN6, TOUT263_SELI_8_PORT14_PIN15, TOUT267_SELC_2_PORT10_PIN14, TOUT270_SELJ_9_PORT10_PIN15, TOUT122_SELI_8_PORT11_PIN5, TOUT123_SELC_2_PORT11_PIN7, TOUT129_SELI_8_PORT12_PIN1, TOUT134_SELK_10_PORT22_PIN8, TOUT150_SELK_10_PORT34_PIN5, TOUT158_SELC_2_PORT01_PIN12, TOUT163_SELK_10_PORT01_PIN10, TOUT165_SELI_8_PORT01_PIN11, TOUT177_SELK_10_PORT31_PIN3, TOUT178_SELC_2_PORT31_PIN4, TOUT209_SELK_10_PORT25_PIN3, TOUT210_SELC_2_PORT25_PIN4, TOUT245_SELC_2_PORT15_PIN13, TOUT248_SELI_8_PORT13_PIN9, TOUT267_SELJ_9_PORT10_PIN14, TOUT268_SELC_2_PORT10_PIN13, TOUT119_SELI_8_PORT11_PIN0, TOUT124_SELC_2_PORT11_PIN8, TOUT135_SELK_10_PORT22_PIN9, TOUT140_SELJ_9_PORT32_PIN5, TOUT155_SELI_8_PORT01_PIN0, TOUT159_SELC_2_PORT01_PIN1, TOUT162_SELK_10_PORT01_PIN8, TOUT174_SELK_10_PORT31_PIN0, TOUT179_SELC_2_PORT31_PIN5, TOUT206_SELK_10_PORT25_PIN0, TOUT211_SELC_2_PORT25_PIN5, TOUT246_SELC_2_PORT15_PIN14, TOUT250_SELI_8_PORT13_PIN11, TOUT269_SELC_2_PORT10_PIN11, TOUT120_SELI_8_PORT11_PIN1, TOUT125_SELC_2_PORT11_PIN13, TOUT136_SELK_10_PORT22_PIN10, TOUT141_SELJ_9_PORT32_PIN6, TOUT156_SELI_8_PORT01_PIN2, TOUT158_SELK_10_PORT01_PIN12, TOUT160_SELC_2_PORT01_PIN9, TOUT175_SELK_10_PORT31_PIN1, TOUT180_SELC_2_PORT31_PIN6, TOUT207_SELK_10_PORT25_PIN1, TOUT212_SELC_2_PORT25_PIN6, TOUT212_SELC_2_PORT26_PIN0, TOUT247_SELC_2_PORT15_PIN15, TOUT249_SELI_8_PORT13_PIN12, TOUT270_SELC_2_PORT10_PIN15, TOUT96_SELK_10_PORT11_PIN3, TOUT121_SELI_8_PORT11_PIN4, TOUT126_SELC_2_PORT11_PIN14, TOUT137_SELK_10_PORT22_PIN11, TOUT142_SELJ_9_PORT32_PIN7, TOUT152_SELK_10_PORT02_PIN15, TOUT157_SELI_8_PORT01_PIN15, TOUT161_SELC_2_PORT01_PIN13, TOUT176_SELK_10_PORT31_PIN2, TOUT181_SELC_2_PORT31_PIN7, TOUT208_SELK_10_PORT25_PIN2, TOUT213_SELC_2_PORT25_PIN7, TOUT248_SELC_2_PORT13_PIN9, TOUT127_SELC_2_PORT11_PIN15, TOUT141_SELC_2_PORT32_PIN6, TOUT155_SELD_3_PORT01_PIN0, TOUT161_SELJ_9_PORT01_PIN13, TOUT162_SELJ_9_PORT01_PIN8, TOUT182_SELC_2_PORT31_PIN8, TOUT189_SELJ_9_PORT31_PIN15, TOUT214_SELC_2_PORT25_PIN8, TOUT221_SELJ_9_PORT25_PIN15, TOUT242_SELI_8_PORT15_PIN10, TOUT250_SELC_2_PORT13_PIN11, TOUT264_SELK_10_PORT13_PIN15, TOUT128_SELC_2_PORT12_PIN0, TOUT142_SELC_2_PORT32_PIN7, TOUT156_SELD_3_PORT01_PIN2, TOUT158_SELJ_9_PORT01_PIN12, TOUT164_SELJ_9_PORT01_PIN14, TOUT183_SELC_2_PORT31_PIN9, TOUT186_SELJ_9_PORT31_PIN12, TOUT215_SELC_2_PORT25_PIN9, TOUT218_SELJ_9_PORT25_PIN12, TOUT251_SELC_2_PORT13_PIN10, TOUT254_SELK_10_PORT13_PIN5, TOUT258_SELC_2_PORT14_PIN11, TOUT261_SELK_10_PORT14_PIN12, TOUT129_SELC_2_PORT12_PIN1, TOUT143_SELC_2_PORT33_PIN14, TOUT152_SELJ_9_PORT02_PIN15, TOUT157_SELD_3_PORT01_PIN15, TOUT159_SELJ_9_PORT01_PIN1, TOUT184_SELC_2_PORT31_PIN10, TOUT187_SELJ_9_PORT31_PIN13, TOUT216_SELC_2_PORT25_PIN10, TOUT219_SELJ_9_PORT25_PIN13, TOUT252_SELC_2_PORT13_PIN14, TOUT255_SELK_10_PORT13_PIN6, TOUT259_SELC_2_PORT14_PIN14, TOUT111_SELJ_9_PORT01_PIN3, TOUT144_SELC_2_PORT33_PIN15, TOUT160_SELJ_9_PORT01_PIN9, TOUT163_SELJ_9_PORT01_PIN10, TOUT165_SELD_3_PORT01_PIN11, TOUT185_SELC_2_PORT31_PIN11, TOUT188_SELJ_9_PORT31_PIN14, TOUT217_SELC_2_PORT25_PIN11, TOUT220_SELJ_9_PORT25_PIN14, TOUT253_SELC_2_PORT13_PIN4, TOUT256_SELK_10_PORT13_PIN7, TOUT260_SELC_2_PORT14_PIN13, TOUT263_SELK_10_PORT14_PIN15, TOUT140_SELI_8_PORT32_PIN5, TOUT143_SELD_3_PORT33_PIN14, TOUT158_SELD_3_PORT01_PIN12, TOUT163_SELL_11_PORT01_PIN10, TOUT165_SELJ_9_PORT01_PIN11, TOUT185_SELJ_9_PORT31_PIN11, TOUT186_SELC_2_PORT31_PIN12, TOUT217_SELJ_9_PORT25_PIN11, TOUT218_SELC_2_PORT25_PIN12, TOUT253_SELK_10_PORT13_PIN4, TOUT254_SELC_2_PORT13_PIN5, TOUT260_SELK_10_PORT14_PIN13, TOUT261_SELC_2_PORT14_PIN12, TOUT31_SELI_8_PORT33_PIN9, TOUT146_SELC_2_PORT34_PIN1, TOUT155_SELJ_9_PORT01_PIN0, TOUT159_SELD_3_PORT01_PIN1, TOUT162_SELL_11_PORT01_PIN8, TOUT182_SELJ_9_PORT31_PIN8, TOUT187_SELC_2_PORT31_PIN13, TOUT214_SELJ_9_PORT25_PIN8, TOUT219_SELC_2_PORT25_PIN13, TOUT243_SELI_8_PORT15_PIN11, TOUT250_SELJ_9_PORT13_PIN11, TOUT255_SELC_2_PORT13_PIN6, TOUT262_SELC_2_PORT13_PIN13, TOUT147_SELC_2_PORT34_PIN2, TOUT156_SELJ_9_PORT01_PIN2, TOUT158_SELL_11_PORT01_PIN12, TOUT160_SELD_3_PORT01_PIN9, TOUT183_SELJ_9_PORT31_PIN9, TOUT188_SELC_2_PORT31_PIN14, TOUT215_SELJ_9_PORT25_PIN9, TOUT220_SELC_2_PORT25_PIN14, TOUT251_SELK_10_PORT13_PIN10, TOUT256_SELC_2_PORT13_PIN7, TOUT258_SELK_10_PORT14_PIN11, TOUT263_SELC_2_PORT14_PIN15, TOUT148_SELC_2_PORT34_PIN3, TOUT152_SELL_11_PORT02_PIN15, TOUT157_SELJ_9_PORT01_PIN15, TOUT161_SELD_3_PORT01_PIN13, TOUT184_SELJ_9_PORT31_PIN10, TOUT189_SELC_2_PORT31_PIN15, TOUT216_SELJ_9_PORT25_PIN10, TOUT221_SELC_2_PORT25_PIN15, TOUT244_SELI_8_PORT15_PIN12, TOUT252_SELK_10_PORT13_PIN14, TOUT259_SELK_10_PORT14_PIN14, TOUT264_SELC_2_PORT13_PIN15, TOUT149_SELC_2_PORT34_PIN4, TOUT162_SELC_2_PORT01_PIN8, TOUT190_SELC_2_PORT30_PIN0, TOUT222_SELC_2_PORT24_PIN0, TOUT249_SELD_3_PORT13_PIN12, TOUT258_SELJ_9_PORT14_PIN11, TOUT150_SELC_2_PORT34_PIN5, TOUT163_SELC_2_PORT01_PIN10, TOUT191_SELC_2_PORT30_PIN1, TOUT223_SELC_2_PORT24_PIN1, TOUT242_SELD_3_PORT15_PIN10, TOUT245_SELJ_9_PORT15_PIN13, TOUT253_SELJ_9_PORT13_PIN4, TOUT265_SELD_3_PORT10_PIN9, TOUT164_SELC_2_PORT01_PIN14, TOUT192_SELC_2_PORT30_PIN2, TOUT224_SELC_2_PORT24_PIN2, TOUT243_SELD_3_PORT15_PIN11, TOUT246_SELJ_9_PORT15_PIN14, TOUT254_SELJ_9_PORT13_PIN5, TOUT266_SELD_3_PORT10_PIN10, TOUT166_SELC_2_PORT00_PIN14, TOUT193_SELC_2_PORT30_PIN3, TOUT225_SELC_2_PORT24_PIN3, TOUT244_SELD_3_PORT15_PIN12, TOUT247_SELJ_9_PORT15_PIN15, TOUT255_SELJ_9_PORT13_PIN6, TOUT267_SELD_3_PORT10_PIN14, TOUT167_SELC_2_PORT00_PIN13, TOUT194_SELC_2_PORT30_PIN4, TOUT226_SELC_2_PORT24_PIN4, TOUT245_SELD_3_PORT15_PIN13, TOUT248_SELJ_9_PORT13_PIN9, TOUT268_SELD_3_PORT10_PIN13, TOUT168_SELC_2_PORT00_PIN15, TOUT195_SELC_2_PORT30_PIN5, TOUT227_SELC_2_PORT24_PIN5, TOUT246_SELD_3_PORT15_PIN14, TOUT251_SELJ_9_PORT13_PIN10, TOUT269_SELD_3_PORT10_PIN11, TOUT151_SELC_2_PORT02_PIN12, TOUT153_SELC_2_PORT02_PIN13, TOUT196_SELC_2_PORT30_PIN6, TOUT228_SELC_2_PORT24_PIN6, TOUT247_SELD_3_PORT15_PIN15, TOUT249_SELJ_9_PORT13_PIN12, TOUT270_SELD_3_PORT10_PIN15, TOUT152_SELC_2_PORT02_PIN15, TOUT154_SELC_2_PORT02_PIN14, TOUT161_SELK_10_PORT01_PIN13, TOUT197_SELC_2_PORT30_PIN7, TOUT229_SELC_2_PORT24_PIN7, TOUT248_SELD_3_PORT13_PIN9, TOUT261_SELJ_9_PORT14_PIN12, TOUT162_SELD_3_PORT01_PIN8, TOUT198_SELC_2_PORT30_PIN8, TOUT230_SELC_2_PORT24_PIN8, TOUT242_SELJ_9_PORT15_PIN10, TOUT250_SELD_3_PORT13_PIN11, TOUT163_SELD_3_PORT01_PIN10, TOUT199_SELC_2_PORT30_PIN9, TOUT231_SELC_2_PORT24_PIN9, TOUT251_SELD_3_PORT13_PIN10, TOUT258_SELD_3_PORT14_PIN11, TOUT164_SELD_3_PORT01_PIN14, TOUT200_SELC_2_PORT30_PIN10, TOUT232_SELC_2_PORT24_PIN10, TOUT252_SELD_3_PORT13_PIN14, TOUT259_SELD_3_PORT14_PIN14, TOUT166_SELD_3_PORT00_PIN14, TOUT201_SELC_2_PORT30_PIN11, TOUT233_SELC_2_PORT24_PIN11, TOUT253_SELD_3_PORT13_PIN4, TOUT260_SELD_3_PORT14_PIN13, TOUT167_SELD_3_PORT00_PIN13, TOUT202_SELC_2_PORT30_PIN12, TOUT234_SELC_2_PORT24_PIN12, TOUT254_SELD_3_PORT13_PIN5, TOUT261_SELD_3_PORT14_PIN12, TOUT168_SELD_3_PORT00_PIN15, TOUT203_SELC_2_PORT30_PIN13, TOUT235_SELC_2_PORT24_PIN13, TOUT243_SELJ_9_PORT15_PIN11, TOUT255_SELD_3_PORT13_PIN6, TOUT262_SELD_3_PORT13_PIN13, TOUT151_SELD_3_PORT02_PIN12, TOUT153_SELD_3_PORT02_PIN13, TOUT204_SELC_2_PORT30_PIN14, TOUT236_SELC_2_PORT24_PIN14, TOUT256_SELD_3_PORT13_PIN7, TOUT263_SELD_3_PORT14_PIN15, TOUT152_SELD_3_PORT02_PIN15, TOUT154_SELD_3_PORT02_PIN14, TOUT161_SELL_11_PORT01_PIN13, TOUT205_SELC_2_PORT30_PIN15, TOUT237_SELC_2_PORT24_PIN15, TOUT244_SELJ_9_PORT15_PIN12, TOUT264_SELD_3_PORT13_PIN15, TOUT206_SELI_8_PORT25_PIN0, TOUT222_SELI_8_PORT24_PIN0, TOUT207_SELI_8_PORT25_PIN1, TOUT223_SELI_8_PORT24_PIN1, TOUT208_SELI_8_PORT25_PIN2, TOUT224_SELI_8_PORT24_PIN2, TOUT209_SELI_8_PORT25_PIN3, TOUT225_SELI_8_PORT24_PIN3, TOUT210_SELI_8_PORT25_PIN4, TOUT226_SELI_8_PORT24_PIN4, TOUT211_SELI_8_PORT25_PIN5, TOUT227_SELI_8_PORT24_PIN5, TOUT212_SELI_8_PORT25_PIN6, TOUT212_SELI_8_PORT26_PIN0, TOUT228_SELI_8_PORT24_PIN6, TOUT213_SELI_8_PORT25_PIN7, TOUT229_SELI_8_PORT24_PIN7, TOUT174_SELI_8_PORT31_PIN0, TOUT190_SELI_8_PORT30_PIN0, TOUT230_SELI_8_PORT24_PIN8, TOUT175_SELI_8_PORT31_PIN1, TOUT191_SELI_8_PORT30_PIN1, TOUT231_SELI_8_PORT24_PIN9, TOUT176_SELI_8_PORT31_PIN2, TOUT192_SELI_8_PORT30_PIN2, TOUT232_SELI_8_PORT24_PIN10, TOUT177_SELI_8_PORT31_PIN3, TOUT193_SELI_8_PORT30_PIN3, TOUT233_SELI_8_PORT24_PIN11, TOUT178_SELI_8_PORT31_PIN4, TOUT194_SELI_8_PORT30_PIN4, TOUT234_SELI_8_PORT24_PIN12, TOUT179_SELI_8_PORT31_PIN5, TOUT195_SELI_8_PORT30_PIN5, TOUT235_SELI_8_PORT24_PIN13, TOUT180_SELI_8_PORT31_PIN6, TOUT196_SELI_8_PORT30_PIN6, TOUT236_SELI_8_PORT24_PIN14, TOUT181_SELI_8_PORT31_PIN7, TOUT197_SELI_8_PORT30_PIN7, TOUT237_SELI_8_PORT24_PIN15, TOUT182_SELI_8_PORT31_PIN8, TOUT198_SELI_8_PORT30_PIN8, TOUT214_SELI_8_PORT25_PIN8, TOUT242_SELK_10_PORT15_PIN10, TOUT265_SELI_8_PORT10_PIN9, TOUT183_SELI_8_PORT31_PIN9, TOUT199_SELI_8_PORT30_PIN9, TOUT215_SELI_8_PORT25_PIN9, TOUT243_SELK_10_PORT15_PIN11, TOUT266_SELI_8_PORT10_PIN10, TOUT184_SELI_8_PORT31_PIN10, TOUT200_SELI_8_PORT30_PIN10, TOUT216_SELI_8_PORT25_PIN10, TOUT244_SELK_10_PORT15_PIN12, TOUT269_SELI_8_PORT10_PIN11, TOUT185_SELI_8_PORT31_PIN11, TOUT201_SELI_8_PORT30_PIN11, TOUT217_SELI_8_PORT25_PIN11, TOUT245_SELK_10_PORT15_PIN13, TOUT268_SELI_8_PORT10_PIN13, TOUT186_SELI_8_PORT31_PIN12, TOUT202_SELI_8_PORT30_PIN12, TOUT218_SELI_8_PORT25_PIN12, TOUT246_SELK_10_PORT15_PIN14, TOUT267_SELI_8_PORT10_PIN14, TOUT187_SELI_8_PORT31_PIN13, TOUT203_SELI_8_PORT30_PIN13, TOUT219_SELI_8_PORT25_PIN13, TOUT247_SELK_10_PORT15_PIN15, TOUT270_SELI_8_PORT10_PIN15, TOUT127_SELJ_9_PORT11_PIN15, TOUT188_SELI_8_PORT31_PIN14, TOUT204_SELI_8_PORT30_PIN14, TOUT220_SELI_8_PORT25_PIN14, TOUT126_SELJ_9_PORT11_PIN14, TOUT189_SELI_8_PORT31_PIN15, TOUT205_SELI_8_PORT30_PIN15, TOUT221_SELI_8_PORT25_PIN15}, origin=INFINEON_AURIX2G, post-build-variant-value=true, set at post-build, default-value=NONE  # This parameter decides the output port and pin for the GTM timer.
        container GtmTimGlobalConf [8..8]  # This container holds the configuration parameters for the TIM global parameters.
          container GtmTimChannelConf [8..8]  # This container holds the configuration parameters for TIM channel- level parameters required to be configured globally.
            enumeration GtmTimInpPortPinSel: {SEL0_NONE, SEL2_PORT02_PIN0, SEL3_PORT10_PIN7, SEL1_PORT00_PIN9, SEL11_PORT13_PIN12, SEL10_PORT33_PIN4, SEL9_PORT33_PIN10, SEL8_PORT22_PIN1, SEL7_PORT21_PIN2, SEL6_PORT15_PIN6, SEL4_PORT14_PIN5, SEL5_PORT14_PIN7, SEL3_PORT10_PIN1, SEL1_PORT00_PIN10, SEL2_PORT02_PIN1, SEL10_PORT10_PIN9, SEL8_PORT33_PIN5, SEL9_PORT33_PIN9, SEL7_PORT22_PIN0, SEL6_PORT21_PIN3, SEL5_PORT15_PIN7, SEL4_PORT14_PIN6, SEL3_PORT10_PIN2, SEL4_PORT10_PIN5, SEL10_PORT02_PIN9, SEL1_PORT00_PIN11, SEL11_PORT10_PIN10, SEL9_PORT33_PIN6, SEL2_PORT02_PIN2, SEL8_PORT33_PIN11, SEL7_PORT23_PIN5, SEL6_PORT21_PIN4, SEL5_PORT15_PIN8, SEL3_PORT10_PIN3, SEL4_PORT10_PIN6, SEL10_PORT02_PIN10, SEL1_PORT00_PIN12, SEL11_PORT10_PIN14, SEL9_PORT33_PIN7, SEL8_PORT32_PIN2, SEL2_PORT02_PIN3, SEL7_PORT22_PIN2, SEL6_PORT21_PIN5, SEL5_PORT14_PIN0, SEL2_PORT10_PIN0, SEL6_PORT33_PIN0, SEL9_PORT10_PIN13, SEL7_PORT33_PIN8, SEL5_PORT32_PIN3, SEL1_PORT02_PIN4, SEL4_PORT22_PIN3, SEL8_PORT21_PIN6, SEL3_PORT14_PIN1, SEL2_PORT10_PIN8, SEL8_PORT01_PIN3, SEL6_PORT33_PIN1, SEL9_PORT10_PIN11, SEL5_PORT32_PIN4, SEL4_PORT23_PIN0, SEL7_PORT21_PIN7, SEL1_PORT02_PIN5, SEL3_PORT14_PIN2, SEL2_PORT10_PIN4, SEL8_PORT01_PIN4, SEL6_PORT33_PIN2, SEL9_PORT10_PIN15, SEL4_PORT23_PIN1, SEL5_PORT23_PIN2, SEL7_PORT20_PIN0, SEL1_PORT02_PIN6, SEL3_PORT14_PIN3, SEL7_PORT02_PIN11, SEL8_PORT11_PIN15, SEL6_PORT33_PIN3, SEL4_PORT23_PIN3, SEL5_PORT23_PIN4, SEL3_PORT20_PIN8, SEL1_PORT02_PIN7, SEL2_PORT14_PIN4, SEL10_PORT23_PIN6, SEL10_PORT23_PIN7, SEL9_PORT20_PIN0, SEL8_PORT20_PIN7, SEL14_PORT01_PIN3, SEL7_PORT11_PIN0, SEL8_PORT33_PIN14, SEL13_PORT31_PIN0, SEL6_PORT33_PIN12, SEL5_PORT20_PIN12, SEL4_PORT15_PIN5, SEL2_PORT02_PIN8, SEL3_PORT13_PIN3, SEL9_PORT11_PIN10, SEL1_PORT00_PIN0, SEL1_PORT00_PIN1, SEL14_PORT01_PIN4, SEL2_PORT00_PIN2, SEL6_PORT11_PIN1, SEL7_PORT33_PIN15, SEL9_PORT31_PIN1, SEL8_PORT15_PIN10, SEL5_PORT33_PIN13, SEL4_PORT20_PIN13, SEL3_PORT11_PIN2, SEL7_PORT01_PIN5, SEL6_PORT11_PIN4, SEL1_PORT00_PIN3, SEL9_PORT31_PIN2, SEL8_PORT15_PIN11, SEL5_PORT32_PIN0, SEL4_PORT20_PIN14, SEL14_PORT15_PIN6, SEL3_PORT14_PIN8, SEL2_PORT11_PIN3, SEL8_PORT11_PIN5, SEL1_PORT00_PIN4, SEL9_PORT34_PIN1, SEL14_PORT31_PIN3, SEL6_PORT15_PIN12, SEL5_PORT20_PIN1, SEL4_PORT15_PIN0, SEL3_PORT14_PIN9, SEL2_PORT11_PIN6, SEL7_PORT11_PIN7, SEL8_PORT34_PIN2, SEL1_PORT00_PIN5, SEL14_PORT02_PIN14, SEL12_PORT31_PIN4, SEL9_PORT15_PIN13, SEL6_PORT21_PIN0, SEL5_PORT20_PIN3, SEL4_PORT15_PIN1, SEL3_PORT14_PIN10, SEL2_PORT11_PIN9, SEL7_PORT01_PIN6, SEL8_PORT11_PIN8, SEL9_PORT34_PIN3, SEL14_PORT02_PIN15, SEL1_PORT00_PIN6, SEL13_PORT31_PIN5, SEL12_PORT15_PIN14, SEL6_PORT21_PIN1, SEL5_PORT20_PIN9, SEL4_PORT15_PIN2, SEL3_PORT13_PIN0, SEL2_PORT11_PIN10, SEL2_PORT11_PIN11, SEL7_PORT11_PIN13, SEL14_PORT22_PIN6, SEL8_PORT34_PIN4, SEL13_PORT01_PIN0, SEL1_PORT00_PIN7, SEL12_PORT31_PIN6, SEL9_PORT15_PIN15, SEL5_PORT20_PIN6, SEL6_PORT20_PIN10, SEL4_PORT15_PIN3, SEL3_PORT13_PIN1, SEL2_PORT11_PIN12, SEL7_PORT01_PIN7, SEL8_PORT11_PIN14, SEL9_PORT34_PIN5, SEL1_PORT00_PIN8, SEL14_PORT31_PIN7, SEL12_PORT13_PIN9, SEL5_PORT20_PIN7, SEL6_PORT20_PIN11, SEL4_PORT15_PIN4, SEL3_PORT13_PIN2, SEL14_PORT11_PIN11, SEL7_PORT12_PIN0, SEL8_PORT22_PIN4, SEL11_PORT00_PIN5, SEL12_PORT25_PIN0, SEL13_PORT33_PIN0, SEL9_PORT13_PIN11, SEL10_PORT02_PIN6, SEL6_PORT12_PIN1, SEL7_PORT22_PIN5, SEL14_PORT00_PIN6, SEL11_PORT25_PIN1, SEL15_PORT33_PIN1, SEL8_PORT13_PIN10, SEL9_PORT14_PIN11, SEL10_PORT02_PIN7, SEL6_PORT22_PIN6, SEL11_PORT00_PIN7, SEL9_PORT25_PIN2, SEL14_PORT33_PIN2, SEL7_PORT13_PIN14, SEL8_PORT14_PIN14, SEL10_PORT02_PIN8, SEL7_PORT22_PIN7, SEL11_PORT00_PIN8, SEL9_PORT25_PIN3, SEL8_PORT13_PIN4, SEL12_PORT33_PIN3, SEL6_PORT14_PIN13, SEL15_PORT32_PIN1, SEL11_PORT02_PIN10, SEL7_PORT22_PIN8, SEL12_PORT34_PIN1, SEL10_PORT25_PIN4, SEL9_PORT13_PIN5, SEL8_PORT14_PIN12, SEL12_PORT02_PIN11, SEL7_PORT22_PIN9, SEL8_PORT32_PIN5, SEL13_PORT34_PIN2, SEL11_PORT25_PIN5, SEL10_PORT13_PIN6, SEL9_PORT13_PIN13, SEL7_PORT22_PIN10, SEL8_PORT32_PIN6, SEL13_PORT34_PIN3, SEL12_PORT02_PIN12, SEL14_PORT25_PIN6, SEL11_PORT26_PIN0, SEL10_PORT13_PIN7, SEL9_PORT14_PIN15, SEL7_PORT22_PIN11, SEL8_PORT32_PIN7, SEL12_PORT34_PIN4, SEL11_PORT02_PIN13, SEL10_PORT25_PIN7, SEL9_PORT13_PIN15, SEL12_PORT10_PIN0, SEL13_PORT10_PIN8, SEL4_PORT11_PIN0, SEL5_PORT12_PIN0, SEL15_PORT32_PIN7, SEL3_PORT02_PIN12, SEL2_PORT01_PIN12, SEL1_PORT00_PIN13, SEL7_PORT00_PIN9, SEL10_PORT30_PIN0, SEL9_PORT25_PIN8, SEL8_PORT24_PIN0, SEL6_PORT13_PIN12, SEL11_PORT21_PIN0, SEL5_PORT11_PIN1, SEL14_PORT32_PIN5, SEL3_PORT02_PIN15, SEL2_PORT01_PIN1, SEL1_PORT00_PIN15, SEL10_PORT30_PIN1, SEL11_PORT00_PIN10, SEL9_PORT25_PIN9, SEL8_PORT24_PIN1, SEL7_PORT15_PIN10, SEL4_PORT10_PIN9, SEL13_PORT21_PIN1, SEL13_PORT10_PIN6, SEL2_PORT02_PIN9, SEL5_PORT11_PIN4, SEL7_PORT23_PIN6, SEL3_PORT02_PIN13, SEL1_PORT01_PIN9, SEL10_PORT30_PIN2, SEL11_PORT00_PIN11, SEL9_PORT25_PIN10, SEL8_PORT24_PIN2, SEL6_PORT15_PIN11, SEL4_PORT10_PIN10, SEL12_PORT21_PIN6, SEL13_PORT10_PIN5, SEL2_PORT02_PIN10, SEL5_PORT11_PIN5, SEL7_PORT23_PIN7, SEL3_PORT02_PIN14, SEL1_PORT01_PIN13, SEL10_PORT30_PIN3, SEL9_PORT25_PIN11, SEL11_PORT00_PIN12, SEL8_PORT24_PIN3, SEL4_PORT10_PIN14, SEL12_PORT21_PIN7, SEL12_PORT10_PIN1, SEL3_PORT02_PIN11, SEL5_PORT11_PIN7, SEL15_PORT32_PIN6, SEL1_PORT01_PIN0, SEL2_PORT01_PIN8, SEL9_PORT30_PIN4, SEL8_PORT25_PIN12, SEL7_PORT24_PIN4, SEL6_PORT15_PIN13, SEL4_PORT10_PIN13, SEL14_PORT33_PIN10, SEL11_PORT20_PIN1, SEL12_PORT10_PIN2, SEL2_PORT01_PIN3, SEL5_PORT11_PIN8, SEL14_PORT33_PIN14, SEL1_PORT01_PIN2, SEL3_PORT01_PIN10, SEL9_PORT30_PIN5, SEL8_PORT25_PIN13, SEL7_PORT24_PIN5, SEL6_PORT15_PIN14, SEL4_PORT10_PIN11, SEL10_PORT33_PIN5, SEL11_PORT20_PIN3, SEL10_PORT10_PIN3, SEL2_PORT01_PIN4, SEL5_PORT11_PIN13, SEL12_PORT33_PIN15, SEL1_PORT01_PIN15, SEL3_PORT01_PIN14, SEL9_PORT30_PIN6, SEL8_PORT25_PIN14, SEL7_PORT24_PIN6, SEL6_PORT15_PIN15, SEL4_PORT10_PIN15, SEL3_PORT10_PIN4, SEL4_PORT11_PIN14, SEL5_PORT11_PIN15, SEL12_PORT34_PIN5, SEL2_PORT01_PIN11, SEL1_PORT00_PIN14, SEL9_PORT30_PIN7, SEL8_PORT25_PIN15, SEL7_PORT24_PIN7, SEL6_PORT13_PIN9, SEL10_PORT14_PIN7, SEL4_PORT22_PIN8, SEL10_PORT01_PIN8, SEL7_PORT31_PIN8, SEL6_PORT30_PIN8, SEL5_PORT24_PIN8, SEL10_PORT22_PIN9, SEL9_PORT33_PIN15, SEL11_PORT01_PIN9, SEL8_PORT31_PIN9, SEL7_PORT30_PIN9, SEL6_PORT24_PIN9, SEL5_PORT13_PIN10, SEL4_PORT14_PIN11, SEL8_PORT22_PIN10, SEL2_PORT02_PIN13, SEL9_PORT01_PIN10, SEL7_PORT31_PIN10, SEL6_PORT30_PIN10, SEL5_PORT24_PIN10, SEL4_PORT13_PIN14, SEL3_PORT14_PIN14, SEL2_PORT01_PIN5, SEL10_PORT22_PIN11, SEL11_PORT01_PIN11, SEL8_PORT31_PIN11, SEL7_PORT30_PIN11, SEL6_PORT24_PIN11, SEL4_PORT13_PIN4, SEL5_PORT14_PIN13, SEL9_PORT34_PIN2, SEL8_PORT31_PIN12, SEL7_PORT30_PIN12, SEL6_PORT24_PIN12, SEL4_PORT13_PIN5, SEL5_PORT14_PIN12, SEL11_PORT21_PIN2, SEL10_PORT00_PIN0, SEL11_PORT00_PIN1, SEL3_PORT01_PIN6, SEL9_PORT32_PIN5, SEL10_PORT34_PIN3, SEL2_PORT01_PIN10, SEL8_PORT31_PIN13, SEL7_PORT30_PIN13, SEL6_PORT24_PIN13, SEL4_PORT13_PIN6, SEL5_PORT13_PIN13, SEL12_PORT21_PIN3, SEL2_PORT01_PIN6, SEL11_PORT00_PIN2, SEL9_PORT32_PIN6, SEL10_PORT34_PIN4, SEL8_PORT31_PIN14, SEL7_PORT30_PIN14, SEL6_PORT24_PIN14, SEL4_PORT13_PIN7, SEL5_PORT14_PIN15, SEL12_PORT21_PIN4, SEL2_PORT01_PIN7, SEL10_PORT00_PIN3, SEL3_PORT01_PIN11, SEL7_PORT31_PIN15, SEL6_PORT30_PIN15, SEL5_PORT24_PIN15, SEL4_PORT13_PIN15, SEL11_PORT21_PIN5, SEL2_PORT23_PIN7, SEL3_PORT01_PIN12, SEL9_PORT31_PIN8, SEL8_PORT30_PIN8, SEL7_PORT25_PIN0, SEL6_PORT24_PIN0, SEL5_PORT10_PIN9, SEL1_PORT20_PIN6, SEL2_PORT23_PIN6, SEL3_PORT01_PIN13, SEL9_PORT31_PIN9, SEL8_PORT30_PIN9, SEL7_PORT25_PIN1, SEL6_PORT24_PIN1, SEL5_PORT10_PIN10, SEL1_PORT20_PIN7, SEL9_PORT31_PIN10, SEL8_PORT30_PIN10, SEL7_PORT25_PIN2, SEL6_PORT24_PIN2, SEL5_PORT10_PIN11, SEL2_PORT23_PIN5, SEL1_PORT20_PIN8, SEL3_PORT01_PIN15, SEL9_PORT31_PIN11, SEL8_PORT30_PIN11, SEL7_PORT25_PIN3, SEL6_PORT24_PIN3, SEL5_PORT10_PIN13, SEL2_PORT23_PIN4, SEL1_PORT20_PIN9, SEL6_PORT25_PIN4, SEL5_PORT24_PIN4, SEL4_PORT13_PIN9, SEL3_PORT14_PIN12, SEL2_PORT23_PIN3, SEL2_PORT00_PIN13, SEL6_PORT25_PIN5, SEL5_PORT24_PIN5, SEL4_PORT13_PIN10, SEL3_PORT14_PIN13, SEL1_PORT23_PIN2, SEL2_PORT00_PIN14, SEL6_PORT25_PIN6, SEL9_PORT26_PIN0, SEL5_PORT24_PIN6, SEL4_PORT13_PIN11, SEL1_PORT23_PIN1, SEL2_PORT00_PIN15, SEL8_PORT31_PIN15, SEL7_PORT30_PIN15, SEL6_PORT25_PIN7, SEL5_PORT24_PIN7, SEL4_PORT13_PIN12, SEL3_PORT14_PIN15, SEL1_PORT23_PIN0, SEL8_PORT31_PIN0, SEL7_PORT30_PIN0, SEL6_PORT25_PIN8, SEL2_PORT15_PIN10, SEL3_PORT13_PIN13, SEL1_PORT22_PIN3, SEL8_PORT31_PIN1, SEL7_PORT30_PIN1, SEL6_PORT25_PIN9, SEL5_PORT24_PIN9, SEL2_PORT15_PIN11, SEL3_PORT13_PIN14, SEL1_PORT22_PIN2, SEL7_PORT31_PIN2, SEL6_PORT30_PIN2, SEL5_PORT25_PIN10, SEL4_PORT24_PIN10, SEL2_PORT15_PIN12, SEL3_PORT13_PIN15, SEL1_PORT22_PIN1, SEL2_PORT12_PIN0, SEL7_PORT31_PIN3, SEL6_PORT30_PIN3, SEL5_PORT25_PIN11, SEL4_PORT24_PIN11, SEL3_PORT15_PIN13, SEL1_PORT22_PIN0, SEL1_PORT12_PIN1, SEL6_PORT31_PIN4, SEL5_PORT30_PIN4, SEL4_PORT25_PIN12, SEL3_PORT24_PIN12, SEL2_PORT15_PIN14, SEL1_PORT11_PIN0, SEL6_PORT31_PIN5, SEL5_PORT30_PIN5, SEL4_PORT25_PIN13, SEL3_PORT24_PIN13, SEL2_PORT15_PIN15, SEL1_PORT11_PIN1, SEL6_PORT31_PIN6, SEL5_PORT30_PIN6, SEL4_PORT25_PIN14, SEL3_PORT24_PIN14, SEL2_PORT14_PIN11, SEL1_PORT11_PIN4, SEL5_PORT31_PIN7, SEL4_PORT30_PIN7, SEL2_PORT24_PIN15}, origin=INFINEON_AURIX2G, post-build-variant-value=true, set at post-build, default-value=SEL0_NONE  # This parameter to configure the input port pin connection for TIM channels.
        container GtmTriggerForAdc [12..12]  # This Specifies the TOM/ATOM channels that can be used as ADC Triggers
          enumeration GtmAdcTrigger{0..4}Select: {TRIG_0_NO_TRIGGER, TRIG_1, TRIG_2, TRIG_3, TRIG_4, TRIG_5, TRIG_6, TRIG_7, TRIG_8, TRIG_9, TRIG_10, TRIG_11, TRIG_12, TRIG_13, TRIG_14, TRIG_15}, origin=INFINEON_AURIX2G, post-build-variant-value=true, set at post-build, default-value=TRIG_0_NO_TRIGGER  # This parameter defines the GTM timer (TOM/ATOM) channel controlling the adc_trig{0..4} signal. TRIG_'VAL'_NO_TRIGGER indicating that this trigger line is electrically disconnected from possible trigger sources. TRIG_'VAL' - 'VAL' is the value programmed into the register. TOMx/ATOMx is the module containing Channel which generates the trigger.
        container GtmTriggerForDsadc [14..14]  # This Specifies the TOM/ATOM channels that can be used as DSADC Triggers
          enumeration GtmDsadcTrigger0Select: {TRIG_0_NO_TRIGGER, TRIG_0_TOM_0_6, TRIG_1_TOM_0_7, TRIG_2_TOM_0_13, TRIG_3_TOM_0_14, TRIG_4_ATOM_0_4, TRIG_5_ATOM_0_5, TRIG_6_ATOM_0_6, TRIG_7_ATOM_0_7, TRIG_8_ATOM_1_4, TRIG_9_ATOM_1_5, TRIG_10_ATOM_1_6, TRIG_11_ATOM_1_7, TRIG_12_ATOM_4_6, TRIG_13_ATOM_4_7, TRIG_14_ATOM_6_6}, origin=INFINEON_AURIX2G, post-build-variant-value=true, set at post-build, default-value=TRIG_0_NO_TRIGGER  # This parameter defines the GTM timer (TOM/ATOM) channel controlling the adc_trig0 signal. TRIG_'VAL'_NO_TRIGGER indicating that this trigger line is electrically disconnected from possible trigger sources. TRIG_'VAL' - 'VAL' is the value programmed into the register. TOMx/ATOMx is the module containing Channel which generates the trigger.
          enumeration GtmDsadcTrigger1Select: {TRIG_0_NO_TRIGGER, TRIG_0_TOM_2_6, TRIG_1_TOM_2_7, TRIG_2_TOM_2_13, TRIG_3_TOM_2_14, TRIG_4_ATOM_2_4, TRIG_5_ATOM_2_5, TRIG_6_ATOM_2_6, TRIG_7_ATOM_2_7, TRIG_8_ATOM_3_4, TRIG_9_ATOM_3_5, TRIG_10_ATOM_3_6, TRIG_11_ATOM_3_7, TRIG_12_ATOM_5_6, TRIG_13_ATOM_5_7, TRIG_14_ATOM_6_7}, origin=INFINEON_AURIX2G, post-build-variant-value=true, set at post-build, default-value=TRIG_0_NO_TRIGGER  # This parameter defines the GTM timer (TOM/ATOM) channel controlling the adc_trig1 signal. TRIG_'VAL'_NO_TRIGGER indicating that this trigger line is electrically disconnected from possible trigger sources. TRIG_'VAL' - 'VAL' is the value programmed into the register. TOMx/ATOMx is the module containing Channel which generates the trigger.
          enumeration GtmDsadcTrigger2Select: {TRIG_0_NO_TRIGGER, TRIG_0_TOM_1_7, TRIG_1_TOM_1_14, TRIG_2_TOM_3_7, TRIG_3_TOM_3_14, TRIG_4_TOM_4_7, TRIG_5_TOM_4_14, TRIG_6_TOM_5_7, TRIG_7_TOM_5_14, TRIG_8_ATOM_7_6, TRIG_9_ATOM_7_7, TRIG_10_ATOM_8_6, TRIG_11_ATOM_8_7, TRIG_12_ATOM_9_6, TRIG_13_ATOM_9_7, TRIG_14_ATOM_11_6}, origin=INFINEON_AURIX2G, post-build-variant-value=true, set at post-build, default-value=TRIG_0_NO_TRIGGER  # This parameter defines the GTM timer (TOM/ATOM) channel controlling the adc_trig2 signal. TRIG_'VAL'_NO_TRIGGER indicating that this trigger line is electrically disconnected from possible trigger sources. TRIG_'VAL' - 'VAL' is the value programmed into the register. TOMx/ATOMx is the module containing Channel which generates the trigger.
          enumeration GtmDsadcTrigger3Select: {TRIG_0_NO_TRIGGER, TRIG_0_TOM_1_6, TRIG_1_ATOM_10_6, TRIG_2_ATOM_10_7, TRIG_3_ATOM_11_7}, origin=INFINEON_AURIX2G, post-build-variant-value=true, set at post-build, default-value=TRIG_0_NO_TRIGGER  # This parameter defines the GTM timer (TOM/ATOM) channel controlling the adc_trig3 signal. TRIG_'VAL'_NO_TRIGGER indicating that this trigger line is electrically disconnected from possible trigger sources. TRIG_'VAL' - 'VAL' is the value programmed into the register. TOMx/ATOMx is the module containing Channel which generates the trigger.
    container McuHardwareResourceAllocationConf  # Mcu Hardware resource allocation configuration
      container McuGtmAllocationConf  # Mcu GTM unit resource allocation configuration
        container McuGtmTimAllocationConf [8..8]  # This container contains the TIM Configuration for GTM
          container McuGtmTimChannelAllocationConf [8..8]  # This container contains the TIM Channel Configuration
            enumeration McuGtmTimChannelAllocationConf: {GTM_TIM_CHANNEL_NOT_USED, GTM_TIM_CHANNEL_USED_BY_ICU}, origin=INFINEON_AURIX2G, set at pre-compile, default-value=GTM_TIM_CHANNEL_NOT_USED  # This decides as to if this Channel is used for ICU or will it not be used. GTM_TIM_CHANNEL_NOT_USED: Specifies that this Channel is not configured by any module (unused). GTM_TIM_CHANNEL_USED_BY_ICU: Specifies that this Channel is configured by ICU module.
        container McuGtmTomAllocationConf [6..6]  # This container contains the TOM Configuration for GTM
          container McuGtmTomChannelAllocationConf [16..16]  # This container contains the TOM Channel Configuration
            enumeration McuGtmTomChannelAllocationConf: {GTM_TOM_CHANNEL_NOT_USED, GTM_TOM_CHANNEL_USED_BY_ADC, GTM_TOM_CHANNEL_USED_BY_WDG, GTM_TOM_CHANNEL_USED_BY_PWM, GTM_TOM_CHANNEL_USED_BY_GPT, GTM_TOM_CHANNEL_USED_BY_OCU}, origin=INFINEON_AURIX2G, set at pre-compile, default-value=GTM_TOM_CHANNEL_NOT_USED  # This decides as to if this Channel is used or will it not be used. GTM_TOM_CHANNEL_NOT_USED: Specifies that this Channel is not configured by any module (unused). GTM_TOM_CHANNEL_USED_BY_ADC: Specifies that this Channel is configured by ADC module. GTM_TOM_CHANNEL_USED_BY_WDG: Specifies that this Channel is configured by WDG module. GTM_TOM_CHANNEL_USED_BY_PWM: Specifies that this Channel is configured by PWM module. GTM_TOM_CHANNEL_USED_BY_GPT: Specifies that this Channel is configured by GPT module. GTM_TOM_CHANNEL_USED_BY_OCU: Specifies that this Channel is configured by OCU module.
            boolean McuTomChannelEventHandledByDsadc: origin=INFINEON_AURIX2G, set at pre-compile, default-value=false  # This parameter specifies which callback will be invoked when an event occurs TRUE : The callback of DSADC is invoked on an event. FALSE: The callback of the module which has configured the channel is invoked on an event.
        container McuGtmAtomAllocationConf [12..12]  # This container contains the ATOM Configuration for GTM
          container McuGtmAtomChannelAllocationConf [8..8]  # This container contains the ATOM Channel Configuration
            enumeration McuGtmAtomChannelAllocationConf: {GTM_ATOM_CHANNEL_NOT_USED, GTM_ATOM_CHANNEL_USED_BY_ADC, GTM_ATOM_CHANNEL_USED_BY_GPT, GTM_ATOM_CHANNEL_USED_BY_OCU, GTM_ATOM_CHANNEL_USED_BY_PWM, GTM_ATOM_CHANNEL_USED_BY_WDG}, origin=INFINEON_AURIX2G, set at pre-compile, default-value=GTM_ATOM_CHANNEL_NOT_USED  # This decides as to if this Channel is used or will it not be used. GTM_ATOM_CHANNEL_NOT_USED: Specifies that this Channel is not configured by any module (unused). GTM_ATOM_CHANNEL_USED_BY_ADC: Specifies that this Channel is configured by ADC module. GTM_ATOM_CHANNEL_USED_BY_GPT: Specifies that this Channel is configured by GPT module. GTM_ATOM_CHANNEL_USED_BY_OCU: Specifies that this Channel is configured by OCU module. GTM_ATOM_CHANNEL_USED_BY_PWM: Specifies that this Channel is configured by PWM module. GTM_ATOM_CHANNEL_USED_BY_WDG: Specifies that this Channel is configured by WDG module.
            boolean McuAtomChannelEventHandledByDsadc: origin=INFINEON_AURIX2G, set at pre-compile, default-value=false  # This parameter specifies which callback will be invoked when an event occurs TRUE : The callback of DSADC is invoked on an event. FALSE: The callback of the module which has configured the channel is invoked on an event.
      container McuAscLinAllocationConf [12..12]  # This container contains the AscLin Configuration
        container McuAscLinChannelAllocationConf  # This container defines the AscLin Channel Configuration
          enumeration McuAscLinChannelAllocationConf: {ASCLIN_CH_NOT_USED, ASCLIN_CH_USED_BY_LIN_DRIVER, ASCLIN_CH_USED_BY_UART_DRIVER, ASCLIN_CH_USED_BY_STDLIN_DRIVER}, origin=INFINEON_AURIX2G, set at pre-compile, default-value=ASCLIN_CH_NOT_USED  # This decides the usage of ASCLIN channel. This parameter is currently disabled, as none of the drivers are using ASCLIN channels. ASCLIN_CH_NOT_USED: Specifies that this Channel is not configured by any module (unused). ASCLIN_CH_USED_BY_LIN_DRIVER: Specifies that this Channel is configured by LIN module. ASCLIN_CH_USED_BY_UART_DRIVER: Specifies that this Channel is configured by UART module.
          enumeration McuAscLinKernelId: {ASCLIN0, ASCLIN1, ASCLIN2, ASCLIN3, ASCLIN4, ASCLIN5, ASCLIN6, ASCLIN7, ASCLIN8, ASCLIN9, ASCLIN10, ASCLIN11}, origin=INFINEON_AURIX2G, set at pre-compile, default-value=ASCLIN0  # Specifies the Kernel Id for the respective Asclin channel.
      container McuCcu6ModuleAllocationConf [2..2]  # This container contains the Ccu6 Configuration
        enumeration McuCcu6ModuleAllocationConf: {CCU6_MODULE_NOT_USED, CCU6_MODULE_USED_BY_ADC_DRIVER, CCU6_MODULE_USED_BY_ICU_DRIVER, CCU6_MODULE_USED_BY_PWM_DRIVER}, origin=INFINEON_AURIX2G, set at pre-compile, default-value=CCU6_MODULE_NOT_USED  # This decides the usage of CCU6 module. CCU6_MODULE_NOT_USED: Specifies that this Channel is not configured by any module (unused). CCU6_MODULE_USED_BY_ADC_DRIVER: Specifies that this Module is configured by ADC module. CCU6_MODULE_USED_BY_ICU_DRIVER: Specifies that this Module is configured by ICU module. CCU6_MODULE_USED_BY_PWM_DRIVER: Specifies that this Module is configured by PWM module.
      container McuGpt12ModuleAllocationConf [5..5]  # This container contains the GPT12 allocation configuration
        enumeration McuGpt12TimerAllocation: {GPT_TIMER_2, GPT_TIMER_3, GPT_TIMER_4, GPT_TIMER_5, GPT_TIMER_6}, origin=INFINEON_AURIX2G, set at pre-compile, default-value=GPT_TIMER_2  # This denotes the timer in GPT1 or GPT2 block
        enumeration McuGpt12ModuleAllocationConf: {GPT_TIMER_NOT_USED, GPT_TIMER_USED_BY_ICU_DRIVER, GPT_TIMER_USED_BY_GPT_DRIVER}, origin=INFINEON_AURIX2G, set at pre-compile, default-value=GPT_TIMER_NOT_USED  # This decides the usage of the timer of GPT1/GPT2 Timer block. GPT_TIMER_NOT_USED: Specifies that this timer is not configured by any module (unused). GPT_TIMER_USED_BY_ICU_DRIVER: Specifies that this timer is configured by ICU module. GPT_TIMER_USED_BY_GPT_DRIVER: Specifies that this timer is configured by GPT module.
      container McuEruAllocationConf  # This container contains the ERU module configurations
        container McuEruChannelInputLineConf [8..8]  # This container contains the ERU input line Configuration
          enumeration McuEruChannelInputLineConf: {ERU_CHANNEL_INP_NOT_USED, ERU_CHANNEL_INP_USED_BY_ADC_DRIVER, ERU_CHANNEL_INP_USED_BY_DSADC_DRIVER, ERU_CHANNEL_INP_USED_BY_ICU_DRIVER}, origin=INFINEON_AURIX2G, set at pre-compile, default-value=ERU_CHANNEL_INP_NOT_USED  # This decides usage of ERU input channel. ERU_CHANNEL_INP_NOT_USED: Specifies that this Channel is not configured by any module (unused). ERU_CHANNEL_INP_USED_BY_ADC_DRIVER: Specifies that this Channel is configured by ADC module. ERU_CHANNEL_INP_USED_BY_ICU_DRIVER: Specifies that this Channel is configured by ICU module. ERU_CHANNEL_INP_USED_BY_DSADC_DRIVER: Specifies that this Channel is configured by DSADC module.
        container McuEruChannelOutputUnitConf [8..8]  # This container contains the ERU output line Configuration
          enumeration McuEruChannelOutputUnitConf: {ERU_CHANNEL_OUT_NOT_USED, ERU_CHANNEL_OUT_USED_BY_ADC_DRIVER, ERU_CHANNEL_OUT_USED_BY_ICU_DRIVER, ERU_CHANNEL_OUT_USED_BY_DSADC_DRIVER}, origin=INFINEON_AURIX2G, set at pre-compile, default-value=ERU_CHANNEL_OUT_NOT_USED  # This decides the usage of ERU output channel. ERU_CHANNEL_OUT_NOT_USED: Specifies that this Channel is not configured by any module (unused). ERU_CHANNEL_OUT_USED_BY_ADC_DRIVER: Specifies that this Channel is configured by ADC module. ERU_CHANNEL_OUT_USED_BY_ICU_DRIVER: Specifies that this Channel is configured by ICU module. ERU_CHANNEL_OUT_USED_BY_DSADC_DRIVER: Specifies that this Channel is configured by DSADC module.
      container McuStmAllocationConf [6..6]  # Mcu STM resource allocation configuration
        enumeration McuStmCmp0RegAllocationConf: {STM_CMP0_NOT_USED, STM_CMP0_USED_BY_WDG, STM_CMP0_USED_BY_STM}, origin=INFINEON_AURIX2G, set at pre-compile, default-value=STM_CMP0_NOT_USED  # The STM timer compare register 0 usage. STM_CMP0_NOT_USED: STM timer compare register 0 not used. STM_CMP0_USED_BY_WDG: STM timer compare register 0 used by WDG. STM_CMP0_USED_BY_STM: STM timer compare register 0 used by STM.
        enumeration McuStmCmp1RegAllocationConf: {STM_CMP1_NOT_USED, STM_CMP1_USED_BY_WDG, STM_CMP1_USED_BY_STM}, origin=INFINEON_AURIX2G, set at pre-compile, default-value=STM_CMP1_NOT_USED  # The STM timer compare register 1 usage. STM_CMP1_NOT_USED: STM timer compare register 1 not used. STM_CMP1_USED_BY_WDG: STM timer compare register 1 used by WDG. STM_CMP1_USED_BY_STM: STM timer compare register 1 used by STM.
    container McuDemEventParameterRefsConf [0..1]: multiplicity set at pre-compile  # Container for the references to DemEventParameter elements which shall be invoked using the API Mcal_Wrapper_Dem_SetEventStatus API in case the corresponding error occurs. The EventId is taken from the referenced DemEventParameter's DemEventId symbolic name. The standardized errors are provided in the container and can be extended by vendor specific error references.
      reference MCU_E_OSC_FAILURE [0..1]: multiplicity set at pre-compile, origin=INFINEON_AURIX2G, set at pre-compile, requires-symbolic-name-value=true, destination=DemEventParameter  # Reference to the DemEventParameter which shall be raised on Oscillator Failure
      reference MCU_E_SYSTEM_PLL_TIMEOUT_ERR [0..1]: multiplicity set at pre-compile, origin=INFINEON_AURIX2G, set at pre-compile, requires-symbolic-name-value=true, destination=DemEventParameter  # Reference to the DemEventParameter which is raised due to inability of System PLL K2 divider and power mode to be updated within the specified time.
      reference MCU_E_PERIPHERAL_PLL_TIMEOUT_ERR [0..1]: multiplicity set at pre-compile, origin=INFINEON_AURIX2G, set at pre-compile, requires-symbolic-name-value=true, destination=DemEventParameter  # Reference to the DemEventParameter which shall be raised due to inability of Peripheral PLL K2/K3 dividers and power mode to be updated within the specified time.
      reference MCU_E_SYSTEM_PLL_LOCK_LOSS [0..1]: multiplicity set at pre-compile, origin=INFINEON_AURIX2G, set at pre-compile, requires-symbolic-name-value=true, destination=DemEventParameter  # Reference to the DemEventParameter which shall be raised on system PLL lock loss
      reference MCU_E_PERIPHERAL_PLL_LOCK_LOSS [0..1]: multiplicity set at pre-compile, origin=INFINEON_AURIX2G, set at pre-compile, requires-symbolic-name-value=true, destination=DemEventParameter  # Reference to the DemEventParameter which shall be raised on peripheral PLL lock loss
      reference MCU_E_GTM_CLC_ENABLE_ERR [0..1]: multiplicity set at pre-compile, origin=INFINEON_AURIX2G, set at pre-compile, requires-symbolic-name-value=true, destination=DemEventParameter  # Reference to the DemEventParameter which shall be raised on GTM - CLC enable error
      reference MCU_E_GTM_CLC_DISABLE_ERR [0..1]: multiplicity set at pre-compile, origin=INFINEON_AURIX2G, set at pre-compile, requires-symbolic-name-value=true, destination=DemEventParameter  # Reference to the DemEventParameter which shall be raised on GTM - CLC disable error
      reference MCU_E_CONVCTRL_CLC_ENABLE_ERR [0..1]: multiplicity set at pre-compile, origin=INFINEON_AURIX2G, set at pre-compile, requires-symbolic-name-value=true, destination=DemEventParameter  # Reference to the DemEventParameter which shall be raised on CONVCTRL - CLC enable error
      reference MCU_E_CONVCTRL_CLC_DISABLE_ERR [0..1]: multiplicity set at pre-compile, origin=INFINEON_AURIX2G, set at pre-compile, requires-symbolic-name-value=true, destination=DemEventParameter  # Reference to the DemEventParameter which shall be raised on CONVCTRL - CLC disable error
      reference MCU_E_CCUCON_UPDATE_ERR [0..1]: multiplicity set at pre-compile, origin=INFINEON_AURIX2G, set at pre-compile, requires-symbolic-name-value=true, destination=DemEventParameter  # Reference to the DemEventParameter which shall be raised on CCUCON register update inability error
      reference MCU_E_CCU6_CLC_ENABLE_ERR [0..1]: multiplicity set at pre-compile, origin=INFINEON_AURIX2G, set at pre-compile, requires-symbolic-name-value=true, destination=DemEventParameter  # Reference to the DemEventParameter which shall be raised on CCU6 kernel - CLC enable error
      reference MCU_E_CCU6_CLC_DISABLE_ERR [0..1]: multiplicity set at pre-compile, origin=INFINEON_AURIX2G, set at pre-compile, requires-symbolic-name-value=true, destination=DemEventParameter  # Reference to the DemEventParameter which shall be raised on CCU6 kernel - CLC disable error
      reference MCU_E_GPT12_CLC_ENABLE_ERR [0..1]: multiplicity set at pre-compile, origin=INFINEON_AURIX2G, set at pre-compile, requires-symbolic-name-value=true, destination=DemEventParameter  # Reference to the DemEventParameter which shall be raised on GPT12 module - CLC enable error
      reference MCU_E_GPT12_CLC_DISABLE_ERR [0..1]: multiplicity set at pre-compile, origin=INFINEON_AURIX2G, set at pre-compile, requires-symbolic-name-value=true, destination=DemEventParameter  # Reference to the DemEventParameter which shall be raised on GPT12 module - CLC disable error
      reference MCU_E_PMSWCR_UPDATE_ERR [0..1]: multiplicity set at pre-compile, origin=INFINEON_AURIX2G, set at pre-compile, requires-symbolic-name-value=true, destination=DemEventParameter  # Reference to the DemEventParameter which shall be raised on PMSWCR register, when this register is BUSY and cannot be written before the specified time elapses.
    container CommonPublishedInformation  # Common container, aggregated by all modules. It contains published information about vendor and versions.
      integer ArMajorVersion: 0..255, origin=INFINEON_AURIX2G, set at published-information, default-value=4  # Major version number of AUTOSAR specification on which the appropriate implementation is based on.
      integer ArMinorVersion: 0..255, origin=INFINEON_AURIX2G, set at published-information, default-value=4  # Minor version number of AUTOSAR specification on which the appropriate implementation is based on.
      integer ArPatchVersion: 0..255, origin=INFINEON_AURIX2G, set at published-information, default-value=0  # Patch level version number of AUTOSAR specification on which the appropriate implementation is based on.
      integer SwMajorVersion: 0..255, origin=INFINEON_AURIX2G, set at published-information, default-value=20  # Major version number of the vendor specific implementation of the module. The numbering is vendor specific.
      integer SwMinorVersion: 0..255, origin=INFINEON_AURIX2G, set at published-information, default-value=25  # Minor version number of the vendor specific implementation of the module. The numbering is vendor specific.
      integer SwPatchVersion: 0..255, origin=INFINEON_AURIX2G, set at published-information, default-value=0  # Patch level version number of the vendor specific implementation of the module. The numbering is vendor specific.
      integer ModuleId: 0..65535, origin=INFINEON_AURIX2G, set at published-information, default-value=101  # Module ID of this module from Module List
      integer VendorId: 0..65535, origin=INFINEON_AURIX2G, set at published-information, default-value=17  # Vendor ID of the dedicated implementation of this module according to the AUTOSAR vendor list
      string Release: origin=INFINEON_AURIX2G, set at published-information, default-value=_TRICORE_TC399  # AURIX2G derivative used for the implementation
    container McuPublishedInformation  # Container holding all MCU specific published information parameters
      container McuResetReasonConf [21..21]  # This container contains the configuration for the different type of reset reason that can be retrieved from Mcu_GetResetReason Api.
        integer McuResetReason: 0..255, scope=ECU, set at published-information, symbolic-name-value=true, default-value=0  # The parameter represents the different type of reset that the controller supports. This parameter is referenced by the parameter EcuMResetReason in the ECU State manager module.
