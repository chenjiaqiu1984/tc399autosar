AUTOSAR XML (schema 00046)
package /AURIX2G/EcucDefs
  module definition Spi [0..1]: post-build-variant-support=true, refined-module-def=Spi, variants post-build  # Configuration of the Spi (Serial Peripheral Interface) module.
    container SpiDemEventParameterRefs [0..1]: multiplicity set at pre-compile  # Container for the references to DemEventParameter elements which shall be invoked using the API Mcal_Wrapper_Dem_SetEventStatus in case the corresponding error occurs. The EventId is taken from the referenced DemEventParameter's DemEventId symbolic value. The standardized errors are provided in this container and can be extended by vendor-specific error references.
      reference SPI_E_HARDWARE_ERROR [0..1]: multiplicity set at pre-compile, set at pre-compile, requires-symbolic-name-value=true, destination=DemEventParameter  # Reference to configured DEM event to report "Hardware failure". If the reference is not configured the error shall not be reported.
    container SpiDriver  # This container contains the configuration parameters and sub containers of the AUTOSAR Spi module.
      integer SpiMaxChannel [0..1]: 0..255, multiplicity set at post-build, post-build-variant-multiplicity=true, set at post-build, default-value=1  # This parameter contains the number of Channels configured. It will be gathered by tools during the configuration stage. Note: this parameter should be Removed and Added after the SpiChannel configuration is completed(Since, tool does not auto-refresh the default value)
      integer SpiMaxJob [0..1]: 1..5000, multiplicity set at post-build, post-build-variant-multiplicity=true, set at post-build, default-value=1  # Total number of Jobs configured. It will be gathered by tools during the configuration stage. Note: this parameter should be Removed and Added after the SpiJob configuration is completed(Since, tool does not auto-refresh the default value)
      integer SpiMaxSequence [0..1]: 0..255, multiplicity set at post-build, post-build-variant-multiplicity=true, set at post-build, default-value=1  # Total number of Sequences configured. It will be gathered by tools during the configuration stage. Note: this parameter should be Removed and Added after the SpiSequence configuration is completed(Since, tool does not auto-refresh the default value)
      reference SpiSystemClock: origin=INFINEON_AURIX2G, post-build-variant-value=true, set at post-build, destination=McuClockReferencePointConfig  # This parameter is read from the MCU System clock configured - refer to McuQspiFrequency and McuQspiClockSourceSelection in McuClocksettingsConfig container
      container SpiChannel [1..255]: multiplicity set at pre-compile  # All data needed to configure one SPI-channel
        integer SpiChannelId: 0..255, set at pre-compile, symbolic-name-value=true, default-value=0  # SPI Channel ID, used as parameter in SPI API functions. It is published in the Spi_Cfg.h file
        enumeration SpiChannelType: {EB, IB}, set at pre-compile, default-value=EB  # Buffer usage with EB/IB channel.
        integer SpiDataWidth: 2..32, set at pre-compile, default-value=8  # This parameter is the width of a transmitted data unit.
        integer SpiDefaultData [0..1]: 0..4294967295, multiplicity set at post-build, post-build-variant-multiplicity=true, post-build-variant-value=true, set at post-build, default-value=0  # The default data to be transmitted when (for internal buffer or external buffer) the pointer passed to Spi_WriteIB (for internal buffer) or to Spi_SetupEB (for external buffer) is NULL.
        integer SpiEbMaxLength: 1..65535, post-build-variant-value=true, set at post-build, default-value=8190  # This parameter contains the maximum size (number of data elements) of data buffers in case of EB Channels and only.
        integer SpiIbNBuffers: 1..65535, set at pre-compile, default-value=10  # This parameter contains the maximum number of data buffers in case of IB Channels and only.
        enumeration SpiTransferStart: {LSB, MSB}, post-build-variant-value=true, set at post-build, default-value=LSB  # This parameter defines the first starting bit for transmission.
      container SpiExternalDevice [1..*]: multiplicity set at pre-compile  # The communication settings of an external device. Closely linked to SpiJob.
        float SpiBaudrate: 9600.0..3.3E7, post-build-variant-value=true, set at post-build, default-value=640000.0  # This parameter is the communication baudrate - This parameter allows
        string SpiCsIdentifier: set at pre-compile, symbolic-name-value=true, default-value=CHANNEL0  # This parameter is the symbolic name to identify the Chip Select (CS) allocated to this Job.
        enumeration SpiCsPolarity: {HIGH, LOW}, post-build-variant-value=true, set at post-build, default-value=LOW  # This parameter defines the active polarity of Chip Select.
        enumeration SpiCsSelection [0..1]: {CS_VIA_GPIO, CS_VIA_PERIPHERAL_ENGINE}, multiplicity set at post-build, post-build-variant-multiplicity=true, post-build-variant-value=true, set at post-build, default-value=CS_VIA_PERIPHERAL_ENGINE  # When the Chip select handling is enabled (see SpiEnableCs), then this parameter specifies if the chip select is handled automatically by Peripheral HW engine or via general purpose IO by Spi driver.
        enumeration SpiDataShiftEdge: {LEADING, TRAILING}, post-build-variant-value=true, set at post-build, default-value=LEADING  # This parameter defines the SPI data shift edge.
        boolean SpiEnableCs: post-build-variant-value=true, set at post-build, default-value=false  # This parameter enables or not the Chip Select handling functions. If this parameter is enabled then parameter SpiCsSelection further details the type of chip selection.
        enumeration SpiHwUnit: {QSPI0, QSPI1, QSPI2, QSPI3, QSPI4, QSPI5}, set at pre-compile, default-value=QSPI0  # This parameter is the symbolic name to identify the HW SPI Hardware
        boolean SpiAutoCalcBaudParams: origin=INFINEON_AURIX2G, post-build-variant-value=true, set at post-build, default-value=true  # This parameter enables or not the automatic calculation of qspi baudrate parameters. If this value is ON, then the Hw parameters TQ,Q,A,B,C are calculated based on SpiBaudrate
        boolean SpiAutoCalcDelayParams: origin=INFINEON_AURIX2G, post-build-variant-value=true, set at post-build, default-value=true  # This parameter enables or not the automatic calculation of qspi Delay parameters.
        float SpiIdleTime: 4.0E-8..0.098304, origin=INFINEON_AURIX2G, post-build-variant-value=true, set at post-build, default-value=1.0E-7  # IDLEA / IDLEB Time .
        float SpiTrailingTime: 4.0E-8..0.098304, origin=INFINEON_AURIX2G, post-build-variant-value=true, set at post-build, default-value=1.0E-7  # Trailing Time - the time between the last edge of the clock and the CS De-assertion. It is also the time between the data elements in the SpiChannel
        enumeration SpiShiftClockIdleLevel: {HIGH, LOW}, post-build-variant-value=true, set at post-build, default-value=LOW  # This parameter defines the SPI shift clock idle level.
        float SpiTimeClk2Cs: 4.0E-8..1.0E-4, post-build-variant-value=true, set at post-build, default-value=1.0E-7  # Timing between clock and chip select (in seconds) or the Lead time - This parameter allows to use a range of values from 0 up to 0.0001 seconds.
        enumeration SpiParitySupport: {UNUSED, EVEN, ODD}, origin=INFINEON_AURIX2G, post-build-variant-value=true, set at post-build, default-value=UNUSED  # When the SpiParitySupport is selected SPI data Transmission/Reception incorporates an additional bit making the parity EVEN or ODD based on selection
        reference SpiDeviceEcucPartitionRef [0..*]: scope=ECU, multiplicity set at pre-compile, post-build-variant-multiplicity=true, post-build-variant-value=true, set at pre-compile, destination=EcucPartition  # Maps an SPI external device to zero or multiple ECUC partitions to limit the access to this external device. The ECUC partitions referenced are a subset of the ECUC partitions where the SPI driver is mapped to. Tags: atp.Status=draft
        container SpiCsGpio [0..1]: multiplicity set at pre-compile  # Container for the selection of Chipselect
          integer SpiCsGpioPortSelection: 0..41, origin=INFINEON_AURIX2G, post-build-variant-value=true, set at post-build, default-value=1  # Gpio port no used for Chipselect
          integer SpiCsGpioPinSelection: 0..15, origin=INFINEON_AURIX2G, post-build-variant-value=true, set at post-build, default-value=1  # Gpio port pin no used for Chipselect
        container SpiBaudrateParams [0..1]: multiplicity set at pre-compile  # This container has the parameters which are responsible for the Baudrate
          integer SpiBaudParamTQ: 0..255, origin=INFINEON_AURIX2G, post-build-variant-value=true, set at post-build, default-value=2  # This parameter defines Global time quantum value, Qspi TQ Hw parameter. If SpiAutoCalcBaudParams value is ON, then the HW baudrate parameters TQ,Q,A,B,C are calculated based on SpiBaudrate
          integer SpiBaudParamQ: 0..63, origin=INFINEON_AURIX2G, post-build-variant-value=true, set at post-build, default-value=10  # This parameter defines Qspi Q Hw parameter
          integer SpiBaudParamA: 0..3, origin=INFINEON_AURIX2G, post-build-variant-value=true, set at post-build, default-value=1  # This parameter defines one of the bit segment A in a period, Qspi A Hw parameter
          integer SpiBaudParamB: 0..3, origin=INFINEON_AURIX2G, post-build-variant-value=true, set at post-build, default-value=0  # Qspi B Hw parameter
          integer SpiBaudParamC: 0..3, origin=INFINEON_AURIX2G, post-build-variant-value=true, set at post-build, default-value=1  # Qspi C Hw parameter
        container SpiDelayParams [0..1]: multiplicity set at pre-compile  # THis container has the parameters which are responsible for the delay configuration during transmission
          integer SpiDelayParamTrailPre: 0..7, origin=INFINEON_AURIX2G, post-build-variant-value=true, set at post-build, default-value=0  # Qspi Trail delay prescalar Hw parameter
          integer SpiDelayParamTrailLength: 0..7, origin=INFINEON_AURIX2G, post-build-variant-value=true, set at post-build, default-value=0  # Qspi Trail Hw parameter
          integer SpiDelayParamIdlePre: 0..7, origin=INFINEON_AURIX2G, post-build-variant-value=true, set at post-build, default-value=0  # Qspi Idle delay prescalar Hw parameter
          integer SpiDelayParamIdleLength: 0..7, origin=INFINEON_AURIX2G, post-build-variant-value=true, set at post-build, default-value=0  # Qspi IDLE delay Hw parameter
          integer SpiDelayParamLeadPre: 0..7, origin=INFINEON_AURIX2G, post-build-variant-value=true, set at post-build, default-value=0  # Qspi Lead delay prescalar Hw parameter
          integer SpiDelayParamLeadLength: 0..7, origin=INFINEON_AURIX2G, post-build-variant-value=true, set at post-build, default-value=0  # Qspi LEAD delay Hw parameter
      container SpiJob [1..65535]: multiplicity set at pre-compile  # All data needed to configure one SPI-Job, amongst others the connection between the internal SPI unit and the special settings for an external device is done.
        function name SpiJobEndNotification [0..1]: multiplicity set at post-build, post-build-variant-multiplicity=true, post-build-variant-value=true, set at post-build, default-value=NULL_PTR  # This parameter is a reference to a notification function.
        integer SpiJobId: 0..5000, set at pre-compile, symbolic-name-value=true, default-value=0  # SPI Job ID, used as parameter in SPI API functions.
        boolean SpiFrameBasedCS: origin=INFINEON_AURIX2G, post-build-variant-value=true, set at post-build, default-value=false  # enable frame based chip select
        integer SpiJobPriority: 0..3, post-build-variant-value=true, set at post-build, default-value=0  # Priority set accordingly to SPI093: 0, lowest, 3, highest priority
        reference SpiDeviceAssignment: set at pre-compile, destination=SpiExternalDevice  # Reference to the external device used by this job
        container SpiChannelList [1..*]: multiplicity set at pre-compile  # References to SPI channels and their order within the Job.
          integer SpiChannelIndex: 0..254, post-build-variant-value=true, set at post-build, default-value=0  # This parameter specifies the order of Channels within the Job.
          reference SpiChannelAssignment: set at pre-compile, destination=SpiChannel  # A job reference to a SPI channel.
      container SpiSequence [1..255]: multiplicity set at pre-compile  # All data needed to configure one SPI-sequence
        boolean SpiInterruptibleSequence: post-build-variant-value=true, set at post-build, default-value=false  # This parameter allows or not this Sequence to be suspended by another one.
        function name SpiSeqEndNotification [0..1]: multiplicity set at post-build, post-build-variant-multiplicity=true, post-build-variant-value=true, set at post-build, default-value=NULL_PTR  # This parameter is a reference to a notification function.
        integer SpiSequenceId: 0..255, scope=ECU, set at pre-compile, symbolic-name-value=true, default-value=0  # SPI Sequence ID, used as parameter in SPI API functions.
        reference SpiJobAssignment [1..*]: multiplicity set at post-build, set at post-build, destination=SpiJob  # A sequence references several jobs, which are executed during a communication sequence
    container SpiGeneral  # General configuration settings for SPI-Handler
      boolean SpiCancelApi: set at pre-compile, default-value=false  # Switches the Spi_Cancel function ON or OFF.
      integer SpiChannelBuffersAllowed: 0..2, set at pre-compile, default-value=1  # Selects the SPI Handler/Driver Channel Buffers usage 0 - IB (Internal Buffer), 1 - EB (External Buffer), 2 - Both
      enumeration SpiInitDeInitApiMode: {SPI_MCAL_SUPERVISOR, SPI_MCAL_USER1}, origin=INFINEON_AURIX2G, set at pre-compile, default-value=SPI_MCAL_SUPERVISOR  # This parameter selects the operating modes for MCU initialization, de-initialization APIs
      boolean SpiInitCheckApi: origin=INFINEON_AURIX2G, set at pre-compile, default-value=false  # This parameter enables init checks for APIs
      boolean SpiMultiCoreErrorDetect: origin=INFINEON_AURIX2G, set at pre-compile, default-value=false  # This parameter disables multicore configuration checks
      enumeration SpiRuntimeApiMode: {SPI_MCAL_SUPERVISOR, SPI_MCAL_USER1}, origin=INFINEON_AURIX2G, set at pre-compile, default-value=SPI_MCAL_SUPERVISOR  # This parameter selects the operating modes for SPI runtime APIs
      boolean SpiDevErrorDetect: set at pre-compile, default-value=false  # Switches the development error detection and notification on or off.
      boolean SpiSafetyEnable: origin=INFINEON_AURIX2G, set at pre-compile, default-value=true  # Switches the Default safety check for QSPI ON or OFF.
      boolean SpiRunTimeErrorDetect: origin=INFINEON_AURIX2G, set at pre-compile, default-value=true  # This parameter enables or disables the Runtime errors reporting
      boolean SpiHwStatusApi: set at pre-compile, default-value=false  # Switches the Spi_GetHWUnitStatus function ON or OFF.
      boolean SpiEnableLoopBackApi: origin=INFINEON_AURIX2G, set at pre-compile, default-value=false  # Switches the Spi_ControlLoopBack function ON or OFF.
      boolean SpiInterruptibleSeqAllowed: set at pre-compile, default-value=false  # Switches the Interruptible Sequences handling functionality ON or OFF.
      integer SpiLevelDelivered: 0..2, set at pre-compile, default-value=1  # Selects the SPI Handler/Driver level of scalable functionality that is available and delivered. SpiLevelDelivered is 0(LEVEL0): The driver handles only simple synchronous transmission on all available SPI busses(QSPIx) SpiLevelDelivered is 1(LEVEL1): The driver handles only simple asynchronous transmission on all available SPI busses(QSPIx) SpiLevelDelivered is 2(LEVEL2): The LEVEL2 which is an enhanced behavior of the driver will handle both synchronous and asynchronous transmissions.
      float SpiMainFunctionPeriod [0..1]: 1.0E-7..1.0, multiplicity set at pre-compile, set at pre-compile, default-value=0.01  # This parameter defines the cycle time of the function Spi_MainFunction_Handling in seconds. The parameter is not used by the driver it self, but it is used by upper layer.
      boolean SpiSupportConcurrentSyncTransmit: set at pre-compile, default-value=false  # Specifies whether concurrent Spi_SyncTransmit() calls for different sequences shall be configurable.
      integer SpiSyncTransmitTimeoutDuration: 100..4294967295, origin=INFINEON_AURIX2G, set at pre-compile, default-value=65535  # The parameter is used as timeout loop counter while waiting for data transmission/reception of 1 data element.
      boolean SpiVersionInfoApi: set at pre-compile, default-value=false  # Switches the Spi_GetVersionInfo function ON or OFF.
      reference SpiEcucPartitionRef [0..*]: scope=ECU, multiplicity set at pre-compile, post-build-variant-multiplicity=true, post-build-variant-value=true, set at pre-compile, destination=EcucPartition  # Maps the SPI driver to zero or multiple ECUC partitions to make the driver API available in the according partition. Tags: atp.Status=draft
      reference SpiKernelEcucPartitionRef [0..1]: scope=ECU, multiplicity set at pre-compile, post-build-variant-multiplicity=true, post-build-variant-value=true, set at pre-compile, destination=EcucPartition  # Maps the SPI kernel to zero or one ECUC partitions to assign the driver kernel to a certain core. The ECUC partition referenced is a subset of the ECUC partitions where the SPI driver is mapped to. Tags: atp.Status=draft
    container SpiHwConfiguration  # This container has the QSPI specific configuration which is PC type
      container SpiHwConfigurationQspi [1..6]: multiplicity set at pre-compile  # Container for the SpiHwConfigurationQspix
        enumeration SpiHwConfigKernel: {QSPI0, QSPI1, QSPI2, QSPI3, QSPI4, QSPI5}, origin=INFINEON_AURIX2G, set at pre-compile, symbolic-name-value=true, default-value=QSPI0  # This parameter is the symbolic name to identify the Kernel ID configuration
        integer SpiJobQueueLengthQspix: 0..65535, origin=INFINEON_AURIX2G, set at pre-compile, default-value=2  # The parameter is used to specify the Job Queue size. The size should be chosen properly so as to accommodate the runtime Sequence transmission requests. Note: in SpiLevelDelivered = 2, if the HW is Synchronous, configuring this parameter should be ignored and default value could be kept.
        boolean SpiSleepEnableQspix: origin=INFINEON_AURIX2G, post-build-variant-value=true, set at post-build, default-value=false  # To control QSPIx sleep mode
        enumeration SpiHWPinMRSTQspix: {MRST0A_PORT20_PIN12, MRST0B_PORT22_PIN9, MRST0C_PORT22_PIN6, MRST1A_PORT10_PIN1, MRST1B_PORT11_PIN3, MRST2A_PORT15_PIN4, MRST2B_PORT15_PIN7, MRST2CN_PORT21_PIN2, MRST2CP_PORT21_PIN3, MRST2D_PORT34_PIN4, MRST2E_PORT15_PIN2, MRST2FN_PORT14_PIN9, MRST2FP_PORT14_PIN10, MRST3A_PORT02_PIN5, MRST3B_PORT10_PIN7, MRST3C_PORT01_PIN5, MRST4A_PORT33_PIN13, MRST4B_PORT22_PIN1, MRST4CN_PORT21_PIN2, MRST4CP_PORT21_PIN3, MRST4DN_PORT21_PIN0, MRST4DP_PORT21_PIN1, MRST5B_PORT14_PIN5, MRST5A_PORT15_PIN10}, origin=INFINEON_AURIX2G, post-build-variant-value=true, set at post-build, default-value=MRST0A_PORT20_PIN12  # Port Pin selection for Master_Receive_Slave_Transmit
        boolean SpiExternalDemux: origin=INFINEON_AURIX2G, post-build-variant-value=true, set at post-build, default-value=false  # This parameter enables/disables the external demultiplexer feature of QSPI HW
        integer SpiSLSO0StrobeDelay: 2..31, origin=INFINEON_AURIX2G, post-build-variant-value=true, set at post-build, default-value=2  # The parameter is used to specify the Strobe delay to be configured for SLSO0 in External Demultiplexer mode
        container SpiHwDmaConfigurationQspi [0..1]: multiplicity set at pre-compile  # Spi DMA Configuration For QSPI node
          reference SpiHwDmaChannelReceptionRef: origin=INFINEON_AURIX2G, set at pre-compile, destination=DmaChannelConfig  # This parameter refer DMA channel configuration in MCU. Used for SPI reception.
          reference SpiHwDmaChannelTransmissionRef: origin=INFINEON_AURIX2G, set at pre-compile, destination=DmaChannelConfig  # This parameter refer DMA channel configuration in MCU. Used for SPI transmission.
    container SpiPublishedInformation  # Container holding all SPI specific published information parameters
      integer SpiMaxHwUnit: 0..6, set at published-information, default-value=6  # Number of different SPI hardware microcontroller peripherals (units/busses) available and handled by this SPI Handler/Driver module.
    container CommonPublishedInformation  # Common container, aggregated by all modules. It contains published information about vendor and versions.
      integer ArMajorVersion: 0..255, origin=INFINEON_AURIX2G, post-build-variant-value=true, set at published-information, default-value=4  # Major version number of AUTOSAR specification on which the appropriate implementation is based on.
      integer ArMinorVersion: 0..255, origin=INFINEON_AURIX2G, post-build-variant-value=true, set at published-information, default-value=4  # Minor version number of AUTOSAR specification on which the appropriate implementation is based on.
      integer ArPatchVersion: 0..255, origin=INFINEON_AURIX2G, post-build-variant-value=true, set at published-information, default-value=0  # Patch level version number of AUTOSAR specification on which the appropriate implementation is based on.
      integer SwMajorVersion: 0..255, origin=INFINEON_AURIX2G, post-build-variant-value=true, set at published-information, default-value=20  # Major version number of the vendor specific implementation of the module. The numbering is vendor specific.
      integer SwMinorVersion: 0..255, origin=INFINEON_AURIX2G, post-build-variant-value=true, set at published-information, default-value=25  # Minor version number of the vendor specific implementation of the module. The numbering is vendor specific.
      integer SwPatchVersion: 0..255, origin=INFINEON_AURIX2G, post-build-variant-value=true, set at published-information, default-value=0  # Patch level version number of the vendor specific implementation of the module. The numbering is vendor specific.
      integer ModuleId: 0..65535, origin=INFINEON_AURIX2G, post-build-variant-value=true, set at published-information, default-value=83  # Module ID of this module from Module List
      integer VendorId: 0..65535, origin=INFINEON_AURIX2G, post-build-variant-value=true, set at published-information, default-value=17  # Vendor ID of the dedicated implementation of this module according to the AUTOSAR vendor list
      string Release: origin=INFINEON_AURIX2G, set at published-information, default-value=_TRICORE_TC399  # Aurix2G derivative used for the implementation
