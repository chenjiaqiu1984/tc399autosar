AUTOSAR XML (schema 00046)
package /AURIX2G/EcucDefs
  module definition Dsadc [0..1]: post-build-variant-support=true, variants post-build  # Configuration of the Dsadc (Delta Sigma Analog Digital Conversion) module.
    container DsadcGeneral  # This Container contains all the general configuration parameters for the DSADC driver
      boolean DsadcDevErrorDetect: origin=INFINEON_AURIX2G, set at pre-compile, default-value=false  # This Parameter Enables/Disables the Development Error Detection and reporting in the Dsadc Driver
      boolean DsadcSafetyEnable: origin=INFINEON_AURIX2G, set at pre-compile, default-value=true  # ThisParameter determines whether to Enable/Disable the safety check and reporting.
      boolean DsadcDeInitApi: origin=INFINEON_AURIX2G, set at pre-compile, default-value=false  # This Parameter adds or removes the service Dsadc_DeInit() API from the code.
      boolean DsadcInitCheckApi: origin=INFINEON_AURIX2G, set at pre-compile, default-value=false  # This Parameter adds or removes the service Dsadc_InitCheck() API from the code.
      boolean DsadcVersionInfoApi: origin=INFINEON_AURIX2G, set at pre-compile, default-value=false  # This Parameter adds or removes the service Dsadc_GetVersionInfo() API from the code.
      enumeration DsadcInitDeInitApiMode: {DSADC_MCAL_SUPERVISOR, DSADC_MCAL_USER1}, origin=INFINEON_AURIX2G, set at pre-compile, default-value=DSADC_MCAL_SUPERVISOR  # This parameter defines the privilege mode in which the Initialization and De-initialization APIs would operate.
      enumeration DsadcRuntimeApiMode: {DSADC_MCAL_SUPERVISOR, DSADC_MCAL_USER1}, origin=INFINEON_AURIX2G, set at pre-compile, default-value=DSADC_MCAL_SUPERVISOR  # This Parameter defines the privilege mode in which the runtime APIs would operate.
      boolean DsadcRestartIntegratorApi: origin=INFINEON_AURIX2G, set at pre-compile, default-value=false  # This Parameter adds or removes the service Dsadc_RestartIntegrator() API from the code. Considering the STM frequency of 100MHz and carrier period of 9.7656kHz the delay calculation is given as an example below: Fcarrier = 9.7656kHz Tcperiod = 1/9.7656kHz = ?102.4002621446711 microseconds Delay = ?Tcperiod/8 = 12.800 micro seconds STM frequency = 100 MHz Tstmperiod = 1/100MHz = 10ns = 0.01Microseconds Ticks = Delay/TstmPeriod = 1280 ticks. Note: Carrier signal is also restarted along wih the integartor.
    container CommonPublishedInformation  # This container contains the published information of the DSADC driver.
      integer ArMajorVersion: 0..255, origin=INFINEON_AURIX2G, set at published-information, default-value=4  # Major version number of AUTOSAR specification on which the appropriate implementation is based on.
      integer ArMinorVersion: 0..255, origin=INFINEON_AURIX2G, set at published-information, default-value=4  # Minor version number of AUTOSAR specification on which the appropriate implementation is based on.
      integer ArPatchVersion: 0..255, origin=INFINEON_AURIX2G, set at published-information, default-value=0  # Patch version number of AUTOSAR specification on which the appropriate implementation is based on.
      integer SwMajorVersion: 0..255, origin=INFINEON_AURIX2G, set at published-information, default-value=20  # Major version number of the vendor specific implementation of the module. The numbering is vendor specific.
      integer SwMinorVersion: 0..255, origin=INFINEON_AURIX2G, set at published-information, default-value=25  # Minor version number of the vendor specific implementation of the module. The numbering is vendor specific.
      integer SwPatchVersion: 0..255, origin=INFINEON_AURIX2G, set at published-information, default-value=0  # Patch level version number of the vendor specific implementation of the module. The numbering is vendor specific.
      integer ModuleId: 0..65535, origin=INFINEON_AURIX2G, set at published-information, default-value=255  # Module ID of this module from Module List
      integer VendorId: 0..65535, origin=INFINEON_AURIX2G, set at published-information, default-value=17  # Vendor ID of the dedicated implementation of this module according to the AUTOSAR vendor list
      string Release: origin=INFINEON_AURIX2G, set at published-information, default-value=_TRICORE_TC399  # Aurix2G derivative used for the implementation
    container DsadcDemEventParameterRefs [0..1]: multiplicity set at pre-compile  # Container list down the production errors supported by the DSADC driver.
      reference DsadcClcFailureNotification [0..1]: multiplicity set at pre-compile, origin=INFINEON_AURIX2G, set at pre-compile, requires-symbolic-name-value=true, destination=DemEventParameter  # Parameter defines whether CLC failure Production Error notification is enabled or not..
      reference DsadcFifoFailureNotification [0..1]: multiplicity set at pre-compile, origin=INFINEON_AURIX2G, set at pre-compile, requires-symbolic-name-value=true, destination=DemEventParameter  # Parameter defines whether FIFO failure Production Error notification is enabled or not..
    container DsadcConfigSet  # This is the base container that contains Dsadc module related parameters
      container DsadcGlobalConfiguration  # This container contains the parameters to configure DSADC IP global configuration.
        enumeration DsadcDitheringTrimValue: {DSADC_DITHERING_MIN_50_MILVLT, DSADC_DITHERING_LOW_100_MILVLT, DSADC_DITHERING_MED_200_MILVLT, DSADC_DITHERING_HIGH_400_MILVLT}, origin=INFINEON_AURIX2G, post-build-variant-value=true, set at post-build, default-value=DSADC_DITHERING_MIN_50_MILVLT  # Defines trimming value for internal dithering function. This trimming value is used for all the modulators of DSADC
        enumeration DsadcSleepMode: {SLEEP_ENABLE, SLEEP_DISABLE}, origin=INFINEON_AURIX2G, post-build-variant-value=true, set at post-build, default-value=SLEEP_ENABLE  # Parameter defines EDSADC reaction to the Sleep mode requests
        enumeration DsadcSupplyVoltageLevel: {VOLTAGESUPPLY_AUTO, VOLTAGESUPPLY_5V, VOLTAGESUPPLY_3_3V}, origin=INFINEON_AURIX2G, post-build-variant-value=true, set at post-build, default-value=VOLTAGESUPPLY_AUTO  # Parameter defines the supply voltage level to be used for DSADC internal operations
        enumeration DsadcSyncClockGen: {SYNCHRONIZED_MODE, UNSYNCHRONIZED_MODE}, origin=INFINEON_AURIX2G, post-build-variant-value=true, set at post-build, default-value=UNSYNCHRONIZED_MODE  # Parameter defines the influence of Analog Phase synchronizer on the clock generated
      container DsadcCarrierGeneratorConfiguration  # This container contains the Carrier Generation related Parameters.
        enumeration DsadcPwmGenerationMode: {DSADC_NORMAL_MODE, DSADC_BIT_REVERSE_MODE}, origin=INFINEON_AURIX2G, post-build-variant-value=true, set at post-build, default-value=DSADC_NORMAL_MODE  # This parameter defines the mode in which the Carrier Generator signal is generated. In case of Bit Reverse generation mode, it increases the frequency spectrum to yield a smoother induced sine signal. This is done by distributing the 0 and 1 bits over the 32 cycles of a PWM period.
        enumeration DsadcCarrierFrequencyClockDiv: {DSADC_CG_CLOCKDIVIDER_DIV2, DSADC_CG_CLOCKDIVIDER_DIV4, DSADC_CG_CLOCKDIVIDER_DIV6, DSADC_CG_CLOCKDIVIDER_DIV8, DSADC_CG_CLOCKDIVIDER_DIV10, DSADC_CG_CLOCKDIVIDER_DIV12, DSADC_CG_CLOCKDIVIDER_DIV14, DSADC_CG_CLOCKDIVIDER_DIV16, DSADC_CG_CLOCKDIVIDER_DIV18, DSADC_CG_CLOCKDIVIDER_DIV20, DSADC_CG_CLOCKDIVIDER_DIV22, DSADC_CG_CLOCKDIVIDER_DIV24, DSADC_CG_CLOCKDIVIDER_DIV26, DSADC_CG_CLOCKDIVIDER_DIV28, DSADC_CG_CLOCKDIVIDER_DIV30, DSADC_CG_CLOCKDIVIDER_DIV32}, origin=INFINEON_AURIX2G, post-build-variant-value=true, set at post-build, default-value=DSADC_CG_CLOCKDIVIDER_DIV2  # This parameter defines the divider factor, which is used to define the frequency of the carrier signal generator, which is derived from the selected internal clock source and divider factor.
        enumeration DsadcCarrierSignalPolarity: {DSADC_CARR_SIG_NORMAL, DSADC_CARR_SIG_INVERTED}, origin=INFINEON_AURIX2G, post-build-variant-value=true, set at post-build, default-value=DSADC_CARR_SIG_NORMAL  # This parameter defines the starting polarity of the carrier signal.
        enumeration DsadcCarrierSignalType: {DSADC_CARR_SIG_STOPPED, DSADC_CARR_SIG_SQUAREWAVE, DSADC_CARR_SIG_TRIANGLE, DSADC_CARR_SIG_SINEWAVE}, origin=INFINEON_AURIX2G, post-build-variant-value=true, set at post-build, default-value=DSADC_CARR_SIG_STOPPED  # This parameter determines the carrier signal type to be generated.
      container DsadcErsEtlConfig [0..8]: multiplicity set at post-build, post-build-variant-multiplicity=true  # This container configures the parameters for ERU input triggering
        enumeration DsadcEruStatusFlagConfig: {DSADC_ETL_FALLING_EDGE, DSADC_ETL_RISING_EDGE}, origin=INFINEON_AURIX2G, post-build-variant-value=true, set at post-build, default-value=DSADC_ETL_FALLING_EDGE  # This parameters defines the condition on which the status flag in ETL block of ERU is set. On the inverse of the edge selected, the status flag is cleared.
        enumeration DsadcEruErsInputPin: {ERS_0_REQ0A_PORTS_P15_4, ERS_1_REQ0B_CCU60_COUT60, ERS_2_REQ0C_PORTS_P10_7, ERS_3_REQ0D_MSC0_FCLP, ERS_4_REQ0E_STM5_STMIR0, ERS_5_REQ0F_Reserved, ERS_0_REQ1A_PORTS_P14_3, ERS_1_REQ1B_CCU61_COUT60, ERS_2_REQ1C_PORTS_P10_8, ERS_3_REQ1D_STM0_STMIR0, ERS_4_REQ1E_Reserved, ERS_5_REQ1F_Reserved, ERS_0_REQ2A_PORTS_P10_2, ERS_1_REQ2B_PORTS_P02_1, ERS_2_REQ2C_PORTS_P00_4, ERS_3_REQ2D_ERAY0_MT, ERS_4_REQ2E_Reserved, ERS_5_REQ2F_Reserved, ERS_0_REQ3A_PORTS_P10_3, ERS_1_REQ3B_PORTS_P14_1, ERS_2_REQ3C_PORTS_P02_0, ERS_3_REQ3D_STM1_STMIR0, ERS_4_REQ3E_Reserved, ERS_5_REQ3F_Reserved, ERS_0_REQ4A_PORTS_P33_7, ERS_1_REQ4B_GTM_TOM0_12, ERS_2_REQ4C_GPT120_T3OUT, ERS_3_REQ4D_PORTS_P15_5, ERS_4_REQ4E_Reserved, ERS_5_REQ4F_Reserved, ERS_0_REQ5A_PORTS_P15_8, ERS_1_REQ5B_GTM_TOM1_12, ERS_2_REQ5C_GPT120_T6OUT, ERS_3_REQ5D_STM2_STMIR0, ERS_4_REQ5E_Reserved, ERS_5_REQ5F_Reserved, ERS_0_REQ6A_PORTS_P20_0, ERS_1_REQ6B_PORTS_ESR0, ERS_2_REQ6C_Reserved, ERS_3_REQ6D_PORTS_P11_10, ERS_4_REQ6E_STM3_STMIR0, ERS_5_REQ6F_GTM_TOM2_12, ERS_0_REQ7A_PORTS_P20_9, ERS_1_REQ7B_PORTS_ESR1, ERS_2_REQ7C_PORTS_P15_1, ERS_3_REQ7D_ERAY1_MT, ERS_4_REQ7E_STM4_STMIR0, ERS_5_REQ7F_GTM_TOM3_12}, origin=INFINEON_AURIX2G, post-build-variant-value=true, set at post-build, default-value=ERS_0_REQ0A_PORTS_P15_4  # This parameter determines the input pin for the selected ERS
        choice reference DsadcEruErsRef: origin=INFINEON_AURIX2G, post-build-variant-value=true, set at post-build, destination=McuEruChannelInputLineConf  # This parameter is a reference to the ERU container in the MCU. It lists down all the ERU-ERS channels available.
      container DsadcChannelConfiguration [1..14]: multiplicity set at pre-compile  # This container contains the channel configuration (parameters) depending on the hardware capability.
        integer DsadcChannelId: 0..13, origin=INFINEON_AURIX2G, set at pre-compile, symbolic-name-value=true, default-value=0  # Unique number to identify the channel
        enumeration DsadcHwChannelNum: {DSADC_CHANNEL_0, DSADC_CHANNEL_1, DSADC_CHANNEL_2, DSADC_CHANNEL_3, DSADC_CHANNEL_4, DSADC_CHANNEL_5, DSADC_CHANNEL_6, DSADC_CHANNEL_7, DSADC_CHANNEL_8, DSADC_CHANNEL_9, DSADC_CHANNEL_10, DSADC_CHANNEL_11, DSADC_CHANNEL_12, DSADC_CHANNEL_13}, origin=INFINEON_AURIX2G, post-build-variant-value=true, set at post-build, default-value=DSADC_CHANNEL_0  # Hardware EDSADC channel number
        enumeration DsadcAccessMode: {DSADC_SINGLE_READ, DSADC_CIRCULAR_BUFFER, DSADC_STREAM_LINEAR_BUFFER, DSADC_DMA_ACCESS}, origin=INFINEON_AURIX2G, post-build-variant-value=true, set at post-build, default-value=DSADC_SINGLE_READ  # This parameter determines the access mode selection for DSADC Driver. The available access mode is depends on parameter DsdcTriggerMode.If the DsadcTriggerMode is configured as TRIGGER_MODE_NORMAL then DsadcAccessMode can be any inside the Range. If DsadcTriggerMode is Configured as TRIGGER_MODE_WINDOW then DsadcAccessMode can be DSADC_SINGLE_READ or DSADC_STRERAM_LINEAR_BUFFER or DSADC_DMA_ACCESS.
        enumeration DsadcTriggerMode: {DSADC_TRIGGER_MODE_NORMAL, DSADC_TRIGGER_MODE_WINDOW}, origin=INFINEON_AURIX2G, post-build-variant-value=true, set at post-build, default-value=DSADC_TRIGGER_MODE_NORMAL  # This parameter is used to define the trigger mode. possbile conversion modes are DSADC_TRIGGER_MODE_NORMAL and DSADC_TRIGGER_MODE_WINDOW. DSADC_TRIGGER_MODE_NORMAL: Conversion starts after calling Dsadc_StartModulation() API. DSADC_TRIGGER_MODE_WINDOW: The result values are considered after Hardware trigger signal(GTM or ERU) is arrived.
        enumeration DsadcTimestampFeature: {DSADC_TIMESTAMP_ENABLED, DSADC_TIMESTAMP_DISABLED}, origin=INFINEON_AURIX2G, post-build-variant-value=true, set at post-build, default-value=DSADC_TIMESTAMP_DISABLED  # This Parameter is used to define the timestamp Functionality availability for the DSADC Channel. DSADC_TIMESTAMP_ENABLED: Enable the Timestamp functionality. DSADC_TIMESTAMP_DISABLED: Disable the Timestamp Functionality.
        enumeration DsadcGateActiveLevel: {DSADC_GATE_HIGH_LEVEL, DSADC_GATE_LOW_LEVEL}, origin=INFINEON_AURIX2G, post-build-variant-value=true, set at post-build, default-value=DSADC_GATE_HIGH_LEVEL  # This parameter is used to define the active level for the trigger gate signal.
        function name DsadcBufferFullNotification: origin=INFINEON_AURIX2G, post-build-variant-value=true, set at post-build, default-value=NULL_PTR  # Callback function for buffer full event. The availablity of this parameter depends on DsadcAccessMode. If the DsadcAccessMode is configured as ACCESS_MODE_SINGLE OR ACCESS_MODE_CIRCULAR_BUFFER or DSADC_DMA_ACCESS then this parameter is not available.
        function name DsadcNewResultNotification: origin=INFINEON_AURIX2G, post-build-variant-value=true, set at post-build, default-value=NULL_PTR  # Callback function for new result event.
        function name DsadcWindowCloseNotification: origin=INFINEON_AURIX2G, post-build-variant-value=true, set at post-build, default-value=NULL_PTR  # Callback function for window close event, the availability of this parameter depends on DsadcTriggerMode configured as DSADC_TRIGGER_MODE_NORMAL
        container DsadcModulatorConfiguration  # This container contains configuration parameters related to the On-chip modulator, input pin selection and modulator clock configuration.
          integer DsadcAnalogClockSyncDelay: 0..7, origin=INFINEON_AURIX2G, post-build-variant-value=true, set at post-build, default-value=0  # This parameter defines the delay in clock cycles after the sync signal provided from Phase synchronizer.
          enumeration DsadcClockDivider: {DSADC_CLOCKDIVIDER_DIV4, DSADC_CLOCKDIVIDER_DIV6, DSADC_CLOCKDIVIDER_DIV8, DSADC_CLOCKDIVIDER_DIV10, DSADC_CLOCKDIVIDER_DIV12, DSADC_CLOCKDIVIDER_DIV14, DSADC_CLOCKDIVIDER_DIV16, DSADC_CLOCKDIVIDER_DIV18}, origin=INFINEON_AURIX2G, post-build-variant-value=true, set at post-build, default-value=DSADC_CLOCKDIVIDER_DIV4  # This parameter defines the divider factor, which defines the frequency of the modulator clock, which is derived from the peripheral clock
          boolean DsadcDitheringEnable: origin=INFINEON_AURIX2G, post-build-variant-value=true, set at post-build, default-value=false  # This parameter defines the availability of internal dithering functionality for the modulator.
          enumeration DsadcInputGain: {DSADC_INPUT_GAIN_FACTOR_1, DSADC_INPUT_GAIN_FACTOR_2, DSADC_INPUT_GAIN_FACTOR_4}, origin=INFINEON_AURIX2G, post-build-variant-value=true, set at post-build, default-value=DSADC_INPUT_GAIN_FACTOR_1  # This parameter defines multiplication Gain factor for the analog input signal.
          enumeration DsadcInputMuxActionMode: {DSADC_INPUTMUX_PRESET_MODE, DSADC_INPUTMUX_SINGLE_STEP_MODE}, origin=INFINEON_AURIX2G, post-build-variant-value=true, set at post-build, default-value=DSADC_INPUTMUX_PRESET_MODE  # This parameter defines the control mechanism for input multiplexer. It defines the action to be taken for the input multiplexer upon a trigger event for pin selection.
          enumeration DsadcInputMuxControlMode: {DSADC_INMUX_SOFTWARE_CONTROL, DSADC_INMUX_TRIG_EVENT_FALLING_EDGE, DSADC_INMUX_TRIG_EVENT_RISING_EDGE, DSADC_INMUX_TRIG_EVENT_BOTH_EDGES}, origin=INFINEON_AURIX2G, post-build-variant-value=true, set at post-build, default-value=DSADC_INMUX_SOFTWARE_CONTROL  # This parameter defines the condition for a trigger event to control the input multiplexer.
          enumeration DsadcInputPinSelection: {INPUT_PIN_0_AN2_AN3, INPUT_PIN_1_AN12_AN13, INPUT_PIN_0_AN36_AN37, INPUT_PIN_1_AN38_AN39, INPUT_PIN_2_AN44_AN45, INPUT_PIN_3_AN46_AN47, INPUT_PIN_0_AN20_AN21, INPUT_PIN_1_AN24_AN25, INPUT_PIN_0_AN0_AN1, INPUT_PIN_1_AN14_AN15, INPUT_PIN_0_PORT_00_8_PORT_00_7, INPUT_PIN_1_PORT_00_10_PORT_00_9, INPUT_PIN_0_PORT_00_2_PORT_00_1, INPUT_PIN_1_PORT_00_4_PORT_00_3, INPUT_PIN_0_AN52_AN53, INPUT_PIN_1_AN54_AN55, INPUT_PIN_0_AN60_AN61, INPUT_PIN_1_AN62_AN63, INPUT_PIN_0_AN68_AN69, INPUT_PIN_0_AN50_AN51, INPUT_PIN_1_AN70_AN71, INPUT_PIN_0_AN58_AN59, INPUT_PIN_0_AN66_AN67, INPUT_PIN_0_AN70_AN71, INPUT_PIN_0_AN72_AN73}, origin=INFINEON_AURIX2G, post-build-variant-value=true, set at post-build, default-value=INPUT_PIN_0_AN2_AN3  # This parameter defines the initial/permanent setting for the input multiplexer, based on the operating mode selected.
          boolean DsadcIntegratorResetEnable: origin=INFINEON_AURIX2G, post-build-variant-value=true, set at post-build, default-value=false  # This parameter defines the modulator overload handling.
          enumeration DsadcNegativeInputLine: {DSADC_NEG_INPUT_PIN, DSADC_NEG_IN_SUPPLY_VOLT, DSADC_NEG_IN_COMMON_MODE_VOLT, DSADC_NEG_IN_REFERENCE_GROUND}, origin=INFINEON_AURIX2G, post-build-variant-value=true, set at post-build, default-value=DSADC_NEG_INPUT_PIN  # This parameter defines the modulator internal connection of the negative input.
          enumeration DsadcPositiveInputLine: {DSADC_POS_INPUT_PIN, DSADC_POS_IN_SUPPLY_VOLT, DSADC_POS_IN_COMMON_MODE_VOLT, DSADC_POS_IN_REFERENCE_GROUND}, origin=INFINEON_AURIX2G, post-build-variant-value=true, set at post-build, default-value=DSADC_POS_INPUT_PIN  # This parameter defines the modulator internal connection of the positive input.
        container DsadcDemodulatorConfiguration  # This container contains configuration parameters related to the de-modulator, input data stream and trigger selection.
          enumeration DsadcIntegratorTriggerMode: {DSADC_INTR_BYPASSED, DSADC_INTR_FALLING_EDGE, DSADC_INTR_RISING_EDGE, DSADC_INTR_ALWAYS_ACTIVE}, origin=INFINEON_AURIX2G, post-build-variant-value=true, set at post-build, default-value=DSADC_INTR_BYPASSED  # This parameter defines the Integrator trigger mode.
          enumeration DsadcResultDisplayMode: {DSADC_RES_SIGNED_MODE, DSADC_RES_UNSIGNED_MODE}, origin=INFINEON_AURIX2G, post-build-variant-value=true, set at post-build, default-value=DSADC_RES_SIGNED_MODE  # This parameter defines the ranges of the result values i.e. result display modes.
          enumeration DsadcTriggerSelect: {TRIGGER_0_NO_DSADC_TRIG, TRIGGER_0_GTM_DSADC_TRIG0, TRIGGER_1_GTM_DSADC_TRIG1, TRIGGER_6_ERU_PDOUT0, TRIGGER_12_GTM_DSADC_TRIG2, TRIGGER_13_GTM_DSADC_TRIG3, TRIGGER_6_ERU_PDOUT1, TRIGGER_6_ERU_PDOUT2, TRIGGER_6_ERU_PDOUT3, TRIGGER_6_ERU_PDOUT4, TRIGGER_6_ERU_PDOUT5, TRIGGER_6_ERU_PDOUT6, TRIGGER_6_ERU_PDOUT7}, origin=INFINEON_AURIX2G, post-build-variant-value=true, set at post-build, default-value=TRIGGER_0_NO_DSADC_TRIG  # This parameter defines EDSADC channel trigger source.
          container DsadcOguConfig [0..1]: multiplicity set at post-build, post-build-variant-multiplicity=true  # This container configures the parameters for ERU triggering
            boolean DsadcEruErsCh{0..7}PatternFlagEnable: origin=INFINEON_AURIX2G, post-build-variant-value=true, set at post-build, default-value=false  # This parameter determines the ERU ERS channel {0..7} is used for pattern detection for the selected OGU channel
            choice reference DsadcEruOguRef: origin=INFINEON_AURIX2G, post-build-variant-value=true, set at post-build, destination=McuEruChannelOutputUnitConf  # This parameter is a reference to the ERU container in the MCU. It lists down all the ERU-OGU channels available. The OGUs available is dependent on the DsadcHwChannelNum.
          container DsadcTimestampConfiguration [0..1]: multiplicity set at post-build, post-build-variant-multiplicity=true  # This container provides configuration parameters regarding the timestamp counter configuration.
            enumeration DsadcTimestampCounterClockSel: {CLOCKDIVIDER_DIV1, CLOCKDIVIDER_DIV2, CLOCKDIVIDER_DIV4, CLOCKDIVIDER_DIV8}, origin=INFINEON_AURIX2G, post-build-variant-value=true, set at post-build, default-value=CLOCKDIVIDER_DIV1  # This parameter defines the divider factor, which defines the clock used for Timestamp counter.
            boolean DsadcInputMuxSetCopyEnable: origin=INFINEON_AURIX2G, post-build-variant-value=true, set at post-build, default-value=false  # This parameter defines the availability of Analog MUX setting in the timestamp information.
            enumeration DsadcTimestampTriggerMode: {DSADC_TIMESTAMP_WINDOWOPEN, DSADC_TIMESTAMP_WINDOWCLOSE}, origin=INFINEON_AURIX2G, post-build-variant-value=true, set at post-build, default-value=DSADC_TIMESTAMP_WINDOWOPEN  # This parameter is used to define whether the timestamp has to be captured for window open event or window close event.
          container DsadcIntegratorConfiguration [0..1]: multiplicity set at post-build, post-build-variant-multiplicity=true  # This container provides configuration parameter related to the Integrator functional block.
            integer DsadcDiscardCount: 0..63, origin=INFINEON_AURIX2G, post-build-variant-value=true, set at post-build, default-value=0  # This parameter defines the number of result values to be discarded before the start of the integration cycle.
            integer DsadcIntegrationCount: 2..64, origin=INFINEON_AURIX2G, post-build-variant-value=true, set at post-build, default-value=2  # This parameter defines the number of result values to be integrated.
        container DsadcRectificationConfiguration [0..1]: multiplicity set at post-build, post-build-variant-multiplicity=true  # This container provides configuration parameters of the rectifier block, used for resolver support, to determine position of the motor.
          boolean DsadcRectificationEnable: origin=INFINEON_AURIX2G, post-build-variant-value=true, set at post-build, default-value=false  # This parameter controls the action of the rectifier circuit on the input data.
          enumeration DsadcSignSignalSource: {SRC_0_ON_CHIP_CARRIER_GENERATOR, SRC_1_SIGNRESULT_FROM_DSADC_CHANNEL, SRC_2_EXTERNAL_SIGN_SIGNAL_PORT00_4, SRC_3_EXTERNAL_SIGN_SIGNAL_PORT33_13}, origin=INFINEON_AURIX2G, post-build-variant-value=true, set at post-build, default-value=SRC_0_ON_CHIP_CARRIER_GENERATOR  # This parameter selects the source of the sign signal, which is to be delayed for the purpose of rectification.
          enumeration DsadcSignSignalChannel: {DSADC_CHANNEL_0, DSADC_CHANNEL_1, DSADC_CHANNEL_2, DSADC_CHANNEL_3, DSADC_CHANNEL_4, DSADC_CHANNEL_5, DSADC_CHANNEL_6, DSADC_CHANNEL_7, DSADC_CHANNEL_8, DSADC_CHANNEL_9, DSADC_CHANNEL_10, DSADC_CHANNEL_11, DSADC_CHANNEL_12, DSADC_CHANNEL_13}, origin=INFINEON_AURIX2G, post-build-variant-value=true, set at post-build, default-value=DSADC_CHANNEL_0  # This parameter selects the DSADC channel which provides the source of the sign signal, which is to be delayed for the purpose of rectification.
          integer DsadcPosSignDelayValue: 0..255, origin=INFINEON_AURIX2G, post-build-variant-value=true, set at post-build, default-value=0  # This parameter determines the value of Sign Delay counter (number of result values), for which to generate a positive delayed sign signal.
          integer DsadcNegSignDelayValue: 0..255, origin=INFINEON_AURIX2G, post-build-variant-value=true, set at post-build, default-value=0  # This parameter determines the value of Sign Delay counter (number of result values), for which to generate a negative delayed sign signal.
        container DsadcCommonModeVoltConfig  # This container provides configuration parameter related to common mode voltage application to the inputs of the modulator channel.
          boolean DsadcCommonModeVoltageEnable: origin=INFINEON_AURIX2G, post-build-variant-value=true, set at post-build, default-value=false  # This parameter defines the availability of Common Mode voltage to the input pins.
          enumeration DsadcCommonModeVoltageSelect: {DSADC_VCM_VREFX_2, DSADC_VCM_VREFX_4, DSADC_VCM_VREFX_8, DSADC_VCM_VREFX_16}, origin=INFINEON_AURIX2G, post-build-variant-value=true, set at post-build, default-value=DSADC_VCM_VREFX_2  # This parameter defines the voltage level configured as Common Mode voltage, which can be connected to the input pins.
          boolean DsadcComModeVoltPosAEnable: origin=INFINEON_AURIX2G, post-build-variant-value=true, set at post-build, default-value=false  # This parameter defines if the positive analog line connected to position A in the MUX needs to be connected to the Common Mode Voltage.
          boolean DsadcComModeVoltPosBEnable: origin=INFINEON_AURIX2G, post-build-variant-value=true, set at post-build, default-value=false  # This parameter defines if the positive analog line connected to position B in the MUX needs to be connected to the Common Mode Voltage.
          boolean DsadcComModeVoltPosCEnable: origin=INFINEON_AURIX2G, post-build-variant-value=true, set at post-build, default-value=false  # This parameter defines if the positive analog line connected to position C in the MUX needs to be connected to the Common Mode Voltage.
          boolean DsadcComModeVoltPosDEnable: origin=INFINEON_AURIX2G, post-build-variant-value=true, set at post-build, default-value=false  # This parameter defines if the positive analog line connected to position D in the MUX needs to be connected to the Common Mode Voltage.
          boolean DsadcComModeVoltNegAEnable: origin=INFINEON_AURIX2G, post-build-variant-value=true, set at post-build, default-value=false  # This parameter defines if the negative analog line connected to position A in the MUX needs to be connected to the Common Mode Voltage.
          boolean DsadcComModeVoltNegBEnable: origin=INFINEON_AURIX2G, post-build-variant-value=true, set at post-build, default-value=false  # This parameter defines if the negative analog line connected to position B in the MUX needs to be connected to the Common Mode Voltage.
          boolean DsadcComModeVoltNegCEnable: origin=INFINEON_AURIX2G, post-build-variant-value=true, set at post-build, default-value=false  # This parameter defines if the negative analog line connected to position C in the MUX needs to be connected to the Common Mode Voltage.
          boolean DsadcComModeVoltNegDEnable: origin=INFINEON_AURIX2G, post-build-variant-value=true, set at post-build, default-value=false  # This parameter defines if the negative analog line connected to position D in the MUX needs to be connected to the Common Mode Voltage.
        container DsadcFilterConfiguration  # This container provides configuration parameter related to main filter chain.
          boolean DsadcFIR0FilterEnable: origin=INFINEON_AURIX2G, post-build-variant-value=true, set at post-build, default-value=false  # This parameter defines the availability of FIR0 filter in the filter chain of the DSADC channel.
          boolean DsadcFIR1FilterEnable: origin=INFINEON_AURIX2G, post-build-variant-value=true, set at post-build, default-value=false  # This parameter defines the availability of FIR1 filter in the filter chain of the DSADC channel.
          boolean DsadcFIR1FilterDecimationEnable: origin=INFINEON_AURIX2G, post-build-variant-value=true, set at post-build, default-value=false  # This parameter defines the decimation rate of FIR1 filter.If selected as TRUE, then the filter decimates with a ratio 2:1
          boolean DsadcPreFilterEnable: origin=INFINEON_AURIX2G, post-build-variant-value=true, set at post-build, default-value=false  # This parameter defines the availability of Prefilter in the filter chain of the DSADC channel
          boolean DsadcOvershootCompensationEn: origin=INFINEON_AURIX2G, post-build-variant-value=true, set at post-build, default-value=false  # This parameter defines the availability of Overshoot compensation block in the filter chain of the DSADC channel.
          integer DsadcCICFilterDecimationFactor: 4..512, origin=INFINEON_AURIX2G, post-build-variant-value=true, set at post-build, default-value=4  # This parameter defines the oversampling rate/Decimation factor for the CIC filter.
          integer DsadcCICFilterStartValue: 4..512, origin=INFINEON_AURIX2G, post-build-variant-value=true, set at post-build, default-value=4  # This parameter defines the starting value of decimation counter, when the CIC filter is started/restarted.
          enumeration DsadcAlternateServiceReq: {DSADC_ALT_SERVICE_DISABLE, DSADC_COMPARATOR_EVENT, DSADC_TIMESTAMP_EVENT, DSADC_RESOLVER_EVENT}, origin=INFINEON_AURIX2G, post-build-variant-value=true, set at post-build, default-value=DSADC_ALT_SERVICE_DISABLE  # This parameter is used to generate alternate service request for any one of the following events, comparator event, time stamp event or alternate source.
          enumeration DsadcOffsetCompFilterEnable: {DSADC_OFFCOMP_FILTER_DISABLE, DSADC_OFFCOMP_FILTER_RATE_1, DSADC_OFFCOMP_FILTER_RATE_2, DSADC_OFFCOMP_FILTER_RATE_3, DSADC_OFFCOMP_FILTER_RATE_4, DSADC_OFFCOMP_FILTER_RATE_5, DSADC_OFFCOMP_FILTER_RATE_6, DSADC_OFFCOMP_FILTER_RATE_7}, origin=INFINEON_AURIX2G, post-build-variant-value=true, set at post-build, default-value=DSADC_OFFCOMP_FILTER_DISABLE  # This parameter indicates availability of an Offset Compensation (IIR) filter (and its various operation modes) in Offset Compensation block.
          boolean DsadcOffsetCompValueProtect: origin=INFINEON_AURIX2G, post-build-variant-value=true, set at post-build, default-value=false  # This parameter defines the protection of the Offset Compensation register from the calibration algorithm.
          integer DsadcOffsetCompValue: -32768..32767, origin=INFINEON_AURIX2G, post-build-variant-value=true, set at post-build, default-value=0  # This parameter defines the offset component value to be removed(subtracted) from each result from the filter chain.
          container DsadcAuxFilterConfig  # This configuration container provides parameters related to Dsadc Auxiliary Filter configuration..
            boolean DsadcAuxCicFilterEnable: origin=INFINEON_AURIX2G, post-build-variant-value=true, set at post-build, default-value=false  # This parameter defines the availability of Dsadc Auxiliary filter.
            enumeration DsadcAuxFilterCicDecimationFactor: {DSADC_AUXCIC_OSR_16, DSADC_AUXCIC_OSR_32}, origin=INFINEON_AURIX2G, post-build-variant-value=true, set at post-build, default-value=DSADC_AUXCIC_OSR_16  # This parameter defines the over sampling rate/decimation factor for the Auxiliary CIC filter.
          container DsadcGainCalibConfig  # This container provides configuration parameters for Gain calibration.
            container DsadcGainCorrConfig  # This container provides configuration parameters for Gain correction.
              enumeration DsadcCICFilterOutputShiftPos: {BITS_0_TO_16, BITS_1_TO_17, BITS_2_TO_18, BITS_3_TO_19, BITS_4_TO_20, BITS_5_TO_21, BITS_6_TO_22, BITS_7_TO_23, BITS_8_TO_24, BITS_9_TO_25, BITS_10_TO_26, BITS_11_TO_27, BITS_12_TO_28, BITS_13_TO_29, BITS_14_TO_30, BITS_15_TO_31, BITS_16_TO_32, BITS_17_TO_33, BITS_18_TO_34, BITS_19_TO_35, BITS_20_TO_36, BITS_21_TO_37, BITS_22_TO_38, BITS_23_TO_39, BITS_24_TO_40, BITS_25_TO_41, BITS_26_TO_42, BITS_27_TO_43, BITS_28_TO_44}, origin=INFINEON_AURIX2G, post-build-variant-value=true, set at post-build, default-value=BITS_0_TO_16  # This parameter defines the position of the CIC output shifter, which is to be used to select the valid output bits from the CIC filter.
              float DsadcGainCorrMulFactor: 0.0..1.9999, origin=INFINEON_AURIX2G, post-build-variant-value=true, set at post-build, default-value=1.0  # This parameter defines multiplication factor for Gain correction.
            container DsadcCalibAlgoConfig  # This container provides configuration parmaters for gain calibration.
              enumeration DsadcCalibCICFilterOutputShiftPos: {BITS_0_TO_16, BITS_1_TO_17, BITS_2_TO_18, BITS_3_TO_19, BITS_4_TO_20, BITS_5_TO_21, BITS_6_TO_22, BITS_7_TO_23, BITS_8_TO_24, BITS_9_TO_25, BITS_10_TO_26, BITS_11_TO_27, BITS_12_TO_28, BITS_13_TO_29, BITS_14_TO_30, BITS_15_TO_31, BITS_16_TO_32, BITS_17_TO_33, BITS_18_TO_34, BITS_19_TO_35, BITS_20_TO_36, BITS_21_TO_37, BITS_22_TO_38, BITS_23_TO_39, BITS_24_TO_40, BITS_25_TO_41, BITS_26_TO_42, BITS_27_TO_43, BITS_28_TO_44}, origin=INFINEON_AURIX2G, post-build-variant-value=true, set at post-build, default-value=BITS_0_TO_16  # This parameter defines the position of the CIC output shifter, which is to be used to select the valid output bits from the CIC filter. This is valid only during execution of the calibration algorithm.
              float DsadcCalibGainCorrMulFactor: 0.0..1.9999, origin=INFINEON_AURIX2G, post-build-variant-value=true, set at post-build, default-value=1.0  # This parameter defines multiplication factor for Gain correction. This is valid only during execution of the calibration algorithm
              enumeration DsadcCICDecimationRate: {DSADC_CIC_DECIMATION_RATE_8, DSADC_CIC_DECIMATION_RATE_16, DSADC_CIC_DECIMATION_RATE_32, DSADC_CIC_DECIMATION_RATE_64, DSADC_CIC_DECIMATION_RATE_128, DSADC_CIC_DECIMATION_RATE_256, DSADC_CIC_DECIMATION_RATE_512}, origin=INFINEON_AURIX2G, post-build-variant-value=true, set at post-build, default-value=DSADC_CIC_DECIMATION_RATE_8  # This parameter defines Decimation factor for the CIC filter. This is for only valid during execution of the calibration algorithm.
              float DsadcGainCalibMulFactor: 0.0..1.9999, origin=INFINEON_AURIX2G, post-build-variant-value=true, set at post-build, default-value=1.0  # This parameter defines multiplication factor for Gain calibration. This is valid only during execution of the calibration algorithm.
              integer DsadcCalibAlgoTargetValue: 0..32767, origin=INFINEON_AURIX2G, post-build-variant-value=true, set at post-build, default-value=25000  # This parameter defines the full scale target value for calibration algorithm
          container DsadcComparatorConfiguration  # This container provides configuration parameters for comparator configuration.
            enumeration DsadcComparatorEventSelect: {DSADC_RESULT_ALWAYS, DSADC_RESULT_INSIDE_RANGE, DSADC_RESULT_OUTSIDE_RANGE}, origin=INFINEON_AURIX2G, post-build-variant-value=true, set at post-build, default-value=DSADC_RESULT_ALWAYS  # This parameter defines the comparator mode selected to generate an alarm event (and also a service request, if selected auxiliary service request generation).
            integer DsadcLowerBoundaryValue: -32768..32767, origin=INFINEON_AURIX2G, post-build-variant-value=true, set at post-build, default-value=0  # This parameter defines the lower boundary used for limit checking.
            integer DsadcUpperBoundaryValue: -32768..32767, origin=INFINEON_AURIX2G, post-build-variant-value=true, set at post-build, default-value=0  # This parameter defines the upper boundary used for limit checking.
          container DsadcOvershootCompenConfig [0..1]: multiplicity set at post-build, post-build-variant-multiplicity=true  # This container configures the parameters for ERU input triggering
            integer DsadcStepDetectionThreshold: 0..2047, origin=INFINEON_AURIX2G, post-build-variant-value=true, set at post-build, default-value=0  # This parameter defines the threshold value (magnitude) used for step detection. The threshold value is DsadcStepDetectionThreshold * 32
            enumeration DsadcStepDetectionMode: {DSADC_STEP_DETECT_CMP_LAST, DSADC_STEP_DETECT_CMP_SEC_LAST}, origin=INFINEON_AURIX2G, post-build-variant-value=true, set at post-build, default-value=DSADC_STEP_DETECT_CMP_LAST  # This parameter defines the when the slew rate filter has to be activated
            enumeration DsadcSlewRateFilterStrength: {DSADC_MINIMUM_FILTER_EFFECT, DSADC_WEAK_FILTER_EFFECT, DSADC_MEDIUM_FILTER_EFFECT, DSADC_MAXIMUM_FILTER_EFFECT}, origin=INFINEON_AURIX2G, post-build-variant-value=true, set at post-build, default-value=DSADC_MINIMUM_FILTER_EFFECT  # This parameter defines the filter strength for the slew rate filter
            enumeration DsadcSlewRateFilterRunTime: {DSADC_SLEWRATE_FILTR_RUNTIME_2, DSADC_SLEWRATE_FILTR_RUNTIME_4, DSADC_SLEWRATE_FILTR_RUNTIME_8, DSADC_SLEWRATE_FILTR_RUNTIME_16}, origin=INFINEON_AURIX2G, post-build-variant-value=true, set at post-build, default-value=DSADC_SLEWRATE_FILTR_RUNTIME_2  # This parameter defines the time constant for the slew rate filter
