AUTOSAR XML (schema 00046)
package /AURIX2G/EcucDefs
  module definition ResourceM [0..*]: variants pre-compile  # Configuration of RM (Resource Manager) module.
    container ResourceMMcalConfig  # General container to select Master Core and allocate resources
      enumeration ResourceMMasterCore: {CORE0, CORE1, CORE2, CORE3, CORE4, CORE5}, origin=INFINEON_AURIX2G, set at pre-compile, default-value=CORE0  # Select Master core.
      integer ResourceMNumberOfActiveCores: 1..6, origin=INFINEON_AURIX2G, set at pre-compile, default-value=6  # Configuration for number of available cores in the device
      container ResourceMMcalCore [1..6]: multiplicity set at pre-compile  # General container to allocate Mcal resources to cores
        enumeration ResourceMCoreID: {CORE0, CORE1, CORE2, CORE3, CORE4, CORE5}, origin=INFINEON_AURIX2G, set at pre-compile, default-value=CORE0  # Select Master core.
        container ResourceMAllocation [0..*]: multiplicity set at pre-compile  # Container to allocate module resources.
          enumeration ResourceMModuleName: {ADC, PWM, ICU, GPT, DMA, CAN, STM, SPI, SENT, OCU, ETH, LIN}, origin=INFINEON_AURIX2G, set at pre-compile, default-value=ADC  # Module name.
          choice reference ResourceMResourceRef: scope=ECU, origin=INFINEON_AURIX2G, set at pre-compile, destination=[GptChannelConfiguration, PwmChannel, IcuChannel, DmaChannelConfig, CanController, SentChannelConfigSet, AdcHwUnit, McuStmAllocationConf, SpiHwConfigurationQspi, OcuChannel, EthCtrlConfig, LinChannel]  # This parameter contains reference to resource
