AUTOSAR XML (schema 00046)
package /AURIX2G/EcucDefs
  module config Fls_Rec: definition=Fls
  bsw implementation Fls_Impl: programming-language=C, vendor-id=17, behavior=FlsBehavior, recommended-configuration=Fls_Rec, vendor-api-infix=Dmu, vendor-specific-module-def=Fls
