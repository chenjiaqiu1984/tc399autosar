AUTOSAR XML (schema 00046)
package /AURIX2G/EcucDefs
  module config Fee_Rec: definition=Fee
  bsw implementation Fee_Impl: programming-language=C, behavior=FeeBehavior, recommended-configuration=Fee_Rec, vendor-specific-module-def=Fee
