AUTOSAR XML (schema 00046)
package /AURIX2G/EcucDefs
  module config Gpt_Rec: definition=Gpt
  bsw implementation Gpt_Impl: programming-language=C, behavior=GptBehavior, recommended-configuration=Gpt_Rec, vendor-specific-module-def=Gpt
