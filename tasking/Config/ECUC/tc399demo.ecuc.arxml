AUTOSAR XML (schema 00048)
package /ActiveEcuC
  ecuc value collection ActiveEcuC: ecu-extract=SYSTEM
    ecuc-values:
      vLinkGen
      vBRS
      BswM
      EcuM
      vBaseEnv
      Rte
      Os
      EcuC
      vSet
      ResourceM
      Dio
      Mcu
      McalLib
      Port
      Com
      PduR
      CanSM
      Can
      CanIf
      Det
      ComM
      SomeIpXf
