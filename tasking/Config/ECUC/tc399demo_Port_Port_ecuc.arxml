AUTOSAR XML (schema 00048)
package /Port
  module config Port: implementation-config-variant=VARIANT-POST-BUILD, module-description=Port_Impl
    CommonPublishedInformation:
      ArMajorVersion = 4
      ArMinorVersion = 4
      ArPatchVersion = 0
      ModuleId = 124
      Release = _TRICORE_TC399
      SwMajorVersion = 20
      SwMinorVersion = 10
      SwPatchVersion = 0
      VendorId = 17
    PortConfigSet
      23 x PortContainer:
        PortContainer_0: PortNumber=0, PortNumberOfPortPins=16
          16 x PortPin, all with PortPinControllerSelect=DISABLE, PortPinDirection=PORT_PIN_IN, PortPinDirectionChangeable=false, PortPinEmergencyStop=false, PortPinEnableAnalogInputOnly=PORT_PIN_ANALOG_INPUT_DISABLE, PortPinInitialMode=GPIO, PortPinInputPadLevel=PORT_INPUT_LEVEL_CMOS_AUTOMOTIVE, PortPinInputPullResistor=PORT_PIN_IN_PULL_UP, PortPinLevelValue=PORT_PIN_LEVEL_LOW, PortPinMode=PORT_PIN_MODE_ALL, PortPinModeChangeable=false, PortPinOutputPadDriveStrength=PORT_PIN_DEFAULT_DRIVER, PortPinOutputPinDriveMode=PORT_PIN_OUT_PUSHPULL:
            PortPin_0: PortPinId=0, PortPinSymbolicName=PORT_0_PIN_0
            PortPin_1: PortPinId=1, PortPinSymbolicName=PORT_0_PIN_1
            PortPin_{10..15}: PortPinId={10..15}, PortPinSymbolicName=PORT_0_PIN_{10..15}
            PortPin_{2..9}: PortPinId={2..9}, PortPinSymbolicName=PORT_0_PIN_{2..9}
        PortContainer_1: PortNumber=1, PortNumberOfPortPins=16
          16 x PortPin, all with PortPinControllerSelect=DISABLE, PortPinDirection=PORT_PIN_IN, PortPinDirectionChangeable=false, PortPinEmergencyStop=false, PortPinEnableAnalogInputOnly=PORT_PIN_ANALOG_INPUT_DISABLE, PortPinInitialMode=GPIO, PortPinInputPadLevel=PORT_INPUT_LEVEL_CMOS_AUTOMOTIVE, PortPinInputPullResistor=PORT_PIN_IN_PULL_UP, PortPinLevelValue=PORT_PIN_LEVEL_LOW, PortPinMode=PORT_PIN_MODE_ALL, PortPinModeChangeable=false, PortPinOutputPadDriveStrength=PORT_PIN_DEFAULT_DRIVER, PortPinOutputPinDriveMode=PORT_PIN_OUT_PUSHPULL:
            PortPin_0: PortPinId=16, PortPinSymbolicName=PORT_1_PIN_0
            PortPin_1: PortPinId=17, PortPinSymbolicName=PORT_1_PIN_1
            PortPin_10: PortPinId=26, PortPinSymbolicName=PORT_1_PIN_10
            PortPin_11: PortPinId=27, PortPinSymbolicName=PORT_1_PIN_11
            PortPin_12: PortPinId=28, PortPinSymbolicName=PORT_1_PIN_12
            PortPin_13: PortPinId=29, PortPinSymbolicName=PORT_1_PIN_13
            PortPin_14: PortPinId=30, PortPinSymbolicName=PORT_1_PIN_14
            PortPin_15: PortPinId=31, PortPinSymbolicName=PORT_1_PIN_15
            PortPin_2: PortPinId=18, PortPinSymbolicName=PORT_1_PIN_2
            PortPin_3: PortPinId=19, PortPinSymbolicName=PORT_1_PIN_3
            PortPin_4: PortPinId=20, PortPinSymbolicName=PORT_1_PIN_4
            PortPin_5: PortPinId=21, PortPinSymbolicName=PORT_1_PIN_5
            PortPin_6: PortPinId=22, PortPinSymbolicName=PORT_1_PIN_6
            PortPin_7: PortPinId=23, PortPinSymbolicName=PORT_1_PIN_7
            PortPin_8: PortPinId=24, PortPinSymbolicName=PORT_1_PIN_8
            PortPin_9: PortPinId=25, PortPinSymbolicName=PORT_1_PIN_9
        PortContainer_10: PortNumber=21, PortNumberOfPortPins=8
          3 x PortLVDS, all with PortLVDSMode=LVDSH, PortLVDSPadSupply=V3_3, PortLVDSRxEnController=PORT_CONTROLLED, PortLVDSRxPathEnable=false, PortLVDSRxTerminationMode=INTERNAL_TERMINATION, PortLVDSTxEnController=PORT_CONTROLLED, PortLVDSTxPathEnable=false, PortLVDSTxPowerDownPullDown=DISABLE:
            PortLVDS_0: PortLVDSPinPair=Pin_0_Pin_1
            PortLVDS_1: PortLVDSPinPair=Pin_2_Pin_3
            PortLVDS_2: PortLVDSPinPair=Pin_4_Pin_5
          8 x PortPin, all with PortPinControllerSelect=DISABLE, PortPinDirection=PORT_PIN_IN, PortPinDirectionChangeable=false, PortPinEmergencyStop=false, PortPinEnableAnalogInputOnly=PORT_PIN_ANALOG_INPUT_DISABLE, PortPinInitialMode=GPIO, PortPinInputPadLevel=PORT_INPUT_LEVEL_CMOS_AUTOMOTIVE, PortPinInputPullResistor=PORT_PIN_IN_PULL_UP, PortPinLevelValue=PORT_PIN_LEVEL_LOW, PortPinMode=PORT_PIN_MODE_ALL, PortPinModeChangeable=false, PortPinOutputPadDriveStrength=PORT_PIN_DEFAULT_DRIVER, PortPinOutputPinDriveMode=PORT_PIN_OUT_PUSHPULL:
            PortPin_0: PortPinId=336, PortPinSymbolicName=PORT_21_PIN_0
            PortPin_1: PortPinId=337, PortPinSymbolicName=PORT_21_PIN_1
            PortPin_2: PortPinId=338, PortPinSymbolicName=PORT_21_PIN_2
            PortPin_3: PortPinId=339, PortPinSymbolicName=PORT_21_PIN_3
            PortPin_4: PortPinId=340, PortPinSymbolicName=PORT_21_PIN_4
            PortPin_5: PortPinId=341, PortPinSymbolicName=PORT_21_PIN_5
            PortPin_6: PortPinId=342, PortPinSymbolicName=PORT_21_PIN_6
            PortPin_7: PortPinId=343, PortPinSymbolicName=PORT_21_PIN_7
        PortContainer_11: PortNumber=22, PortNumberOfPortPins=12
          PortLVDS_0 (PortLVDS):
            PortLVDSMode = LVDSH
            PortLVDSPadSupply = V3_3
            PortLVDSPinPair = Pin_0_Pin_1
            PortLVDSRxEnController = PORT_CONTROLLED
            PortLVDSRxPathEnable = false
            PortLVDSRxTerminationMode = INTERNAL_TERMINATION
            PortLVDSTxEnController = PORT_CONTROLLED
            PortLVDSTxPathEnable = false
            PortLVDSTxPowerDownPullDown = DISABLE
          PortLVDS_1 (PortLVDS):
            PortLVDSMode = LVDSH
            PortLVDSPadSupply = V3_3
            PortLVDSPinPair = Pin_2_Pin_3
            PortLVDSRxEnController = PORT_CONTROLLED
            PortLVDSRxPathEnable = false
            PortLVDSRxTerminationMode = INTERNAL_TERMINATION
            PortLVDSTxEnController = PORT_CONTROLLED
            PortLVDSTxPathEnable = false
            PortLVDSTxPowerDownPullDown = DISABLE
          12 x PortPin, all with PortPinControllerSelect=DISABLE, PortPinDirection=PORT_PIN_IN, PortPinDirectionChangeable=false, PortPinEmergencyStop=false, PortPinEnableAnalogInputOnly=PORT_PIN_ANALOG_INPUT_DISABLE, PortPinInitialMode=GPIO, PortPinInputPadLevel=PORT_INPUT_LEVEL_CMOS_AUTOMOTIVE, PortPinInputPullResistor=PORT_PIN_IN_PULL_UP, PortPinLevelValue=PORT_PIN_LEVEL_LOW, PortPinMode=PORT_PIN_MODE_ALL, PortPinModeChangeable=false, PortPinOutputPadDriveStrength=PORT_PIN_DEFAULT_DRIVER, PortPinOutputPinDriveMode=PORT_PIN_OUT_PUSHPULL:
            PortPin_0: PortPinId=352, PortPinSymbolicName=PORT_22_PIN_0
            PortPin_1: PortPinId=353, PortPinSymbolicName=PORT_22_PIN_1
            PortPin_10: PortPinId=362, PortPinSymbolicName=PORT_22_PIN_10
            PortPin_11: PortPinId=363, PortPinSymbolicName=PORT_22_PIN_11
            PortPin_2: PortPinId=354, PortPinSymbolicName=PORT_22_PIN_2
            PortPin_3: PortPinId=355, PortPinSymbolicName=PORT_22_PIN_3
            PortPin_4: PortPinId=356, PortPinSymbolicName=PORT_22_PIN_4
            PortPin_5: PortPinId=357, PortPinSymbolicName=PORT_22_PIN_5
            PortPin_6: PortPinId=358, PortPinSymbolicName=PORT_22_PIN_6
            PortPin_7: PortPinId=359, PortPinSymbolicName=PORT_22_PIN_7
            PortPin_8: PortPinId=360, PortPinSymbolicName=PORT_22_PIN_8
            PortPin_9: PortPinId=361, PortPinSymbolicName=PORT_22_PIN_9
        PortContainer_12: PortNumber=23, PortNumberOfPortPins=8
          8 x PortPin, all with PortPinControllerSelect=DISABLE, PortPinDirection=PORT_PIN_IN, PortPinDirectionChangeable=false, PortPinEmergencyStop=false, PortPinEnableAnalogInputOnly=PORT_PIN_ANALOG_INPUT_DISABLE, PortPinInitialMode=GPIO, PortPinInputPadLevel=PORT_INPUT_LEVEL_CMOS_AUTOMOTIVE, PortPinInputPullResistor=PORT_PIN_IN_PULL_UP, PortPinLevelValue=PORT_PIN_LEVEL_LOW, PortPinMode=PORT_PIN_MODE_ALL, PortPinModeChangeable=false, PortPinOutputPadDriveStrength=PORT_PIN_DEFAULT_DRIVER, PortPinOutputPinDriveMode=PORT_PIN_OUT_PUSHPULL:
            PortPin_0: PortPinId=368, PortPinSymbolicName=PORT_23_PIN_0
            PortPin_1: PortPinId=369, PortPinSymbolicName=PORT_23_PIN_1
            PortPin_2: PortPinId=370, PortPinSymbolicName=PORT_23_PIN_2
            PortPin_3: PortPinId=371, PortPinSymbolicName=PORT_23_PIN_3
            PortPin_4: PortPinId=372, PortPinSymbolicName=PORT_23_PIN_4
            PortPin_5: PortPinId=373, PortPinSymbolicName=PORT_23_PIN_5
            PortPin_6: PortPinId=374, PortPinSymbolicName=PORT_23_PIN_6
            PortPin_7: PortPinId=375, PortPinSymbolicName=PORT_23_PIN_7
        PortContainer_13: PortNumber=24, PortNumberOfPortPins=16
          16 x PortPin, all with PortPinControllerSelect=DISABLE, PortPinDirection=PORT_PIN_IN, PortPinDirectionChangeable=false, PortPinEmergencyStop=false, PortPinEnableAnalogInputOnly=PORT_PIN_ANALOG_INPUT_DISABLE, PortPinInitialMode=GPIO, PortPinInputPadLevel=PORT_INPUT_LEVEL_CMOS_AUTOMOTIVE, PortPinInputPullResistor=PORT_PIN_IN_PULL_UP, PortPinLevelValue=PORT_PIN_LEVEL_LOW, PortPinMode=PORT_PIN_MODE_ALL, PortPinModeChangeable=false, PortPinOutputPadDriveStrength=PORT_PIN_DEFAULT_DRIVER, PortPinOutputPinDriveMode=PORT_PIN_OUT_PUSHPULL:
            PortPin_0: PortPinId=384, PortPinSymbolicName=PORT_24_PIN_0
            PortPin_1: PortPinId=385, PortPinSymbolicName=PORT_24_PIN_1
            PortPin_10: PortPinId=394, PortPinSymbolicName=PORT_24_PIN_10
            PortPin_11: PortPinId=395, PortPinSymbolicName=PORT_24_PIN_11
            PortPin_12: PortPinId=396, PortPinSymbolicName=PORT_24_PIN_12
            PortPin_13: PortPinId=397, PortPinSymbolicName=PORT_24_PIN_13
            PortPin_14: PortPinId=398, PortPinSymbolicName=PORT_24_PIN_14
            PortPin_15: PortPinId=399, PortPinSymbolicName=PORT_24_PIN_15
            PortPin_2: PortPinId=386, PortPinSymbolicName=PORT_24_PIN_2
            PortPin_3: PortPinId=387, PortPinSymbolicName=PORT_24_PIN_3
            PortPin_4: PortPinId=388, PortPinSymbolicName=PORT_24_PIN_4
            PortPin_5: PortPinId=389, PortPinSymbolicName=PORT_24_PIN_5
            PortPin_6: PortPinId=390, PortPinSymbolicName=PORT_24_PIN_6
            PortPin_7: PortPinId=391, PortPinSymbolicName=PORT_24_PIN_7
            PortPin_8: PortPinId=392, PortPinSymbolicName=PORT_24_PIN_8
            PortPin_9: PortPinId=393, PortPinSymbolicName=PORT_24_PIN_9
        PortContainer_14: PortNumber=25, PortNumberOfPortPins=16
          16 x PortPin, all with PortPinControllerSelect=DISABLE, PortPinDirection=PORT_PIN_IN, PortPinDirectionChangeable=false, PortPinEmergencyStop=false, PortPinEnableAnalogInputOnly=PORT_PIN_ANALOG_INPUT_DISABLE, PortPinInitialMode=GPIO, PortPinInputPadLevel=PORT_INPUT_LEVEL_CMOS_AUTOMOTIVE, PortPinInputPullResistor=PORT_PIN_IN_PULL_UP, PortPinLevelValue=PORT_PIN_LEVEL_LOW, PortPinMode=PORT_PIN_MODE_ALL, PortPinModeChangeable=false, PortPinOutputPadDriveStrength=PORT_PIN_DEFAULT_DRIVER, PortPinOutputPinDriveMode=PORT_PIN_OUT_PUSHPULL:
            PortPin_0: PortPinId=400, PortPinSymbolicName=PORT_25_PIN_0
            PortPin_1: PortPinId=401, PortPinSymbolicName=PORT_25_PIN_1
            PortPin_10: PortPinId=410, PortPinSymbolicName=PORT_25_PIN_10
            PortPin_11: PortPinId=411, PortPinSymbolicName=PORT_25_PIN_11
            PortPin_12: PortPinId=412, PortPinSymbolicName=PORT_25_PIN_12
            PortPin_13: PortPinId=413, PortPinSymbolicName=PORT_25_PIN_13
            PortPin_14: PortPinId=414, PortPinSymbolicName=PORT_25_PIN_14
            PortPin_15: PortPinId=415, PortPinSymbolicName=PORT_25_PIN_15
            PortPin_2: PortPinId=402, PortPinSymbolicName=PORT_25_PIN_2
            PortPin_3: PortPinId=403, PortPinSymbolicName=PORT_25_PIN_3
            PortPin_4: PortPinId=404, PortPinSymbolicName=PORT_25_PIN_4
            PortPin_5: PortPinId=405, PortPinSymbolicName=PORT_25_PIN_5
            PortPin_6: PortPinId=406, PortPinSymbolicName=PORT_25_PIN_6
            PortPin_7: PortPinId=407, PortPinSymbolicName=PORT_25_PIN_7
            PortPin_8: PortPinId=408, PortPinSymbolicName=PORT_25_PIN_8
            PortPin_9: PortPinId=409, PortPinSymbolicName=PORT_25_PIN_9
        PortContainer_15: PortNumber=26, PortNumberOfPortPins=1
          PortPin_0 (PortPin):
            PortPinControllerSelect = DISABLE
            PortPinDirection = PORT_PIN_IN
            PortPinDirectionChangeable = false
            PortPinEmergencyStop = false
            PortPinEnableAnalogInputOnly = PORT_PIN_ANALOG_INPUT_DISABLE
            PortPinId = 416
            PortPinInitialMode = GPIO
            PortPinInputPadLevel = PORT_INPUT_LEVEL_CMOS_AUTOMOTIVE
            PortPinInputPullResistor = PORT_PIN_IN_PULL_UP
            PortPinLevelValue = PORT_PIN_LEVEL_LOW
            PortPinMode = PORT_PIN_MODE_ALL
            PortPinModeChangeable = false
            PortPinOutputPadDriveStrength = PORT_PIN_DEFAULT_DRIVER
            PortPinOutputPinDriveMode = PORT_PIN_OUT_PUSHPULL
            PortPinSymbolicName = PORT_26_PIN_0
        PortContainer_16: PortNumber=30, PortNumberOfPortPins=16
          16 x PortPin, all with PortPinControllerSelect=DISABLE, PortPinDirection=PORT_PIN_IN, PortPinDirectionChangeable=false, PortPinEmergencyStop=false, PortPinEnableAnalogInputOnly=PORT_PIN_ANALOG_INPUT_DISABLE, PortPinInitialMode=GPIO, PortPinInputPadLevel=PORT_INPUT_LEVEL_CMOS_AUTOMOTIVE, PortPinInputPullResistor=PORT_PIN_IN_PULL_UP, PortPinLevelValue=PORT_PIN_LEVEL_LOW, PortPinMode=PORT_PIN_MODE_ALL, PortPinModeChangeable=false, PortPinOutputPadDriveStrength=PORT_PIN_DEFAULT_DRIVER, PortPinOutputPinDriveMode=PORT_PIN_OUT_PUSHPULL:
            PortPin_0: PortPinId=480, PortPinSymbolicName=PORT_30_PIN_0
            PortPin_1: PortPinId=481, PortPinSymbolicName=PORT_30_PIN_1
            PortPin_10: PortPinId=490, PortPinSymbolicName=PORT_30_PIN_10
            PortPin_11: PortPinId=491, PortPinSymbolicName=PORT_30_PIN_11
            PortPin_12: PortPinId=492, PortPinSymbolicName=PORT_30_PIN_12
            PortPin_13: PortPinId=493, PortPinSymbolicName=PORT_30_PIN_13
            PortPin_14: PortPinId=494, PortPinSymbolicName=PORT_30_PIN_14
            PortPin_15: PortPinId=495, PortPinSymbolicName=PORT_30_PIN_15
            PortPin_2: PortPinId=482, PortPinSymbolicName=PORT_30_PIN_2
            PortPin_3: PortPinId=483, PortPinSymbolicName=PORT_30_PIN_3
            PortPin_4: PortPinId=484, PortPinSymbolicName=PORT_30_PIN_4
            PortPin_5: PortPinId=485, PortPinSymbolicName=PORT_30_PIN_5
            PortPin_6: PortPinId=486, PortPinSymbolicName=PORT_30_PIN_6
            PortPin_7: PortPinId=487, PortPinSymbolicName=PORT_30_PIN_7
            PortPin_8: PortPinId=488, PortPinSymbolicName=PORT_30_PIN_8
            PortPin_9: PortPinId=489, PortPinSymbolicName=PORT_30_PIN_9
        PortContainer_17: PortNumber=31, PortNumberOfPortPins=16
          16 x PortPin, all with PortPinControllerSelect=DISABLE, PortPinDirection=PORT_PIN_IN, PortPinDirectionChangeable=false, PortPinEmergencyStop=false, PortPinEnableAnalogInputOnly=PORT_PIN_ANALOG_INPUT_DISABLE, PortPinInitialMode=GPIO, PortPinInputPadLevel=PORT_INPUT_LEVEL_CMOS_AUTOMOTIVE, PortPinInputPullResistor=PORT_PIN_IN_PULL_UP, PortPinLevelValue=PORT_PIN_LEVEL_LOW, PortPinMode=PORT_PIN_MODE_ALL, PortPinModeChangeable=false, PortPinOutputPadDriveStrength=PORT_PIN_DEFAULT_DRIVER, PortPinOutputPinDriveMode=PORT_PIN_OUT_PUSHPULL:
            PortPin_0: PortPinId=496, PortPinSymbolicName=PORT_31_PIN_0
            PortPin_1: PortPinId=497, PortPinSymbolicName=PORT_31_PIN_1
            PortPin_10: PortPinId=506, PortPinSymbolicName=PORT_31_PIN_10
            PortPin_11: PortPinId=507, PortPinSymbolicName=PORT_31_PIN_11
            PortPin_12: PortPinId=508, PortPinSymbolicName=PORT_31_PIN_12
            PortPin_13: PortPinId=509, PortPinSymbolicName=PORT_31_PIN_13
            PortPin_14: PortPinId=510, PortPinSymbolicName=PORT_31_PIN_14
            PortPin_15: PortPinId=511, PortPinSymbolicName=PORT_31_PIN_15
            PortPin_2: PortPinId=498, PortPinSymbolicName=PORT_31_PIN_2
            PortPin_3: PortPinId=499, PortPinSymbolicName=PORT_31_PIN_3
            PortPin_4: PortPinId=500, PortPinSymbolicName=PORT_31_PIN_4
            PortPin_5: PortPinId=501, PortPinSymbolicName=PORT_31_PIN_5
            PortPin_6: PortPinId=502, PortPinSymbolicName=PORT_31_PIN_6
            PortPin_7: PortPinId=503, PortPinSymbolicName=PORT_31_PIN_7
            PortPin_8: PortPinId=504, PortPinSymbolicName=PORT_31_PIN_8
            PortPin_9: PortPinId=505, PortPinSymbolicName=PORT_31_PIN_9
        PortContainer_18: PortNumber=32, PortNumberOfPortPins=8
          8 x PortPin, all with PortPinControllerSelect=DISABLE, PortPinDirection=PORT_PIN_IN, PortPinDirectionChangeable=false, PortPinEmergencyStop=false, PortPinEnableAnalogInputOnly=PORT_PIN_ANALOG_INPUT_DISABLE, PortPinInitialMode=GPIO, PortPinInputPadLevel=PORT_INPUT_LEVEL_CMOS_AUTOMOTIVE, PortPinInputPullResistor=PORT_PIN_IN_PULL_UP, PortPinLevelValue=PORT_PIN_LEVEL_LOW, PortPinMode=PORT_PIN_MODE_ALL, PortPinModeChangeable=false, PortPinOutputPadDriveStrength=PORT_PIN_DEFAULT_DRIVER, PortPinOutputPinDriveMode=PORT_PIN_OUT_PUSHPULL:
            PortPin_0: PortPinId=512, PortPinSymbolicName=PORT_32_PIN_0
            PortPin_1: PortPinId=513, PortPinSymbolicName=PORT_32_PIN_1
            PortPin_2: PortPinId=514, PortPinSymbolicName=PORT_32_PIN_2
            PortPin_3: PortPinId=515, PortPinSymbolicName=PORT_32_PIN_3
            PortPin_4: PortPinId=516, PortPinSymbolicName=PORT_32_PIN_4
            PortPin_5: PortPinId=517, PortPinSymbolicName=PORT_32_PIN_5
            PortPin_6: PortPinId=518, PortPinSymbolicName=PORT_32_PIN_6
            PortPin_7: PortPinId=519, PortPinSymbolicName=PORT_32_PIN_7
        PortContainer_19: PortNumber=33, PortNumberOfPortPins=16
          16 x PortPin, all with PortPinControllerSelect=DISABLE, PortPinDirectionChangeable=false, PortPinEmergencyStop=false, PortPinEnableAnalogInputOnly=PORT_PIN_ANALOG_INPUT_DISABLE, PortPinInitialMode=GPIO, PortPinInputPadLevel=PORT_INPUT_LEVEL_CMOS_AUTOMOTIVE, PortPinInputPullResistor=PORT_PIN_IN_PULL_UP, PortPinMode=PORT_PIN_MODE_ALL, PortPinModeChangeable=false, PortPinOutputPadDriveStrength=PORT_PIN_DEFAULT_DRIVER, PortPinOutputPinDriveMode=PORT_PIN_OUT_PUSHPULL:
            PortPin_0: PortPinDirection=PORT_PIN_IN, PortPinId=528, PortPinLevelValue=PORT_PIN_LEVEL_LOW, PortPinSymbolicName=PORT_33_PIN_0
            PortPin_1: PortPinDirection=PORT_PIN_IN, PortPinId=529, PortPinLevelValue=PORT_PIN_LEVEL_LOW, PortPinSymbolicName=PORT_33_PIN_1
            PortPin_10: PortPinDirection=PORT_PIN_IN, PortPinId=538, PortPinLevelValue=PORT_PIN_LEVEL_LOW, PortPinSymbolicName=PORT_33_PIN_10
            PortPin_11: PortPinDirection=PORT_PIN_IN, PortPinId=539, PortPinLevelValue=PORT_PIN_LEVEL_LOW, PortPinSymbolicName=PORT_33_PIN_11
            PortPin_12: PortPinDirection=PORT_PIN_IN, PortPinId=540, PortPinLevelValue=PORT_PIN_LEVEL_LOW, PortPinSymbolicName=PORT_33_PIN_12
            PortPin_13: PortPinDirection=PORT_PIN_IN, PortPinId=541, PortPinLevelValue=PORT_PIN_LEVEL_LOW, PortPinSymbolicName=PORT_33_PIN_13
            PortPin_14: PortPinDirection=PORT_PIN_IN, PortPinId=542, PortPinLevelValue=PORT_PIN_LEVEL_LOW, PortPinSymbolicName=PORT_33_PIN_14
            PortPin_15: PortPinDirection=PORT_PIN_IN, PortPinId=543, PortPinLevelValue=PORT_PIN_LEVEL_LOW, PortPinSymbolicName=PORT_33_PIN_15
            PortPin_2: PortPinDirection=PORT_PIN_IN, PortPinId=530, PortPinLevelValue=PORT_PIN_LEVEL_LOW, PortPinSymbolicName=PORT_33_PIN_2
            PortPin_3: PortPinDirection=PORT_PIN_IN, PortPinId=531, PortPinLevelValue=PORT_PIN_LEVEL_LOW, PortPinSymbolicName=PORT_33_PIN_3
            PortPin_4: PortPinDirection=PORT_PIN_OUT, PortPinId=532, PortPinLevelValue=PORT_PIN_LEVEL_HIGH, PortPinSymbolicName=PORT_33_PIN_4
            PortPin_5: PortPinDirection=PORT_PIN_OUT, PortPinId=533, PortPinLevelValue=PORT_PIN_LEVEL_HIGH, PortPinSymbolicName=PORT_33_PIN_5
            PortPin_6: PortPinDirection=PORT_PIN_OUT, PortPinId=534, PortPinLevelValue=PORT_PIN_LEVEL_HIGH, PortPinSymbolicName=PORT_33_PIN_6
            PortPin_7: PortPinDirection=PORT_PIN_OUT, PortPinId=535, PortPinLevelValue=PORT_PIN_LEVEL_HIGH, PortPinSymbolicName=PORT_33_PIN_7
            PortPin_8: PortPinDirection=PORT_PIN_IN, PortPinId=536, PortPinLevelValue=PORT_PIN_LEVEL_LOW, PortPinSymbolicName=PORT_33_PIN_8
            PortPin_9: PortPinDirection=PORT_PIN_IN, PortPinId=537, PortPinLevelValue=PORT_PIN_LEVEL_LOW, PortPinSymbolicName=PORT_33_PIN_9
        PortContainer_2: PortNumber=2, PortNumberOfPortPins=16
          16 x PortPin, all with PortPinControllerSelect=DISABLE, PortPinDirection=PORT_PIN_IN, PortPinDirectionChangeable=false, PortPinEmergencyStop=false, PortPinEnableAnalogInputOnly=PORT_PIN_ANALOG_INPUT_DISABLE, PortPinInitialMode=GPIO, PortPinInputPadLevel=PORT_INPUT_LEVEL_CMOS_AUTOMOTIVE, PortPinInputPullResistor=PORT_PIN_IN_PULL_UP, PortPinLevelValue=PORT_PIN_LEVEL_LOW, PortPinMode=PORT_PIN_MODE_ALL, PortPinModeChangeable=false, PortPinOutputPadDriveStrength=PORT_PIN_DEFAULT_DRIVER, PortPinOutputPinDriveMode=PORT_PIN_OUT_PUSHPULL:
            PortPin_0: PortPinId=32, PortPinSymbolicName=PORT_2_PIN_0
            PortPin_1: PortPinId=33, PortPinSymbolicName=PORT_2_PIN_1
            PortPin_10: PortPinId=42, PortPinSymbolicName=PORT_2_PIN_10
            PortPin_11: PortPinId=43, PortPinSymbolicName=PORT_2_PIN_11
            PortPin_12: PortPinId=44, PortPinSymbolicName=PORT_2_PIN_12
            PortPin_13: PortPinId=45, PortPinSymbolicName=PORT_2_PIN_13
            PortPin_14: PortPinId=46, PortPinSymbolicName=PORT_2_PIN_14
            PortPin_15: PortPinId=47, PortPinSymbolicName=PORT_2_PIN_15
            PortPin_2: PortPinId=34, PortPinSymbolicName=PORT_2_PIN_2
            PortPin_3: PortPinId=35, PortPinSymbolicName=PORT_2_PIN_3
            PortPin_4: PortPinId=36, PortPinSymbolicName=PORT_2_PIN_4
            PortPin_5: PortPinId=37, PortPinSymbolicName=PORT_2_PIN_5
            PortPin_6: PortPinId=38, PortPinSymbolicName=PORT_2_PIN_6
            PortPin_7: PortPinId=39, PortPinSymbolicName=PORT_2_PIN_7
            PortPin_8: PortPinId=40, PortPinSymbolicName=PORT_2_PIN_8
            PortPin_9: PortPinId=41, PortPinSymbolicName=PORT_2_PIN_9
        PortContainer_20: PortNumber=34, PortNumberOfPortPins=5
          5 x PortPin, all with PortPinControllerSelect=DISABLE, PortPinDirection=PORT_PIN_IN, PortPinDirectionChangeable=false, PortPinEmergencyStop=false, PortPinEnableAnalogInputOnly=PORT_PIN_ANALOG_INPUT_DISABLE, PortPinInitialMode=GPIO, PortPinInputPadLevel=PORT_INPUT_LEVEL_CMOS_AUTOMOTIVE, PortPinInputPullResistor=PORT_PIN_IN_PULL_UP, PortPinLevelValue=PORT_PIN_LEVEL_LOW, PortPinMode=PORT_PIN_MODE_ALL, PortPinModeChangeable=false, PortPinOutputPadDriveStrength=PORT_PIN_DEFAULT_DRIVER, PortPinOutputPinDriveMode=PORT_PIN_OUT_PUSHPULL:
            PortPin_0: PortPinId=545, PortPinSymbolicName=PORT_34_PIN_1
            PortPin_1: PortPinId=546, PortPinSymbolicName=PORT_34_PIN_2
            PortPin_2: PortPinId=547, PortPinSymbolicName=PORT_34_PIN_3
            PortPin_3: PortPinId=548, PortPinSymbolicName=PORT_34_PIN_4
            PortPin_4: PortPinId=549, PortPinSymbolicName=PORT_34_PIN_5
        PortContainer_21: PortNumber=40, PortNumberOfPortPins=16
          16 x PortPin, all with PortPinControllerSelect=DISABLE, PortPinDirection=PORT_PIN_IN, PortPinDirectionChangeable=false, PortPinEmergencyStop=false, PortPinEnableAnalogInputOnly=PORT_PIN_ANALOG_INPUT_DISABLE, PortPinInitialMode=GPIO, PortPinInputPadLevel=PORT_INPUT_LEVEL_CMOS_AUTOMOTIVE, PortPinInputPullResistor=PORT_PIN_IN_PULL_UP, PortPinLevelValue=PORT_PIN_LEVEL_LOW, PortPinMode=PORT_PIN_MODE_ALL, PortPinModeChangeable=false, PortPinOutputPadDriveStrength=PORT_PIN_DEFAULT_DRIVER, PortPinOutputPinDriveMode=PORT_PIN_OUT_PUSHPULL:
            PortPin_0: PortPinId=640, PortPinSymbolicName=PORT_40_PIN_0
            PortPin_1: PortPinId=641, PortPinSymbolicName=PORT_40_PIN_1
            PortPin_10: PortPinId=650, PortPinSymbolicName=PORT_40_PIN_10
            PortPin_11: PortPinId=651, PortPinSymbolicName=PORT_40_PIN_11
            PortPin_12: PortPinId=652, PortPinSymbolicName=PORT_40_PIN_12
            PortPin_13: PortPinId=653, PortPinSymbolicName=PORT_40_PIN_13
            PortPin_14: PortPinId=654, PortPinSymbolicName=PORT_40_PIN_14
            PortPin_15: PortPinId=655, PortPinSymbolicName=PORT_40_PIN_15
            PortPin_2: PortPinId=642, PortPinSymbolicName=PORT_40_PIN_2
            PortPin_3: PortPinId=643, PortPinSymbolicName=PORT_40_PIN_3
            PortPin_4: PortPinId=644, PortPinSymbolicName=PORT_40_PIN_4
            PortPin_5: PortPinId=645, PortPinSymbolicName=PORT_40_PIN_5
            PortPin_6: PortPinId=646, PortPinSymbolicName=PORT_40_PIN_6
            PortPin_7: PortPinId=647, PortPinSymbolicName=PORT_40_PIN_7
            PortPin_8: PortPinId=648, PortPinSymbolicName=PORT_40_PIN_8
            PortPin_9: PortPinId=649, PortPinSymbolicName=PORT_40_PIN_9
        PortContainer_22: PortNumber=41, PortNumberOfPortPins=9
          9 x PortPin, all with PortPinControllerSelect=DISABLE, PortPinDirection=PORT_PIN_IN, PortPinDirectionChangeable=false, PortPinEmergencyStop=false, PortPinEnableAnalogInputOnly=PORT_PIN_ANALOG_INPUT_DISABLE, PortPinInitialMode=GPIO, PortPinInputPadLevel=PORT_INPUT_LEVEL_CMOS_AUTOMOTIVE, PortPinInputPullResistor=PORT_PIN_IN_PULL_UP, PortPinLevelValue=PORT_PIN_LEVEL_LOW, PortPinMode=PORT_PIN_MODE_ALL, PortPinModeChangeable=false, PortPinOutputPadDriveStrength=PORT_PIN_DEFAULT_DRIVER, PortPinOutputPinDriveMode=PORT_PIN_OUT_PUSHPULL:
            PortPin_0: PortPinId=656, PortPinSymbolicName=PORT_41_PIN_0
            PortPin_1: PortPinId=657, PortPinSymbolicName=PORT_41_PIN_1
            PortPin_2: PortPinId=658, PortPinSymbolicName=PORT_41_PIN_2
            PortPin_3: PortPinId=659, PortPinSymbolicName=PORT_41_PIN_3
            PortPin_4: PortPinId=660, PortPinSymbolicName=PORT_41_PIN_4
            PortPin_5: PortPinId=661, PortPinSymbolicName=PORT_41_PIN_5
            PortPin_6: PortPinId=662, PortPinSymbolicName=PORT_41_PIN_6
            PortPin_7: PortPinId=663, PortPinSymbolicName=PORT_41_PIN_7
            PortPin_8: PortPinId=664, PortPinSymbolicName=PORT_41_PIN_8
        PortContainer_3: PortNumber=10, PortNumberOfPortPins=15
          15 x PortPin, all with PortPinControllerSelect=DISABLE, PortPinDirection=PORT_PIN_IN, PortPinDirectionChangeable=false, PortPinEmergencyStop=false, PortPinEnableAnalogInputOnly=PORT_PIN_ANALOG_INPUT_DISABLE, PortPinInitialMode=GPIO, PortPinInputPadLevel=PORT_INPUT_LEVEL_CMOS_AUTOMOTIVE, PortPinInputPullResistor=PORT_PIN_IN_PULL_UP, PortPinLevelValue=PORT_PIN_LEVEL_LOW, PortPinMode=PORT_PIN_MODE_ALL, PortPinModeChangeable=false, PortPinOutputPadDriveStrength=PORT_PIN_DEFAULT_DRIVER, PortPinOutputPinDriveMode=PORT_PIN_OUT_PUSHPULL:
            PortPin_0: PortPinId=160, PortPinSymbolicName=PORT_10_PIN_0
            PortPin_1: PortPinId=161, PortPinSymbolicName=PORT_10_PIN_1
            PortPin_10: PortPinId=170, PortPinSymbolicName=PORT_10_PIN_10
            PortPin_11: PortPinId=171, PortPinSymbolicName=PORT_10_PIN_11
            PortPin_12: PortPinId=173, PortPinSymbolicName=PORT_10_PIN_13
            PortPin_13: PortPinId=174, PortPinSymbolicName=PORT_10_PIN_14
            PortPin_14: PortPinId=175, PortPinSymbolicName=PORT_10_PIN_15
            PortPin_2: PortPinId=162, PortPinSymbolicName=PORT_10_PIN_2
            PortPin_3: PortPinId=163, PortPinSymbolicName=PORT_10_PIN_3
            PortPin_4: PortPinId=164, PortPinSymbolicName=PORT_10_PIN_4
            PortPin_5: PortPinId=165, PortPinSymbolicName=PORT_10_PIN_5
            PortPin_6: PortPinId=166, PortPinSymbolicName=PORT_10_PIN_6
            PortPin_7: PortPinId=167, PortPinSymbolicName=PORT_10_PIN_7
            PortPin_8: PortPinId=168, PortPinSymbolicName=PORT_10_PIN_8
            PortPin_9: PortPinId=169, PortPinSymbolicName=PORT_10_PIN_9
        PortContainer_4: PortNumber=11, PortNumberOfPortPins=16
          16 x PortPin, all with PortPinControllerSelect=DISABLE, PortPinDirection=PORT_PIN_IN, PortPinDirectionChangeable=false, PortPinEmergencyStop=false, PortPinEnableAnalogInputOnly=PORT_PIN_ANALOG_INPUT_DISABLE, PortPinInitialMode=GPIO, PortPinInputPadLevel=PORT_INPUT_LEVEL_CMOS_AUTOMOTIVE, PortPinInputPullResistor=PORT_PIN_IN_PULL_UP, PortPinLevelValue=PORT_PIN_LEVEL_LOW, PortPinMode=PORT_PIN_MODE_ALL, PortPinModeChangeable=false, PortPinOutputPadDriveStrength=PORT_PIN_DEFAULT_DRIVER, PortPinOutputPinDriveMode=PORT_PIN_OUT_PUSHPULL:
            PortPin_0: PortPinId=176, PortPinSymbolicName=PORT_11_PIN_0
            PortPin_1: PortPinId=177, PortPinSymbolicName=PORT_11_PIN_1
            PortPin_10: PortPinId=186, PortPinSymbolicName=PORT_11_PIN_10
            PortPin_11: PortPinId=187, PortPinSymbolicName=PORT_11_PIN_11
            PortPin_12: PortPinId=188, PortPinSymbolicName=PORT_11_PIN_12
            PortPin_13: PortPinId=189, PortPinSymbolicName=PORT_11_PIN_13
            PortPin_14: PortPinId=190, PortPinSymbolicName=PORT_11_PIN_14
            PortPin_15: PortPinId=191, PortPinSymbolicName=PORT_11_PIN_15
            PortPin_2: PortPinId=178, PortPinSymbolicName=PORT_11_PIN_2
            PortPin_3: PortPinId=179, PortPinSymbolicName=PORT_11_PIN_3
            PortPin_4: PortPinId=180, PortPinSymbolicName=PORT_11_PIN_4
            PortPin_5: PortPinId=181, PortPinSymbolicName=PORT_11_PIN_5
            PortPin_6: PortPinId=182, PortPinSymbolicName=PORT_11_PIN_6
            PortPin_7: PortPinId=183, PortPinSymbolicName=PORT_11_PIN_7
            PortPin_8: PortPinId=184, PortPinSymbolicName=PORT_11_PIN_8
            PortPin_9: PortPinId=185, PortPinSymbolicName=PORT_11_PIN_9
        PortContainer_5: PortNumber=12, PortNumberOfPortPins=2
          PortPin_0 (PortPin):
            PortPinControllerSelect = DISABLE
            PortPinDirection = PORT_PIN_IN
            PortPinDirectionChangeable = false
            PortPinEmergencyStop = false
            PortPinEnableAnalogInputOnly = PORT_PIN_ANALOG_INPUT_DISABLE
            PortPinId = 192
            PortPinInitialMode = GPIO
            PortPinInputPadLevel = PORT_INPUT_LEVEL_CMOS_AUTOMOTIVE
            PortPinInputPullResistor = PORT_PIN_IN_PULL_UP
            PortPinLevelValue = PORT_PIN_LEVEL_LOW
            PortPinMode = PORT_PIN_MODE_ALL
            PortPinModeChangeable = false
            PortPinOutputPadDriveStrength = PORT_PIN_DEFAULT_DRIVER
            PortPinOutputPinDriveMode = PORT_PIN_OUT_PUSHPULL
            PortPinSymbolicName = PORT_12_PIN_0
          PortPin_1 (PortPin):
            PortPinControllerSelect = DISABLE
            PortPinDirection = PORT_PIN_IN
            PortPinDirectionChangeable = false
            PortPinEmergencyStop = false
            PortPinEnableAnalogInputOnly = PORT_PIN_ANALOG_INPUT_DISABLE
            PortPinId = 193
            PortPinInitialMode = GPIO
            PortPinInputPadLevel = PORT_INPUT_LEVEL_CMOS_AUTOMOTIVE
            PortPinInputPullResistor = PORT_PIN_IN_PULL_UP
            PortPinLevelValue = PORT_PIN_LEVEL_LOW
            PortPinMode = PORT_PIN_MODE_ALL
            PortPinModeChangeable = false
            PortPinOutputPadDriveStrength = PORT_PIN_DEFAULT_DRIVER
            PortPinOutputPinDriveMode = PORT_PIN_OUT_PUSHPULL
            PortPinSymbolicName = PORT_12_PIN_1
        PortContainer_6: PortNumber=13, PortNumberOfPortPins=15
          4 x PortLVDS, all with PortLVDSMode=LVDSH, PortLVDSPadSupply=V3_3, PortLVDSRxEnController=PORT_CONTROLLED, PortLVDSRxPathEnable=false, PortLVDSRxTerminationMode=INTERNAL_TERMINATION, PortLVDSTxEnController=PORT_CONTROLLED, PortLVDSTxPathEnable=false, PortLVDSTxPowerDownPullDown=DISABLE:
            PortLVDS_0: PortLVDSPinPair=Pin_0_Pin_1
            PortLVDS_1: PortLVDSPinPair=Pin_2_Pin_3
            PortLVDS_2: PortLVDSPinPair=Pin_4_Pin_5
            PortLVDS_3: PortLVDSPinPair=Pin_6_Pin_7
          15 x PortPin, all with PortPinControllerSelect=DISABLE, PortPinDirection=PORT_PIN_IN, PortPinDirectionChangeable=false, PortPinEmergencyStop=false, PortPinEnableAnalogInputOnly=PORT_PIN_ANALOG_INPUT_DISABLE, PortPinInitialMode=GPIO, PortPinInputPadLevel=PORT_INPUT_LEVEL_CMOS_AUTOMOTIVE, PortPinInputPullResistor=PORT_PIN_IN_PULL_UP, PortPinLevelValue=PORT_PIN_LEVEL_LOW, PortPinMode=PORT_PIN_MODE_ALL, PortPinModeChangeable=false, PortPinOutputPadDriveStrength=PORT_PIN_DEFAULT_DRIVER, PortPinOutputPinDriveMode=PORT_PIN_OUT_PUSHPULL:
            PortPin_0: PortPinId=208, PortPinSymbolicName=PORT_13_PIN_0
            PortPin_1: PortPinId=209, PortPinSymbolicName=PORT_13_PIN_1
            PortPin_10: PortPinId=219, PortPinSymbolicName=PORT_13_PIN_11
            PortPin_11: PortPinId=220, PortPinSymbolicName=PORT_13_PIN_12
            PortPin_12: PortPinId=221, PortPinSymbolicName=PORT_13_PIN_13
            PortPin_13: PortPinId=222, PortPinSymbolicName=PORT_13_PIN_14
            PortPin_14: PortPinId=223, PortPinSymbolicName=PORT_13_PIN_15
            PortPin_2: PortPinId=210, PortPinSymbolicName=PORT_13_PIN_2
            PortPin_3: PortPinId=211, PortPinSymbolicName=PORT_13_PIN_3
            PortPin_4: PortPinId=212, PortPinSymbolicName=PORT_13_PIN_4
            PortPin_5: PortPinId=213, PortPinSymbolicName=PORT_13_PIN_5
            PortPin_6: PortPinId=214, PortPinSymbolicName=PORT_13_PIN_6
            PortPin_7: PortPinId=215, PortPinSymbolicName=PORT_13_PIN_7
            PortPin_8: PortPinId=217, PortPinSymbolicName=PORT_13_PIN_9
            PortPin_9: PortPinId=218, PortPinSymbolicName=PORT_13_PIN_10
        PortContainer_7: PortNumber=14, PortNumberOfPortPins=16
          PortLVDS_0 (PortLVDS):
            PortLVDSMode = LVDSH
            PortLVDSPadSupply = V3_3
            PortLVDSPinPair = Pin_10_Pin_9
            PortLVDSRxEnController = PORT_CONTROLLED
            PortLVDSRxPathEnable = false
            PortLVDSRxTerminationMode = INTERNAL_TERMINATION
            PortLVDSTxEnController = PORT_CONTROLLED
            PortLVDSTxPathEnable = false
            PortLVDSTxPowerDownPullDown = DISABLE
          16 x PortPin, all with PortPinControllerSelect=DISABLE, PortPinDirection=PORT_PIN_IN, PortPinDirectionChangeable=false, PortPinEmergencyStop=false, PortPinEnableAnalogInputOnly=PORT_PIN_ANALOG_INPUT_DISABLE, PortPinInitialMode=GPIO, PortPinInputPadLevel=PORT_INPUT_LEVEL_CMOS_AUTOMOTIVE, PortPinInputPullResistor=PORT_PIN_IN_PULL_UP, PortPinLevelValue=PORT_PIN_LEVEL_LOW, PortPinMode=PORT_PIN_MODE_ALL, PortPinModeChangeable=false, PortPinOutputPadDriveStrength=PORT_PIN_DEFAULT_DRIVER, PortPinOutputPinDriveMode=PORT_PIN_OUT_PUSHPULL:
            PortPin_0: PortPinId=224, PortPinSymbolicName=PORT_14_PIN_0
            PortPin_1: PortPinId=225, PortPinSymbolicName=PORT_14_PIN_1
            PortPin_10: PortPinId=234, PortPinSymbolicName=PORT_14_PIN_10
            PortPin_11: PortPinId=235, PortPinSymbolicName=PORT_14_PIN_11
            PortPin_12: PortPinId=236, PortPinSymbolicName=PORT_14_PIN_12
            PortPin_13: PortPinId=237, PortPinSymbolicName=PORT_14_PIN_13
            PortPin_14: PortPinId=238, PortPinSymbolicName=PORT_14_PIN_14
            PortPin_15: PortPinId=239, PortPinSymbolicName=PORT_14_PIN_15
            PortPin_2: PortPinId=226, PortPinSymbolicName=PORT_14_PIN_2
            PortPin_3: PortPinId=227, PortPinSymbolicName=PORT_14_PIN_3
            PortPin_4: PortPinId=228, PortPinSymbolicName=PORT_14_PIN_4
            PortPin_5: PortPinId=229, PortPinSymbolicName=PORT_14_PIN_5
            PortPin_6: PortPinId=230, PortPinSymbolicName=PORT_14_PIN_6
            PortPin_7: PortPinId=231, PortPinSymbolicName=PORT_14_PIN_7
            PortPin_8: PortPinId=232, PortPinSymbolicName=PORT_14_PIN_8
            PortPin_9: PortPinId=233, PortPinSymbolicName=PORT_14_PIN_9
        PortContainer_8: PortNumber=15, PortNumberOfPortPins=15
          PortLVDS_0 (PortLVDS):
            PortLVDSMode = LVDSH
            PortLVDSPadSupply = V3_3
            PortLVDSPinPair = Pin_10_Pin_11
            PortLVDSRxEnController = PORT_CONTROLLED
            PortLVDSRxPathEnable = false
            PortLVDSRxTerminationMode = INTERNAL_TERMINATION
            PortLVDSTxEnController = PORT_CONTROLLED
            PortLVDSTxPathEnable = false
            PortLVDSTxPowerDownPullDown = DISABLE
          PortLVDS_1 (PortLVDS):
            PortLVDSMode = LVDSH
            PortLVDSPadSupply = V3_3
            PortLVDSPinPair = Pin_12_Pin_13
            PortLVDSRxEnController = PORT_CONTROLLED
            PortLVDSRxPathEnable = false
            PortLVDSRxTerminationMode = INTERNAL_TERMINATION
            PortLVDSTxEnController = PORT_CONTROLLED
            PortLVDSTxPathEnable = false
            PortLVDSTxPowerDownPullDown = DISABLE
          15 x PortPin, all with PortPinControllerSelect=DISABLE, PortPinDirection=PORT_PIN_IN, PortPinDirectionChangeable=false, PortPinEmergencyStop=false, PortPinEnableAnalogInputOnly=PORT_PIN_ANALOG_INPUT_DISABLE, PortPinInitialMode=GPIO, PortPinInputPadLevel=PORT_INPUT_LEVEL_CMOS_AUTOMOTIVE, PortPinInputPullResistor=PORT_PIN_IN_PULL_UP, PortPinLevelValue=PORT_PIN_LEVEL_LOW, PortPinMode=PORT_PIN_MODE_ALL, PortPinModeChangeable=false, PortPinOutputPadDriveStrength=PORT_PIN_DEFAULT_DRIVER, PortPinOutputPinDriveMode=PORT_PIN_OUT_PUSHPULL:
            PortPin_0: PortPinId=240, PortPinSymbolicName=PORT_15_PIN_0
            PortPin_1: PortPinId=241, PortPinSymbolicName=PORT_15_PIN_1
            PortPin_10: PortPinId=251, PortPinSymbolicName=PORT_15_PIN_11
            PortPin_11: PortPinId=252, PortPinSymbolicName=PORT_15_PIN_12
            PortPin_12: PortPinId=253, PortPinSymbolicName=PORT_15_PIN_13
            PortPin_13: PortPinId=254, PortPinSymbolicName=PORT_15_PIN_14
            PortPin_14: PortPinId=255, PortPinSymbolicName=PORT_15_PIN_15
            PortPin_2: PortPinId=242, PortPinSymbolicName=PORT_15_PIN_2
            PortPin_3: PortPinId=243, PortPinSymbolicName=PORT_15_PIN_3
            PortPin_4: PortPinId=244, PortPinSymbolicName=PORT_15_PIN_4
            PortPin_5: PortPinId=245, PortPinSymbolicName=PORT_15_PIN_5
            PortPin_6: PortPinId=246, PortPinSymbolicName=PORT_15_PIN_6
            PortPin_7: PortPinId=247, PortPinSymbolicName=PORT_15_PIN_7
            PortPin_8: PortPinId=248, PortPinSymbolicName=PORT_15_PIN_8
            PortPin_9: PortPinId=250, PortPinSymbolicName=PORT_15_PIN_10
        PortContainer_9: PortNumber=20, PortNumberOfPortPins=13
          13 x PortPin, all with PortPinControllerSelect=DISABLE, PortPinDirectionChangeable=false, PortPinEmergencyStop=false, PortPinEnableAnalogInputOnly=PORT_PIN_ANALOG_INPUT_DISABLE, PortPinInputPadLevel=PORT_INPUT_LEVEL_CMOS_AUTOMOTIVE, PortPinInputPullResistor=PORT_PIN_IN_PULL_UP, PortPinMode=PORT_PIN_MODE_ALL, PortPinModeChangeable=false, PortPinOutputPadDriveStrength=PORT_PIN_DEFAULT_DRIVER, PortPinOutputPinDriveMode=PORT_PIN_OUT_PUSHPULL:
            PortPin_0: PortPinDirection=PORT_PIN_IN, PortPinId=320, PortPinInitialMode=GPIO, PortPinLevelValue=PORT_PIN_LEVEL_LOW, PortPinSymbolicName=PORT_20_PIN_0
            PortPin_1: PortPinDirection=PORT_PIN_IN, PortPinId=321, PortPinInitialMode=GPIO, PortPinLevelValue=PORT_PIN_LEVEL_LOW, PortPinSymbolicName=PORT_20_PIN_1
            PortPin_10: PortPinDirection=PORT_PIN_OUT, PortPinId=332, PortPinInitialMode=GPIO, PortPinLevelValue=PORT_PIN_LEVEL_HIGH, PortPinSymbolicName=PORT_20_PIN_12
            PortPin_11: PortPinDirection=PORT_PIN_OUT, PortPinId=333, PortPinInitialMode=GPIO, PortPinLevelValue=PORT_PIN_LEVEL_HIGH, PortPinSymbolicName=PORT_20_PIN_13
            PortPin_12: PortPinDirection=PORT_PIN_OUT, PortPinId=334, PortPinInitialMode=GPIO, PortPinLevelValue=PORT_PIN_LEVEL_HIGH, PortPinSymbolicName=PORT_20_PIN_14
            PortPin_2: PortPinDirection=PORT_PIN_IN, PortPinId=322, PortPinInitialMode=GPIO, PortPinLevelValue=PORT_PIN_LEVEL_LOW, PortPinSymbolicName=PORT_20_PIN_2
            PortPin_3: PortPinDirection=PORT_PIN_IN, PortPinId=323, PortPinInitialMode=GPIO, PortPinLevelValue=PORT_PIN_LEVEL_LOW, PortPinSymbolicName=PORT_20_PIN_3
            PortPin_4: PortPinDirection=PORT_PIN_IN, PortPinId=326, PortPinInitialMode=GPIO, PortPinLevelValue=PORT_PIN_LEVEL_LOW, PortPinSymbolicName=PORT_20_PIN_6
            PortPin_5_CANRX: PortPinDirection=PORT_PIN_IN, PortPinId=327, PortPinInitialMode=GPIO, PortPinLevelValue=PORT_PIN_LEVEL_LOW, PortPinSymbolicName=PORT_20_PIN_7
            PortPin_6_CANTX: PortPinDirection=PORT_PIN_OUT, PortPinId=328, PortPinInitialMode=ALT5, PortPinLevelValue=PORT_PIN_LEVEL_LOW, PortPinSymbolicName=PORT_20_PIN_8
            PortPin_7: PortPinDirection=PORT_PIN_IN, PortPinId=329, PortPinInitialMode=GPIO, PortPinLevelValue=PORT_PIN_LEVEL_LOW, PortPinSymbolicName=PORT_20_PIN_9
            PortPin_8: PortPinDirection=PORT_PIN_IN, PortPinId=330, PortPinInitialMode=GPIO, PortPinLevelValue=PORT_PIN_LEVEL_LOW, PortPinSymbolicName=PORT_20_PIN_10
            PortPin_9: PortPinDirection=PORT_PIN_OUT, PortPinId=331, PortPinInitialMode=GPIO, PortPinLevelValue=PORT_PIN_LEVEL_HIGH, PortPinSymbolicName=PORT_20_PIN_11
    PortGeneral:
      PortDevErrorDetect = true
      PortInitApiMode = PORT_MCAL_SUPERVISOR
      PortInitCheckApi = false
      PortSafetyEnable = false
      PortSetPinDirectionApi = false
      PortSetPinModeApi = false
      PortVersionInfoApi = false
