AUTOSAR XML (schema 00048)
package /ActiveEcuC
  module config vSet: implementation-config-variant=VARIANT-PRE-COMPILE, module-description=vSet_Impl
    vSetGeneral: vSetDummyStatementKind=None
    vSetPlatform:
      vSetBitOrder = LSB_to_MSB
      vSetByteOrder = LITTLE_ENDIAN
      vSetCPUType = CPU32Bit
      vSetSizeOfEnum = Size32Bit
      vSetSizeOfInt = Size32Bit
      vSetSizeOfRAMPointer = Size32Bit
      vSetSizeOfROMPointer = Size32Bit
    vSetCalibration
