AUTOSAR XML (schema 00048)
package /ActiveEcuC
  module config Com: implementation-config-variant=VARIANT-PRE-COMPILE, module-description=Com_Impl
    ComGeneration:
      ComOutOfBoundsWriteProtectionStrategy = NONE
      ComOutOfBoundsWriteSanitizer = false
      ComOutOfBoundsReadSanitizer = false
      ComReduceConstantData2Define = false
      ComBoolDataInArrayOfStructStrategy = BOOLEAN
      ComDeduplicateIndirectedData = true
      ComDataDeduplicationStrategy = WITH_CAST
      ComReduceBoolDataByNegationThreshold = 2
      ComReduceBoolDataByNumericalComparisonThreshold = 2
      ComReduceBoolDataByNumericalRelationThreshold = 2
      ComReduceBoolDataByNumericalOperandStrategy = WITH_ANY_VALUE
      ComReduceNumericalDataByOffsetThreshold = 2
      ComReduceNumericalDataByArraySubtractionThreshold = 2
      ComReduceDataByStreaming = false
      ComShortSymbols = false
      ComInterfacesForDeactivatedData = false
      ComReferringKeysInComments = false
    ComOptimization:
      ComTxCyclicProcessingISRLockThreshold = 1
      ComTxDeadlineMonitoringISRLockThreshold = 1
      ComTxProcessingISRLockThreshold = 1
      ComRxDeadlineMonitoringISRLockThreshold = 1
      ComRxDeferredProcessingISRLockThreshold = 1
      ComGatewayProcessingISRLockThreshold = 1
      ComGatewayDescriptionProcessingISRLockThreshold = 1
      ComIPduGroupISRLockThreshold = 1
    ComConfig: ComConfigurationId=0, ComRxDeferredNotificationCacheSize=0, ComRxImmediateNotificationCacheSize=0
      Txsignal5_oRxMessage1_otestCANFDdbc_5491c7bb_Rx (ComSignal):
        ComBitPosition = 0
        ComBitSize = 8
        ComSignalEndianness = BIG_ENDIAN
        ComSignalType = SINT8
        ComSignalInitValue = 0
        ComSignalAccess = ACCESS_NEEDED_BY_SWC_OR_COM
        ComHandleId = 0
        ComSystemTemplateSystemSignalRef = Txsignal5
      ComTimeBase: ComRxTimeBase=0.01, ComTxTimeBase=0.01, ComGwTimeBase=0.01
      testEcu_otestCANFDdbc_Rx_68a3d7c4 (ComIPduGroup): ComIPduGroupHandleId=0
      Txsignal2_oTxMessage22_otestCANFDdbc_bc4438a4_Tx (ComSignal):
        ComBitPosition = 0
        ComBitSize = 8
        ComSignalEndianness = BIG_ENDIAN
        ComSignalType = SINT8
        ComTransferProperty = TRIGGERED_WITHOUT_REPETITION
        ComSignalInitValue = 0
        ComSignalAccess = ACCESS_NEEDED_BY_SWC_OR_COM
        ComHandleId = 1
        ComSystemTemplateSystemSignalRef = Txsignal2
      RxMessage1_otestCANFDdbc_d2b210c8_Rx (ComIPdu):
        ComIPduDirection = RECEIVE
        ComIPduType = NORMAL
        ComIPduHandleId = 0
        ComIPduSignalProcessing = DEFERRED
        ComIPduCancellationSupport = false
        ComIPduGroupRef = testEcu_otestCANFDdbc_Rx_68a3d7c4
        ComIPduSignalRef = Txsignal5_oRxMessage1_otestCANFDdbc_5491c7bb_Rx
        ComIPduSignalRef = Txsignal6_oRxMessage1_otestCANFDdbc_e705ea78_Rx
        ComPduIdRef = RxMessage1_otestCANFDdbc_d2b210c8_Rx
      Txsignal3_oTxMessage1_otestCANFDdbc_58f5c82c_Tx (ComSignal):
        ComBitPosition = 0
        ComBitSize = 8
        ComSignalEndianness = BIG_ENDIAN
        ComSignalType = SINT8
        ComTransferProperty = TRIGGERED_WITHOUT_REPETITION
        ComSignalInitValue = 0
        ComSignalAccess = ACCESS_NEEDED_BY_SWC_OR_COM
        ComHandleId = 2
        ComSystemTemplateSystemSignalRef = Txsignal3
      Txsignal4_oTxMessage1_otestCANFDdbc_8a208eaa_Tx (ComSignal):
        ComBitPosition = 8
        ComBitSize = 8
        ComSignalEndianness = BIG_ENDIAN
        ComSignalType = SINT8
        ComTransferProperty = TRIGGERED_WITHOUT_REPETITION
        ComSignalInitValue = 0
        ComSignalAccess = ACCESS_NEEDED_BY_SWC_OR_COM
        ComHandleId = 3
        ComSystemTemplateSystemSignalRef = Txsignal4
      TxMessage22_otestCANFDdbc_71c7c8a6_Tx (ComIPdu):
        ComIPduDirection = SEND
        ComIPduType = NORMAL
        ComIPduHandleId = 2
        ComIPduSignalProcessing = DEFERRED
        ComIPduCancellationSupport = false
        ComIPduGroupRef = testEcu_otestCANFDdbc_Tx_3ef97042
        ComIPduSignalRef = Txsignal2_oTxMessage22_otestCANFDdbc_bc4438a4_Tx
        ComPduIdRef = TxMessage22_otestCANFDdbc_71c7c8a6_Tx
        ComTxIPdu: ComTxIPduUnusedAreasDefault=0, ComMinimumDelayTime=0
          ComTxModeTrue
            ComTxMode: ComTxModeMode=PERIODIC, ComTxModeTimePeriod=0.5, ComTxModeTimeOffset=0
          ComTxModeFalse
            ComTxMode: ComTxModeMode=PERIODIC, ComTxModeTimePeriod=0.5, ComTxModeTimeOffset=0
      TxMessage1_otestCANFDdbc_628f4298_Tx (ComIPdu):
        ComIPduDirection = SEND
        ComIPduType = NORMAL
        ComIPduHandleId = 0
        ComIPduSignalProcessing = DEFERRED
        ComIPduCancellationSupport = false
        ComIPduGroupRef = testEcu_otestCANFDdbc_Tx_3ef97042
        ComIPduSignalRef = Txsignal3_oTxMessage1_otestCANFDdbc_58f5c82c_Tx
        ComIPduSignalRef = Txsignal4_oTxMessage1_otestCANFDdbc_8a208eaa_Tx
        ComPduIdRef = TxMessage1_otestCANFDdbc_628f4298_Tx
        ComTxIPdu: ComTxIPduUnusedAreasDefault=0, ComMinimumDelayTime=0
          ComTxModeTrue
            ComTxMode: ComTxModeMode=PERIODIC, ComTxModeTimePeriod=0.5, ComTxModeTimeOffset=0, ComTxModeNumberOfRepetitions=0
          ComTxModeFalse
            ComTxMode: ComTxModeMode=PERIODIC, ComTxModeTimePeriod=0.5, ComTxModeTimeOffset=0
      Txsignal1_oTxMessage3_otestCANFDdbc_2d6b4f3f_Tx (ComSignal):
        ComBitPosition = 0
        ComBitSize = 8
        ComSignalEndianness = BIG_ENDIAN
        ComSignalType = SINT8
        ComTransferProperty = TRIGGERED_WITHOUT_REPETITION
        ComSignalInitValue = 0
        ComSignalAccess = ACCESS_NEEDED_BY_SWC_OR_COM
        ComHandleId = 0
        ComSystemTemplateSystemSignalRef = Txsignal1
      testEcu_otestCANFDdbc_Tx_3ef97042 (ComIPduGroup): ComIPduGroupHandleId=1
      TxMessage3_otestCANFDdbc_ca09f309_Tx (ComIPdu):
        ComIPduDirection = SEND
        ComIPduType = NORMAL
        ComIPduHandleId = 1
        ComIPduSignalProcessing = DEFERRED
        ComIPduCancellationSupport = false
        ComIPduGroupRef = testEcu_otestCANFDdbc_Tx_3ef97042
        ComIPduSignalRef = Txsignal1_oTxMessage3_otestCANFDdbc_2d6b4f3f_Tx
        ComPduIdRef = TxMessage3_otestCANFDdbc_ca09f309_Tx
        ComTxIPdu: ComTxIPduUnusedAreasDefault=0, ComMinimumDelayTime=0
          ComTxModeTrue
            ComTxMode: ComTxModeMode=PERIODIC, ComTxModeTimePeriod=0.5, ComTxModeTimeOffset=0
          ComTxModeFalse
            ComTxMode: ComTxModeMode=PERIODIC, ComTxModeTimePeriod=0.5, ComTxModeTimeOffset=0
      Txsignal6_oRxMessage1_otestCANFDdbc_e705ea78_Rx (ComSignal):
        ComBitPosition = 8
        ComBitSize = 8
        ComSignalEndianness = BIG_ENDIAN
        ComSignalType = SINT8
        ComSignalInitValue = 0
        ComSignalAccess = ACCESS_NEEDED_BY_SWC_OR_COM
        ComHandleId = 1
        ComSystemTemplateSystemSignalRef = Txsignal6
    ComGeneral:
      ComConfigurationUseDet = true
      ComSafeBswChecks = false
      ComEnableSignalGroupArrayApi = false
      ComRetryFailedTransmitRequests = false
      ComSupportedIPduGroups = 2
      ComVersionInfoApi = false
      ComAdvancedIPduCallouts = true
      ComOptimizedIPduGroupHandling = false
      ComMetaDataSupport = false
      ComReceiveSignalMacroAPI = false
      ComDeferredEventCacheSupport = false
      ComMainfunctionTimingDomainSupport = false
      ComSignalGateway = false
      ComDescriptionGateway = false
      ComDescriptionRoutingCodeGeneration = false
