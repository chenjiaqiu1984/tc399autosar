AUTOSAR XML (schema 00048)
package /InitialEcuC
  ecuc value collection InitialEcuC: ecuc-values=[Can, CanIf, CanSM, Com, ComM, EcuC, EcuM, PduR]
  module config Can
    CanConfigSet
      CT_testCANFDdbc_2c920817 (CanController):  # testCANFDdbc
        CanControllerActivation = true
        CanControllerDefaultBaudrate = CanControllerBaudrateConfig
        CanControllerSystemRef = CT_testCANFDdbc
        CanWakeupSourceRef = EcuMCommonConfiguration/CN_testCANFDdbc_9817eee0
        CanControllerBaudrateConfig
      CN_testCANFDdbc_07248e7d_Rx (CanHardwareObject): CanHandleType=BASIC, CanIdType=STANDARD, CanIdValue=0, CanObjectType=RECEIVE, CanControllerRef=CanConfigSet/CT_testCANFDdbc_2c920817
      CN_testCANFDdbc_9817eee0_Tx (CanHardwareObject): CanHandleType=BASIC, CanIdValue=0, CanObjectType=TRANSMIT, CanControllerRef=CanConfigSet/CT_testCANFDdbc_2c920817
    CanGeneral: CanIndex=0
  module config CanIf
    CanIfCtrlDrvCfg_7d254554 (CanIfCtrlDrvCfg): CanIfCtrlDrvInitHohConfigRef=CanIfInitHohCfg, CanIfCtrlDrvNameRef=CanGeneral
      CT_testCANFDdbc_2c920817 (CanIfCtrlCfg): CanIfCtrlCanCtrlRef=CanConfigSet/CT_testCANFDdbc_2c920817
    CanIfInitCfg
      CHNL_7a25eeb6 (CanIfBufferCfg): CanIfBufferSize=0, CanIfBufferHthRef=CanIfInitHohCfg/CN_testCANFDdbc_9817eee0_Tx
      CanIfInitHohCfg: CanIfInitRefCfgSet=CanConfigSet
        CN_testCANFDdbc_07248e7d_Rx (CanIfHrhCfg): CanIfHrhCanCtrlIdRef=CanIfCtrlDrvCfg_7d254554/CT_testCANFDdbc_2c920817, CanIfHrhIdSymRef=CanConfigSet/CN_testCANFDdbc_07248e7d_Rx
        CN_testCANFDdbc_9817eee0_Tx (CanIfHthCfg): CanIfHthCanCtrlIdRef=CanIfCtrlDrvCfg_7d254554/CT_testCANFDdbc_2c920817, CanIfHthIdSymRef=CanConfigSet/CN_testCANFDdbc_9817eee0_Tx
      RxMessage1_otestCANFDdbc_38deded6_Rx (CanIfRxPduCfg):
        CanIfRxPduCanId = 102
        CanIfRxPduCanIdType = STANDARD_CAN
        CanIfRxPduDlc = 64
        CanIfRxPduUserRxIndicationName = PduR_CanIfRxIndication
        CanIfRxPduUserRxIndicationUL = PDUR
        CanIfRxPduHrhIdRef = CanIfInitHohCfg/CN_testCANFDdbc_07248e7d_Rx
        CanIfRxPduRef = EcucPduCollection/RxMessage1_otestCANFDdbc_77d9d6ec_Rx
      3 x CanIfTxPduCfg, all with CanIfTxPduCanIdType=STANDARD_FD_CAN, CanIfTxPduUserTxConfirmationName=PduR_CanIfTxConfirmation, CanIfTxPduUserTxConfirmationUL=PDUR, CanIfTxPduBufferRef=CanIfInitCfg/CHNL_7a25eeb6:
        TxMessage1_otestCANFDdbc_815f4c47_Tx: CanIfTxPduCanId=17, CanIfTxPduDlc=64, CanIfTxPduRef=EcucPduCollection/TxMessage1_otestCANFDdbc_ac1d89c7_Tx
        TxMessage22_otestCANFDdbc_f66bbf36_Tx: CanIfTxPduCanId=34, CanIfTxPduDlc=8, CanIfTxPduRef=EcucPduCollection/TxMessage22_otestCANFDdbc_ad75736a_Tx
        TxMessage3_otestCANFDdbc_547b0ac5_Tx: CanIfTxPduCanId=51, CanIfTxPduDlc=32, CanIfTxPduRef=EcucPduCollection/TxMessage3_otestCANFDdbc_768ca1b8_Tx
    CanIfPrivateCfg: CanIfPrivateSoftwareFilterType=LINEAR
    CanIfPublicCfg: CanIfPublicPnSupport=false
  module config CanSM
    CanSMConfiguration
      CHNL_7a25eeb6 (CanSMManagerNetwork): CanSMComMNetworkHandleRef=ComMConfigSet/CN_testCANFDdbc_9817eee0
        CT_testCANFDdbc_da3d3e0f (CanSMController): CanSMControllerId=CanIfCtrlDrvCfg_7d254554/CT_testCANFDdbc_2c920817
  module config Com
    ComConfig
      4 x ComIPdu, all with ComIPduType=NORMAL:
        RxMessage1_otestCANFDdbc_d2b210c8_Rx: ComIPduDirection=RECEIVE, ComIPduGroupRef=testEcu_otestCANFDdbc_Rx_68a3d7c4, ComIPduSignalRef=Txsignal5_oRxMessage1_otestCANFDdbc_5491c7bb_Rx, ComIPduSignalRef=Txsignal6_oRxMessage1_otestCANFDdbc_e705ea78_Rx, ComPduIdRef=EcucPduCollection/RxMessage1_otestCANFDdbc_d2b210c8_Rx
        TxMessage1_otestCANFDdbc_628f4298_Tx: ComIPduDirection=SEND, ComIPduGroupRef=testEcu_otestCANFDdbc_Tx_3ef97042, ComIPduSignalRef=Txsignal3_oTxMessage1_otestCANFDdbc_58f5c82c_Tx, ComIPduSignalRef=Txsignal4_oTxMessage1_otestCANFDdbc_8a208eaa_Tx, ComPduIdRef=EcucPduCollection/TxMessage1_otestCANFDdbc_628f4298_Tx
          ComTxIPdu: ComTxIPduUnusedAreasDefault=0
        TxMessage22_otestCANFDdbc_71c7c8a6_Tx: ComIPduDirection=SEND, ComIPduGroupRef=testEcu_otestCANFDdbc_Tx_3ef97042, ComIPduSignalRef=Txsignal2_oTxMessage22_otestCANFDdbc_bc4438a4_Tx, ComPduIdRef=EcucPduCollection/TxMessage22_otestCANFDdbc_71c7c8a6_Tx
          ComTxIPdu: ComTxIPduUnusedAreasDefault=0
        TxMessage3_otestCANFDdbc_ca09f309_Tx: ComIPduDirection=SEND, ComIPduGroupRef=testEcu_otestCANFDdbc_Tx_3ef97042, ComIPduSignalRef=Txsignal1_oTxMessage3_otestCANFDdbc_2d6b4f3f_Tx, ComPduIdRef=EcucPduCollection/TxMessage3_otestCANFDdbc_ca09f309_Tx
          ComTxIPdu: ComTxIPduUnusedAreasDefault=0
      testEcu_otestCANFDdbc_Rx_68a3d7c4 (ComIPduGroup)
      testEcu_otestCANFDdbc_Tx_3ef97042 (ComIPduGroup)
      6 x ComSignal, all with ComBitSize=8, ComSignalEndianness=LITTLE_ENDIAN, ComSignalType=SINT8:
        Txsignal1_oTxMessage3_otestCANFDdbc_2d6b4f3f_Tx: ComBitPosition=0, ComTransferProperty=PENDING, ComSystemTemplateSystemSignalRef=Txsignal1
        Txsignal2_oTxMessage22_otestCANFDdbc_bc4438a4_Tx: ComBitPosition=0, ComTransferProperty=PENDING, ComSystemTemplateSystemSignalRef=Txsignal2
        Txsignal3_oTxMessage1_otestCANFDdbc_58f5c82c_Tx: ComBitPosition=0, ComTransferProperty=PENDING, ComSystemTemplateSystemSignalRef=Txsignal3
        Txsignal4_oTxMessage1_otestCANFDdbc_8a208eaa_Tx: ComBitPosition=8, ComTransferProperty=PENDING, ComSystemTemplateSystemSignalRef=Txsignal4
        Txsignal5_oRxMessage1_otestCANFDdbc_5491c7bb_Rx: ComBitPosition=0, ComSystemTemplateSystemSignalRef=Txsignal5
        Txsignal6_oRxMessage1_otestCANFDdbc_e705ea78_Rx: ComBitPosition=8, ComSystemTemplateSystemSignalRef=Txsignal6
    ComGeneral
  module config ComM
    ComMConfigSet: ComMPncEnabled=false
      CN_testCANFDdbc_9817eee0 (ComMChannel): ComMBusType=COMM_BUS_TYPE_CAN, ComMChannelId=0
        ComMNetworkManagement: ComMNmVariant=NONE
        CN_testCANFDdbc_78c1a9a9 (ComMUserPerChannel): ComMUserChannel=CN_testCANFDdbc_76c2c5ca
      CN_testCANFDdbc_76c2c5ca (ComMUser): ComMUserIdentifier=0
    ComMGeneral: ComMPncIdCounting=COMM_PNC_ID_COUNT_FROM_NM_MESSAGE, ComMPncSupport=false
  module config EcuC
    EcucPduCollection: PduIdTypeEnum=UINT8, PduLengthTypeEnum=UINT8
      8 x Pdu, all with DynamicLength=false:
        RxMessage1_otestCANFDdbc_77d9d6ec_Rx: PduLength=64, SysTPduToFrameMappingRef=RxMessage1
        RxMessage1_otestCANFDdbc_d2b210c8_Rx: PduLength=64
        TxMessage1_otestCANFDdbc_628f4298_Tx: PduLength=64
        TxMessage1_otestCANFDdbc_ac1d89c7_Tx: PduLength=64, SysTPduToFrameMappingRef=TxMessage1
        TxMessage22_otestCANFDdbc_71c7c8a6_Tx: PduLength=8
        TxMessage22_otestCANFDdbc_ad75736a_Tx: PduLength=8, SysTPduToFrameMappingRef=TxMessage22
        TxMessage3_otestCANFDdbc_768ca1b8_Tx: PduLength=32, SysTPduToFrameMappingRef=TxMessage3
        TxMessage3_otestCANFDdbc_ca09f309_Tx: PduLength=32
  module config EcuM
    EcuMConfiguration
      EcuMCommonConfiguration
        EcuMDriverInitListOne
        EcuMDriverRestartList
        CN_testCANFDdbc_9817eee0 (EcuMWakeupSource): EcuMWakeupSourceId=5, EcuMComMChannelRef=ComMConfigSet/CN_testCANFDdbc_9817eee0
      EcuMFlexConfiguration: EcuMFlexModuleConfigurationRef=CanConfigSet
  module config PduR
    PduRGeneral
    PduRRoutingTables
      PduRRoutingTable
        4 x PduRRoutingPath:
          RxMessage1_otestCANFDdbc_77d9d6ec_Rx
            RxMessage1_otestCANFDdbc_77d9d6ec_Rx_80d39056_Rx (PduRDestPdu): PduRDestPduRef=EcucPduCollection/RxMessage1_otestCANFDdbc_d2b210c8_Rx
            PduRSrcPdu_80d39056 (PduRSrcPdu): PduRSrcPduRef=EcucPduCollection/RxMessage1_otestCANFDdbc_77d9d6ec_Rx
          TxMessage1_otestCANFDdbc_628f4298_Tx
            TxMessage1_otestCANFDdbc_ac1d89c7_Tx (PduRDestPdu): PduRDestPduRef=EcucPduCollection/TxMessage1_otestCANFDdbc_ac1d89c7_Tx
            PduRSrcPdu_79258668 (PduRSrcPdu): PduRSrcPduRef=EcucPduCollection/TxMessage1_otestCANFDdbc_628f4298_Tx
          TxMessage22_otestCANFDdbc_71c7c8a6_Tx
            TxMessage22_otestCANFDdbc_ad75736a_Tx (PduRDestPdu): PduRDestPduRef=EcucPduCollection/TxMessage22_otestCANFDdbc_ad75736a_Tx
            PduRSrcPdu_33a6f9f9 (PduRSrcPdu): PduRSrcPduRef=EcucPduCollection/TxMessage22_otestCANFDdbc_71c7c8a6_Tx
          TxMessage3_otestCANFDdbc_ca09f309_Tx
            TxMessage3_otestCANFDdbc_768ca1b8_Tx (PduRDestPdu): PduRDestPduRef=EcucPduCollection/TxMessage3_otestCANFDdbc_768ca1b8_Tx
            PduRSrcPdu_0293919a (PduRSrcPdu): PduRSrcPduRef=EcucPduCollection/TxMessage3_otestCANFDdbc_ca09f309_Tx
