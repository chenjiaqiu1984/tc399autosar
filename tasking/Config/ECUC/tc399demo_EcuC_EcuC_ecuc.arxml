AUTOSAR XML (schema 00048)
package /ActiveEcuC
  module config EcuC: implementation-config-variant=VARIANT-PRE-COMPILE, module-description=EcuC_Impl
    EcucGeneral:
      CPUType = CPU32Bit
      ByteOrder = LITTLE_ENDIAN
      BitOrder = LSB_to_MSB
      AtomicBitAccessInBitfield = false
      AtomicVariableAccess = Atomic32BitAccess
      SizeOfEnum = Size32Bit
      SizeOfInt = Size32Bit
      SizeOfROMPointer = Size32Bit
      SizeOfRAMPointer = Size32Bit
      BitFieldDataType = INT
      StructAlignment = Auto
      ArrayAlignment = Auto
      StructInArrayAlignment = Auto
      DummyFunction = false
      EcuCSafeBswChecks = false
      DummyStatement = false
      DummyStatementKind = None
      ConditionalGenerating = true
      EcucBswImplementationCodeType = EcuCSourceCode
      EcuCUseStdReturnTypeForRte = false
      PostbuildLoadable: AlignmentFillPattern=0, PBROMStartAddress=0, PBRAMStartAddress=0, PBROMEndAddress=0, PBRAMEndAddress=0
      BswInitialization
        31 x InitFunction:
          BswM_PreInit: Header=BswM.h, InitPhase=INIT_ONE, ConfigType=BswM_ConfigType, ConfigPtrName=BswM_Config_Ptr, ConfigPtrClass=BSWM_INIT_DATA, ModuleRef=BswM  # /ActiveEcuC/BswM PLAIN_TEXT PreInit function description of BswM in UnfilteredViewInInvariantProject (UnfilteredInvariantProjectModelView) .
          BswM_Init: Header=BswM.h, InitPhase=NO_INIT, ConfigType=BswM_ConfigType, ConfigPtrName=BswM_Config_Ptr, ConfigPtrClass=BSWM_INIT_DATA, ModuleRef=BswM  # /ActiveEcuC/BswM PLAIN_TEXT Init function description of BswM in UnfilteredViewInInvariantProject (UnfilteredInvariantProjectModelView) .
          BswM_InitMemory: Header=BswM.h, InitPhase=INIT_MEMORY, ModuleRef=BswM  # /ActiveEcuC/BswM PLAIN_TEXT InitMemory function description of BswM in UnfilteredViewInInvariantProject (UnfilteredInvariantProjectModelView) .
          EcuM_Init: Header=EcuM.h, InitPhase=NO_INIT, ConfigType=EcuM_PbConfigType, ConfigPtrName=EcuM_Config_Ptr, ConfigPtrClass=ECUM_INIT_DATA, ModuleRef=EcuM  # /ActiveEcuC/EcuM PLAIN_TEXT Init function description of EcuM in UnfilteredViewInInvariantProject (UnfilteredInvariantProjectModelView) .
          Rte_InitMemory: Header=Rte_Main.h, InitPhase=INIT_MEMORY, ModuleRef=Rte  # /ActiveEcuC/Rte PLAIN_TEXT Automatically generated by EcuCBswInitFctConfigurationService.
          Rte_Start: Header=Rte_Main.h, InitPhase=INIT_THREE, ModuleRef=Rte  # /ActiveEcuC/Rte PLAIN_TEXT Automatically generated by EcuCBswInitFctConfigurationService.
          SchM_Init: Header=Rte_Main.h, InitPhase=NO_INIT, ModuleRef=Rte  # /ActiveEcuC/Rte PLAIN_TEXT Automatically generated by EcuCBswInitFctConfigurationService.
          Rte_StartTiming: Header=Rte_Main.h, InitPhase=NO_INIT, ModuleRef=Rte  # /ActiveEcuC/Rte PLAIN_TEXT Automatically generated by EcuCBswInitFctConfigurationService.
          Brs_Init: Header=, InitPhase=NO_INIT, ModuleRef=vBRS  # /ActiveEcuC/vBRS PLAIN_TEXT Automatically generated by EcuCBswInitFctConfigurationService.
          vBaseEnv_Init: Header=, InitPhase=NO_INIT, ModuleRef=vBaseEnv  # /ActiveEcuC/vBaseEnv PLAIN_TEXT Created vBaseEnv_Init by Extended Init XML Service
          vLinkGen_Init: Header=vLinkGen_Lcfg.h, InitPhase=NO_INIT, ModuleRef=vLinkGen  # /ActiveEcuC/vLinkGen PLAIN_TEXT Dummy initialization of the vLinkGen
          Dio_Init: Header=Dio.h, InitPhase=NO_INIT, ModuleRef=Dio  # /Dio/Dio PLAIN_TEXT Created Dio_Init by Extended Init XML Service
          McalLib_Init: Header=McalLib.h, InitPhase=NO_INIT, ModuleRef=McalLib  # /McalLib/McalLib PLAIN_TEXT Created McalLib_Init by Extended Init XML Service
          Mcu_Init: Header=Mcu.h, InitPhase=INIT_ONE_EARLY, ConfigType=Mcu_ConfigType, ConfigPtrName=&Mcu_Config, ConfigPtrClass=AUTOMATIC, AdditionalInitCode=Mcu_InitClock(0);while (MCU_PLL_LOCKED != Mcu_GetPllStatus());Mcu_DistributePllClock();, ModuleRef=Mcu  # /Mcu/Mcu PLAIN_TEXT Created Mcu_Init by Extended Init XML Service
          Port_Init: Header=Port.h, InitPhase=INIT_ONE_EARLY, ConfigType=Port_ConfigType, ConfigPtrName=&Port_Config, ConfigPtrClass=AUTOMATIC, ModuleRef=Port  # /Port/Port PLAIN_TEXT Created Port_Init by Extended Init XML Service
          Can_InitMemory: Header=Can.h, InitPhase=INIT_MEMORY, ModuleRef=Can  # /ActiveEcuC/Can PLAIN_TEXT InitMemory function description of Can in UnfilteredViewInInvariantProject (UnfilteredInvariantProjectModelView) .
          Can_Init: Header=Can.h, InitPhase=INIT_TWO_DRV, ConfigType=Can_ConfigType, ConfigPtrName=Can_Config_Ptr, ConfigPtrClass=CAN_INIT_DATA, ModuleRef=Can  # /ActiveEcuC/Can PLAIN_TEXT Init function description of Can in UnfilteredViewInInvariantProject (UnfilteredInvariantProjectModelView) .
          CanIf_Init: Header=CanIf.h, InitPhase=INIT_TWO_IF, ConfigType=CanIf_ConfigType, ConfigPtrName=CanIf_Config_Ptr, ConfigPtrClass=CANIF_INIT_DATA, ModuleRef=CanIf  # /ActiveEcuC/CanIf PLAIN_TEXT Init function description of CanIf in UnfilteredViewInInvariantProject (UnfilteredInvariantProjectModelView) .
          CanIf_InitMemory: Header=CanIf.h, InitPhase=INIT_MEMORY, ModuleRef=CanIf  # /ActiveEcuC/CanIf PLAIN_TEXT InitMemory function description of CanIf in UnfilteredViewInInvariantProject (UnfilteredInvariantProjectModelView) .
          CanSM_InitMemory: Header=CanSM_EcuM.h, InitPhase=INIT_MEMORY, ModuleRef=CanSM  # /ActiveEcuC/CanSM PLAIN_TEXT InitMemory function description of CanSM in UnfilteredViewInInvariantProject (UnfilteredInvariantProjectModelView) .
          CanSM_Init: Header=CanSM_EcuM.h, InitPhase=INIT_TWO_SM, ConfigType=CanSM_ConfigType, ConfigPtrName=CanSM_Config_Ptr, ConfigPtrClass=CANSM_INIT_DATA, ModuleRef=CanSM  # /ActiveEcuC/CanSM PLAIN_TEXT Init function description of CanSM in UnfilteredViewInInvariantProject (UnfilteredInvariantProjectModelView) .
          ComM_InitMemory: Header=ComM.h, InitPhase=INIT_MEMORY, ModuleRef=ComM  # /ActiveEcuC/ComM PLAIN_TEXT Initializes variables of Communication Manager
          ComM_Init: Header=ComM.h, InitPhase=INIT_TWO_POST_NVMREADALL, ModuleRef=ComM  # /ActiveEcuC/ComM PLAIN_TEXT Init function description of ComM
          Com_InitMemory: Header=Com.h, InitPhase=INIT_MEMORY, ModuleRef=Com  # /ActiveEcuC/Com PLAIN_TEXT InitMemory function description of Com in UnfilteredViewInInvariantProject (UnfilteredInvariantProjectModelView) .
          Com_Init: Header=Com.h, InitPhase=INIT_TWO_COM, ConfigType=Com_ConfigType, ConfigPtrName=Com_Config_Ptr, ConfigPtrClass=COM_INIT_DATA, ModuleRef=Com  # /ActiveEcuC/Com PLAIN_TEXT Init function description of Com in UnfilteredViewInInvariantProject (UnfilteredInvariantProjectModelView) .
          Det_Init: Header=Det.h, InitPhase=INIT_ZERO, ConfigType=Det_ConfigType, ConfigPtrName=Det_Config_Ptr, ConfigPtrClass=DET_INIT_DATA, ModuleRef=Det  # /ActiveEcuC/Det PLAIN_TEXT Init function description of Det in UnfilteredViewInInvariantProject (UnfilteredInvariantProjectModelView) .
          Det_InitMemory: Header=Det.h, InitPhase=INIT_MEMORY, ModuleRef=Det  # /ActiveEcuC/Det PLAIN_TEXT InitMemory function description of Det in UnfilteredViewInInvariantProject (UnfilteredInvariantProjectModelView) .
          PduR_Init: Header=PduR.h, InitPhase=INIT_TWO_COM, ConfigType=PduR_PBConfigType, ConfigPtrName=PduR_Config_Ptr, ConfigPtrClass=PDUR_INIT_DATA, ModuleRef=PduR  # /ActiveEcuC/PduR PLAIN_TEXT Init function description of PduR in UnfilteredViewInInvariantProject (UnfilteredInvariantProjectModelView) .
          PduR_InitMemory: Header=PduR.h, InitPhase=INIT_MEMORY, ModuleRef=PduR  # /ActiveEcuC/PduR PLAIN_TEXT InitMemory function description of PduR in UnfilteredViewInInvariantProject (UnfilteredInvariantProjectModelView) .
          PduR_PreInit: Header=PduR.h, InitPhase=INIT_ONE, ConfigType=PduR_PBConfigType, ConfigPtrName=PduR_Config_Ptr, ConfigPtrClass=PDUR_INIT_DATA, ModuleRef=PduR  # /ActiveEcuC/PduR PLAIN_TEXT PreInit function description of PduR in UnfilteredViewInInvariantProject (UnfilteredInvariantProjectModelView) .
          SomeIpXf_Init: Header=SomeIpXf.h, InitPhase=NO_INIT, ModuleRef=SomeIpXf  # /ActiveEcuC/SomeIpXf PLAIN_TEXT Automatically generated by EcuCBswInitFctConfigurationService.
    EcucHardware
      EcucCoreDefinition: EcucCoreId=0
    ECUDioPort_P33_4 (EcucPartitionCollection)
      EcucPartition: EcucPartitionBswModuleExecution=false, PartitionCanBeRestarted=false, ASIL=QM
    EcucPduCollection: PduIdTypeEnum=UINT8, PduLengthTypeEnum=UINT8
      8 x Pdu, all with DynamicLength=false, J1939Requestable=false:
        RxMessage1_otestCANFDdbc_77d9d6ec_Rx: PduLength=64, SysTPduToFrameMappingRef=RxMessage1
        TxMessage1_otestCANFDdbc_628f4298_Tx: PduLength=64
        TxMessage22_otestCANFDdbc_71c7c8a6_Tx: PduLength=8
        TxMessage1_otestCANFDdbc_ac1d89c7_Tx: PduLength=64, SysTPduToFrameMappingRef=TxMessage1
        TxMessage3_otestCANFDdbc_768ca1b8_Tx: PduLength=32, SysTPduToFrameMappingRef=TxMessage3
        RxMessage1_otestCANFDdbc_d2b210c8_Rx: PduLength=64
        TxMessage3_otestCANFDdbc_ca09f309_Tx: PduLength=32
        TxMessage22_otestCANFDdbc_ad75736a_Tx: PduLength=8, SysTPduToFrameMappingRef=TxMessage22
