AUTOSAR XML (schema 00048)
package /ActiveEcuC
  module config Rte: implementation-config-variant=VARIANT-PRE-COMPILE, module-description=Rte_Impl
    RteOsInteraction
      4 x RteUsedOsActivation, all with RteExpectedActivationOffset=0, RteExpectedTickDuration=0:
        Rte_Al_TE2_bsw_task_0_10ms: RteActivationOsAlarmRef=Rte_Al_TE2_bsw_task_0_10ms, RteActivationOsTaskRef=bsw_task
        Rte_Al_TE_swc_test_swc_test_10ms: RteActivationOsAlarmRef=Rte_Al_TE_swc_test_swc_test_10ms, RteActivationOsTaskRef=swc_task
        Rte_Al_TE_swc_test_swc_test_500ms: RteActivationOsAlarmRef=Rte_Al_TE_swc_test_swc_test_500ms, RteActivationOsTaskRef=swc_task
        Rte_Al_TE2_bsw_task_0_20ms: RteActivationOsAlarmRef=Rte_Al_TE2_bsw_task_0_20ms, RteActivationOsTaskRef=bsw_task
    RteGeneration:
      RteGenerationMode = COMPATIBILITY_MODE
      RteIocInteractionReturnValue = RTE_IOC
      RteValueRangeCheckEnabled = false
      RteCalibrationSupport = NONE
      RteCodeVendorId = 30
      RteDevErrorDetect = true
      RteDevErrorDetectUninit = false
      RteMeasurementSupport = false
      RteOptimizationMode = MEMORY
      RteVfbTraceEnabled = false
    RteInitializationBehavior: RteInitializationStrategy=RTE_INITIALIZATION_STRATEGY_AT_DATA_DECLARATION, RteSectionInitializationPolicy=INIT
    RteBswGeneral: RteSchMVersionInfoApi=false, RteUseComShadowSignalApi=false
    5 x RteBswModuleInstance:
      BswM: RteBswImplementationRef=BswM_Impl, RteBswModuleConfigurationRef=BswM
        BSWM_EXCLUSIVE_AREA_0 (RteBswExclusiveAreaImpl): RteExclusiveAreaImplMechanism=ALL_INTERRUPT_BLOCKING, RteBswExclusiveAreaRef=BSWM_EXCLUSIVE_AREA_0
        BswM_MainFunctionTimingEvent0 (RteBswEventToTaskMapping):
          RteBswImmediateRestart = false
          RteBswPositionInTask = 0
          RteBswEventRef = BswM_MainFunctionTimingEvent0
          RteBswMappedToTaskRef = bsw_task
          RteBswUsedOsAlarmRef = Rte_Al_TE2_bsw_task_0_10ms
          RteBswUsedOsEventRef = Rte_Ev_Cyclic2_bsw_task_0_10ms
      Dio: RteBswImplementationRef=Dio_Impl, RteBswModuleConfigurationRef=Dio
      McalLib: RteBswImplementationRef=McalLib_Impl, RteBswModuleConfigurationRef=McalLib
        4 x RteBswExclusiveAreaImpl, all with RteExclusiveAreaImplMechanism=ALL_INTERRUPT_BLOCKING:
          PeripheralEndInit: RteBswExclusiveAreaRef=PeripheralEndInit
          SafetyEndInit: RteBswExclusiveAreaRef=SafetyEndInit
          CpuEndInit: RteBswExclusiveAreaRef=CpuEndInit
          StmTimerResolution: RteBswExclusiveAreaRef=StmTimerResolution
      Mcu: RteBswImplementationRef=Mcu_Impl, RteBswModuleConfigurationRef=Mcu
        TomTgcReg (RteBswExclusiveAreaImpl): RteExclusiveAreaImplMechanism=ALL_INTERRUPT_BLOCKING, RteBswExclusiveAreaRef=TomTgcReg
        AtomAgcReg (RteBswExclusiveAreaImpl): RteExclusiveAreaImplMechanism=ALL_INTERRUPT_BLOCKING, RteBswExclusiveAreaRef=AtomAgcReg
      Port: RteBswImplementationRef=Port_Impl, RteBswModuleConfigurationRef=Port
    BswM_EcuSwComposition (RteSwComponentInstance): RteSoftwareComponentInstanceRef=BswM
      Timer_BswM_MainFunction (RteEventToTaskMapping):
        RteImmediateRestart = false
        RtePositionInTask = 0
        RteEventRef = Timer_BswM_MainFunction
        RteMappedToTaskRef = bsw_task
        RteUsedOsAlarmRef = Rte_Al_TE2_bsw_task_0_10ms
        RteUsedOsEventRef = Rte_Ev_Cyclic2_bsw_task_0_10ms
    Os_OsCore0_swc_EcuSwComposition (RteSwComponentInstance): RteSoftwareComponentInstanceRef=Os_OsCore0_swc
      OpEventGetCounterValue_GetCounterValue_OsService_SystemTimer (RteEventToTaskMapping): RteImmediateRestart=false, RteEventRef=OpEventGetCounterValue_GetCounterValue_OsService_SystemTimer
      OpEventGetElapsedValue_GetElapsedValue_OsService_SystemTimer (RteEventToTaskMapping): RteImmediateRestart=false, RteEventRef=OpEventGetElapsedValue_GetElapsedValue_OsService_SystemTimer
    EcuM (RteBswModuleInstance): RteBswImplementationRef=EcuM_Impl, RteBswModuleConfigurationRef=EcuM
      4 x RteBswExclusiveAreaImpl, all with RteExclusiveAreaImplMechanism=ALL_INTERRUPT_BLOCKING:
        ECUM_EXCLUSIVE_AREA_{0..3}: RteBswExclusiveAreaRef=ECUM_EXCLUSIVE_AREA_{0..3}
      EcuM_MainFunctionTimingEvent0 (RteBswEventToTaskMapping):
        RteBswImmediateRestart = false
        RteBswPositionInTask = 1
        RteBswEventRef = EcuM_MainFunctionTimingEvent0
        RteBswMappedToTaskRef = bsw_task
        RteBswUsedOsAlarmRef = Rte_Al_TE2_bsw_task_0_10ms
        RteBswUsedOsEventRef = Rte_Ev_Cyclic2_bsw_task_0_10ms
    Rte (RteBswModuleInstance): RteBswImplementationRef=Rte_Impl, RteBswModuleConfigurationRef=Rte
      Rte_ComSendSignalProxyPeriodicTimingEvent0 (RteBswEventToTaskMapping): RteBswImmediateRestart=false, RteBswPositionInTask=9, RteBswEventRef=Rte_ComSendSignalProxyPeriodicTimingEvent0, RteBswMappedToTaskRef=bsw_task
    EcuM_EcuSwComposition (RteSwComponentInstance): RteSoftwareComponentInstanceRef=EcuM
      8 x RteEventToTaskMapping, all with RteImmediateRestart=false:
        Timer_EcuM_MainFunction: RtePositionInTask=1, RteEventRef=Timer_EcuM_MainFunction, RteMappedToTaskRef=bsw_task, RteUsedOsAlarmRef=Rte_Al_TE2_bsw_task_0_10ms, RteUsedOsEventRef=Rte_Ev_Cyclic2_bsw_task_0_10ms
        OpEventSelectShutdownTarget_SelectShutdownTarget_EcuM_ShutdownTarget: RteEventRef=OpEventSelectShutdownTarget_SelectShutdownTarget_EcuM_ShutdownTarget
        OpEventGetShutdownTarget_GetShutdownTarget_EcuM_ShutdownTarget: RteEventRef=OpEventGetShutdownTarget_GetShutdownTarget_EcuM_ShutdownTarget
        OpEventGetLastShutdownTarget_GetLastShutdownTarget_EcuM_ShutdownTarget: RteEventRef=OpEventGetLastShutdownTarget_GetLastShutdownTarget_EcuM_ShutdownTarget
        OpEventSelectShutdownCause_SelectShutdownCause_EcuM_ShutdownTarget: RteEventRef=OpEventSelectShutdownCause_SelectShutdownCause_EcuM_ShutdownTarget
        OpEventGetShutdownCause_GetShutdownCause_EcuM_ShutdownTarget: RteEventRef=OpEventGetShutdownCause_GetShutdownCause_EcuM_ShutdownTarget
        OpEventSelectBootTarget_SelectBootTarget_EcuM_BootTarget: RteEventRef=OpEventSelectBootTarget_SelectBootTarget_EcuM_BootTarget
        OpEventGetBootTarget_GetBootTarget_EcuM_BootTarget: RteEventRef=OpEventGetBootTarget_GetBootTarget_EcuM_BootTarget
    swc_test_EcuSwComposition (RteSwComponentInstance): RteSoftwareComponentInstanceRef=swc_test
      3 x RteEventToTaskMapping, all with RteImmediateRestart=false:
        swc_test_InitEvent: RtePositionInTask=0, RteEventRef=swc_test_InitEvent, RteMappedToTaskRef=swc_init
        TMT_swc_test_500ms: RtePositionInTask=1, RteEventRef=TMT_swc_test_500ms, RteMappedToTaskRef=swc_task, RteUsedOsEventRef=Rte_Ev_Run_swc_test_swc_test_500ms, RteUsedOsAlarmRef=Rte_Al_TE_swc_test_swc_test_500ms
        TMT_swc_test_10ms: RtePositionInTask=0, RteEventRef=TMT_swc_test_10ms, RteMappedToTaskRef=swc_task, RteUsedOsEventRef=Rte_Ev_Run_swc_test_swc_test_10ms, RteUsedOsAlarmRef=Rte_Al_TE_swc_test_swc_test_10ms
    swc_test (RteSwComponentType): RteComponentTypeRef=swc_test, RteImplementationRef=swc_test_Implementation
      ComponentTypeCalibration (RteComponentTypeCalibration): RteCalibrationSupportEnabled=false
    ComM_EcuSwComposition (RteSwComponentInstance): RteSoftwareComponentInstanceRef=ComM
      13 x RteEventToTaskMapping, all with RteImmediateRestart=false:
        Timer_ComM_MainFunction_0: RtePositionInTask=2, RteEventRef=Timer_ComM_MainFunction_0, RteMappedToTaskRef=bsw_task, RteUsedOsEventRef=Rte_Ev_Cyclic2_bsw_task_0_20ms, RteUsedOsAlarmRef=Rte_Al_TE2_bsw_task_0_20ms
        OpEventGetInhibitionStatus_GetInhibitionStatus_CL_CN_testCANFDdbc_9817eee0: RteEventRef=OpEventGetInhibitionStatus_GetInhibitionStatus_CL_CN_testCANFDdbc_9817eee0
        OpEventLimitECUToNoComMode_LimitECUToNoComMode_modeLimitation: RteEventRef=OpEventLimitECUToNoComMode_LimitECUToNoComMode_modeLimitation
        OpEventReadInhibitCounter_ReadInhibitCounter_modeLimitation: RteEventRef=OpEventReadInhibitCounter_ReadInhibitCounter_modeLimitation
        OpEventResetInhibitCounter_ResetInhibitCounter_modeLimitation: RteEventRef=OpEventResetInhibitCounter_ResetInhibitCounter_modeLimitation
        OpEventSetECUGroupClassification_SetECUGroupClassification_modeLimitation: RteEventRef=OpEventSetECUGroupClassification_SetECUGroupClassification_modeLimitation
        OpEventLimitChannelToNoComMode_LimitChannelToNoComMode_CL_CN_testCANFDdbc_9817eee0: RteEventRef=OpEventLimitChannelToNoComMode_LimitChannelToNoComMode_CL_CN_testCANFDdbc_9817eee0
        OpEventPreventWakeUp_PreventWakeUp_CW_CN_testCANFDdbc_9817eee0: RteEventRef=OpEventPreventWakeUp_PreventWakeUp_CW_CN_testCANFDdbc_9817eee0
        OpEventRequestComMode_RequestComMode_UR_CN_testCANFDdbc_76c2c5ca: RteEventRef=OpEventRequestComMode_RequestComMode_UR_CN_testCANFDdbc_76c2c5ca
        OpEventGetCurrentComMode_GetCurrentComMode_UR_CN_testCANFDdbc_76c2c5ca: RteEventRef=OpEventGetCurrentComMode_GetCurrentComMode_UR_CN_testCANFDdbc_76c2c5ca
        OpEventGetMaxComMode_GetMaxComMode_UR_CN_testCANFDdbc_76c2c5ca: RteEventRef=OpEventGetMaxComMode_GetMaxComMode_UR_CN_testCANFDdbc_76c2c5ca
        OpEventGetRequestedComMode_GetRequestedComMode_UR_CN_testCANFDdbc_76c2c5ca: RteEventRef=OpEventGetRequestedComMode_GetRequestedComMode_UR_CN_testCANFDdbc_76c2c5ca
        OpEventGetInhibitionStatus_GetInhibitionStatus_CW_CN_testCANFDdbc_9817eee0: RteEventRef=OpEventGetInhibitionStatus_GetInhibitionStatus_CW_CN_testCANFDdbc_9817eee0
    Det_EcuSwComposition (RteSwComponentInstance): RteSoftwareComponentInstanceRef=Det
    8 x RteBswModuleInstance:
      Can: RteBswImplementationRef=Can_Impl, RteBswModuleConfigurationRef=Can
        3 x RteBswEventToTaskMapping, all with RteBswImmediateRestart=false, RteBswMappedToTaskRef=bsw_task, RteBswUsedOsEventRef=Rte_Ev_Cyclic2_bsw_task_0_10ms, RteBswUsedOsAlarmRef=Rte_Al_TE2_bsw_task_0_10ms:
          Can_MainFunction_BusOffTimingEvent0: RteBswPositionInTask=4, RteBswEventRef=Can_MainFunction_BusOffTimingEvent0
          Can_MainFunction_WakeupTimingEvent0: RteBswPositionInTask=6, RteBswEventRef=Can_MainFunction_WakeupTimingEvent0
          Can_MainFunction_ModeTimingEvent0: RteBswPositionInTask=5, RteBswEventRef=Can_MainFunction_ModeTimingEvent0
        8 x RteBswExclusiveAreaImpl:
          CAN_EXCLUSIVE_AREA_{0..5}: RteExclusiveAreaImplMechanism=ALL_INTERRUPT_BLOCKING, RteBswExclusiveAreaRef=CAN_EXCLUSIVE_AREA_{0..5}
          CAN_EXCLUSIVE_AREA_6: RteExclusiveAreaImplMechanism=CUSTOM, RteBswExclusiveAreaRef=CAN_EXCLUSIVE_AREA_6
          CAN_EXCLUSIVE_AREA_7: RteExclusiveAreaImplMechanism=ALL_INTERRUPT_BLOCKING, RteBswExclusiveAreaRef=CAN_EXCLUSIVE_AREA_7
      CanIf: RteBswImplementationRef=CanIf_Impl, RteBswModuleConfigurationRef=CanIf
        8 x RteBswExclusiveAreaImpl:
          CANIF_EXCLUSIVE_AREA_0: RteExclusiveAreaImplMechanism=CUSTOM, RteBswExclusiveAreaRef=CANIF_EXCLUSIVE_AREA_0
          CANIF_EXCLUSIVE_AREA_{1..7}: RteExclusiveAreaImplMechanism=ALL_INTERRUPT_BLOCKING, RteBswExclusiveAreaRef=CANIF_EXCLUSIVE_AREA_{1..7}
      CanSM: RteBswImplementationRef=CanSM_Impl, RteBswModuleConfigurationRef=CanSM
        CanSM_MainFunctionTimingEvent0 (RteBswEventToTaskMapping):
          RteBswImmediateRestart = false
          RteBswPositionInTask = 3
          RteBswEventRef = CanSM_MainFunctionTimingEvent0
          RteBswMappedToTaskRef = bsw_task
          RteBswUsedOsEventRef = Rte_Ev_Cyclic2_bsw_task_0_10ms
          RteBswUsedOsAlarmRef = Rte_Al_TE2_bsw_task_0_10ms
        6 x RteBswExclusiveAreaImpl:
          CANSM_EXCLUSIVE_AREA_1: RteExclusiveAreaImplMechanism=CUSTOM, RteBswExclusiveAreaRef=CANSM_EXCLUSIVE_AREA_1
          CANSM_EXCLUSIVE_AREA_2: RteExclusiveAreaImplMechanism=ALL_INTERRUPT_BLOCKING, RteBswExclusiveAreaRef=CANSM_EXCLUSIVE_AREA_2
          CANSM_EXCLUSIVE_AREA_3: RteExclusiveAreaImplMechanism=ALL_INTERRUPT_BLOCKING, RteBswExclusiveAreaRef=CANSM_EXCLUSIVE_AREA_3
          CANSM_EXCLUSIVE_AREA_4: RteExclusiveAreaImplMechanism=CUSTOM, RteBswExclusiveAreaRef=CANSM_EXCLUSIVE_AREA_4
          CANSM_EXCLUSIVE_AREA_5: RteExclusiveAreaImplMechanism=ALL_INTERRUPT_BLOCKING, RteBswExclusiveAreaRef=CANSM_EXCLUSIVE_AREA_5
          CANSM_EXCLUSIVE_AREA_6: RteExclusiveAreaImplMechanism=ALL_INTERRUPT_BLOCKING, RteBswExclusiveAreaRef=CANSM_EXCLUSIVE_AREA_6
      Com: RteBswImplementationRef=Com_Impl, RteBswModuleConfigurationRef=Com
        Com_MainFunctionTxTimingEvent0 (RteBswEventToTaskMapping):
          RteBswImmediateRestart = false
          RteBswPositionInTask = 8
          RteBswEventRef = Com_MainFunctionTxTimingEvent0
          RteBswMappedToTaskRef = bsw_task
          RteBswUsedOsEventRef = Rte_Ev_Cyclic2_bsw_task_0_10ms
          RteBswUsedOsAlarmRef = Rte_Al_TE2_bsw_task_0_10ms
        Com_MainFunctionRxTimingEvent0 (RteBswEventToTaskMapping):
          RteBswImmediateRestart = false
          RteBswPositionInTask = 7
          RteBswEventRef = Com_MainFunctionRxTimingEvent0
          RteBswMappedToTaskRef = bsw_task
          RteBswUsedOsEventRef = Rte_Ev_Cyclic2_bsw_task_0_10ms
          RteBswUsedOsAlarmRef = Rte_Al_TE2_bsw_task_0_10ms
        3 x RteBswExclusiveAreaImpl, all with RteExclusiveAreaImplMechanism=ALL_INTERRUPT_BLOCKING:
          COM_EXCLUSIVE_AREA_TX: RteBswExclusiveAreaRef=COM_EXCLUSIVE_AREA_TX
          COM_EXCLUSIVE_AREA_RX: RteBswExclusiveAreaRef=COM_EXCLUSIVE_AREA_RX
          COM_EXCLUSIVE_AREA_BOTH: RteBswExclusiveAreaRef=COM_EXCLUSIVE_AREA_BOTH
      ComM: RteBswImplementationRef=ComM_Impl, RteBswModuleConfigurationRef=ComM
        ComM_MainFunction_0TimingEvent0 (RteBswEventToTaskMapping):
          RteBswImmediateRestart = false
          RteBswPositionInTask = 2
          RteBswEventRef = ComM_MainFunction_0TimingEvent0
          RteBswMappedToTaskRef = bsw_task
          RteBswUsedOsEventRef = Rte_Ev_Cyclic2_bsw_task_0_20ms
          RteBswUsedOsAlarmRef = Rte_Al_TE2_bsw_task_0_20ms
        COMM_EXCLUSIVE_AREA_0 (RteBswExclusiveAreaImpl): RteExclusiveAreaImplMechanism=ALL_INTERRUPT_BLOCKING, RteBswExclusiveAreaRef=COMM_EXCLUSIVE_AREA_0
        COMM_EXCLUSIVE_AREA_1 (RteBswExclusiveAreaImpl): RteExclusiveAreaImplMechanism=CUSTOM, RteBswExclusiveAreaRef=COMM_EXCLUSIVE_AREA_1
      Det: RteBswImplementationRef=Det_Impl, RteBswModuleConfigurationRef=Det
        DET_EXCLUSIVE_AREA_0 (RteBswExclusiveAreaImpl): RteExclusiveAreaImplMechanism=ALL_INTERRUPT_BLOCKING, RteBswExclusiveAreaRef=DET_EXCLUSIVE_AREA_0
      PduR: RteBswImplementationRef=PduR_Impl, RteBswModuleConfigurationRef=PduR
        PDUR_EXCLUSIVE_AREA_0 (RteBswExclusiveAreaImpl): RteExclusiveAreaImplMechanism=ALL_INTERRUPT_BLOCKING, RteBswExclusiveAreaRef=PDUR_EXCLUSIVE_AREA_0
      SomeIpXf: RteBswImplementationRef=SomeIpXf_Impl, RteBswModuleConfigurationRef=SomeIpXf
