AUTOSAR XML (schema 00048)
package /COM/VECTOR/CFG/WORKFLOW/SYSDESC/SYNC
  flat map FLATMAP
    flat instance descriptor swc_test: upstream-reference=EcuSwComposition.swc_test, ecu-extract-reference=COMPOSITIONTYPE.swc_test
