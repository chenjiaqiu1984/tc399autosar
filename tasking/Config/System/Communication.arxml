AUTOSAR XML (schema 00048)
package /VehicleProject
  system System
package /Cluster
  can cluster testCANFDdbc: protocol-name=CAN
    can physical channel CHNL: comm-connectors=CN_testCANFDdbc
      frame RxMessage1_otestCANFDdbc: id 0x66, to testEcu, frame-length=64, can-addressing-mode=STANDARD, can-frame-rx-behavior=ANY, can-frame-tx-behavior=CAN-FD
        pdu RxMessage1_otestCANFDdbc: length=64, unused-bit-pattern=0
          signal Txsignal5_oRxMessage1_otestCANFDdbc: start 0, 8 bit, little-endian, i-signal-type=PRIMITIVE, base-type=sint8, compu-method=CM_Txsignal5, data-constr=DC_Txsignal5, transfer-property=PENDING, to testEcu
          signal Txsignal6_oRxMessage1_otestCANFDdbc: start 8, 8 bit, little-endian, i-signal-type=PRIMITIVE, base-type=sint8, compu-method=CM_Txsignal6, data-constr=DC_Txsignal6, transfer-property=PENDING, to testEcu
      frame TxMessage1_otestCANFDdbc: id 0x11, from testEcu, frame-length=64, can-addressing-mode=STANDARD, can-frame-rx-behavior=ANY, can-frame-tx-behavior=CAN-FD
        pdu TxMessage1_otestCANFDdbc: length=64, unused-bit-pattern=0
          signal Txsignal3_oTxMessage1_otestCANFDdbc: start 0, 8 bit, little-endian, i-signal-type=PRIMITIVE, base-type=sint8, compu-method=CM_Txsignal3, data-constr=DC_Txsignal3, transfer-property=PENDING
          signal Txsignal4_oTxMessage1_otestCANFDdbc: start 8, 8 bit, little-endian, i-signal-type=PRIMITIVE, base-type=sint8, compu-method=CM_Txsignal4, data-constr=DC_Txsignal4, transfer-property=PENDING
      frame TxMessage22_otestCANFDdbc: id 0x22, from testEcu, frame-length=8, can-addressing-mode=STANDARD, can-frame-rx-behavior=ANY, can-frame-tx-behavior=CAN-FD
        pdu TxMessage22_otestCANFDdbc: length=8, unused-bit-pattern=0
          signal Txsignal2_oTxMessage22_otestCANFDdbc: start 0, 8 bit, little-endian, i-signal-type=PRIMITIVE, base-type=sint8, compu-method=CM_Txsignal2, data-constr=DC_Txsignal2, transfer-property=PENDING
      frame TxMessage3_otestCANFDdbc: id 0x33, from testEcu, frame-length=32, can-addressing-mode=STANDARD, can-frame-rx-behavior=ANY, can-frame-tx-behavior=CAN-FD
        pdu TxMessage3_otestCANFDdbc: length=32, unused-bit-pattern=0
          signal Txsignal1_oTxMessage3_otestCANFDdbc: start 0, 8 bit, little-endian, i-signal-type=PRIMITIVE, base-type=sint8, compu-method=CM_Txsignal1, data-constr=DC_Txsignal1, transfer-property=PENDING
package /ECU
  ecu instance testEcu: associated-com-i-pdu-group=[testEcu_otestCANFDdbc_Rx, testEcu_otestCANFDdbc_Tx]
    can communication controller CT_testCANFDdbc
    can communication connector CN_testCANFDdbc: comm-controller=CT_testCANFDdbc
package /IPDUGroup
  i signal i pdu group testEcu_otestCANFDdbc_Rx: communication-direction=IN, i-signal-i-pdus=RxMessage1_otestCANFDdbc
  i signal i pdu group testEcu_otestCANFDdbc_Tx: communication-direction=OUT, i-signal-i-pdus=[TxMessage1_otestCANFDdbc, TxMessage22_otestCANFDdbc, TxMessage3_otestCANFDdbc]
