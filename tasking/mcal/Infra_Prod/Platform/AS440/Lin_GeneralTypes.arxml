AUTOSAR XML (schema 00046)
# Copyright (C) Infineon Technologies (2020)
# All rights reserved.
package /AUTOSAR_Lin_GeneralTypes/ImplementationDataTypes
  7 x impl type, all with type-emitter=BSW:
    Lin_FramePidType: implementation-data-type=uint8
    Lin_FrameDlType: implementation-data-type=uint8
    Lin_FrameCsModelType: compu {0=LIN_ENHANCED_CS, 1=LIN_CLASSIC_CS}, implementation-data-type=uint32, additional-native-type-qualifier=enum
    Lin_FrameResponseType: compu {0=LIN_FRAMERESPONSE_TX, 1=LIN_FRAMERESPONSE_RX, 2=LIN_FRAMERESPONSE_IGNORE}, implementation-data-type=uint32, additional-native-type-qualifier=enum
    Lin_StatusType: compu {0=LIN_NOT_OK, 1=LIN_TX_OK, 2=LIN_TX_BUSY, 3=LIN_TX_HEADER_ERROR, 4=LIN_RX_OK, 5=LIN_RX_BUSY, 6=LIN_RX_ERROR, 7=LIN_RX_NO_RESPONSE, 8=LIN_OPERATIONAL, 9=LIN_CH_SLEEP}, implementation-data-type=uint32, additional-native-type-qualifier=enum
    Lin_SlaveErrorType: compu {0=LIN_ERR_HEADER, 1=LIN_ERR_RESP_STOPBIT, 2=LIN_ERR_RESP_CHKSUM, 3=LIN_ERR_RESP_DATABIT, 4=LIN_ERR_NO_RESP, 5=LIN_ERR_INC_RESP}, implementation-data-type=uint32, additional-native-type-qualifier=enum
    Lin_PduType: category=STRUCTURE
      5 x element:
        Pid: implementation-data-type=Lin_FramePidType
        Cs: implementation-data-type=Lin_FrameCsModelType
        Drc: implementation-data-type=Lin_FrameResponseType
        Dl: implementation-data-type=Lin_FrameDlType
        SduPtr: category=DATA_REFERENCE, sw-pointer-target-props={target-category=TYPE_REFERENCE, implementation-data-type=uint8}
