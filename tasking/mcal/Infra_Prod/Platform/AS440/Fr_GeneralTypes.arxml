AUTOSAR XML (schema 00046)
# Copyright (C) Infineon Technologies (2020)
# All rights reserved.
package /AUTOSAR_Fr_GeneralTypes/ImplementationDataTypes
  10 x impl type, all with type-emitter=BSW:
    Fr_POCStateType: compu {0=FR_POCSTATE_CONFIG, 1=FR_POCSTATE_DEFAULT_CONFIG, 2=FR_POCSTATE_HALT, 3=FR_POCSTATE_NORMAL_ACTIVE, 4=FR_POCSTATE_NORMAL_PASSIVE, 5=FR_POCSTATE_READY, 6=FR_POCSTATE_STARTUP, 7=FR_POCSTATE_WAKEUP}, implementation-data-type=uint32, additional-native-type-qualifier=enum
    Fr_SlotModeType: compu {0=FR_SLOTMODE_KEYSLOT, 1=FR_SLOTMODE_ALL_PENDING, 2=FR_SLOTMODE_ALL}, implementation-data-type=uint32, additional-native-type-qualifier=enum
    Fr_ErrorModeType: compu {0=FR_ERRORMODE_ACTIVE, 1=FR_ERRORMODE_PASSIVE, 2=FR_ERRORMODE_COMM_HALT}, implementation-data-type=uint32, additional-native-type-qualifier=enum
    Fr_WakeupStatusType: compu {0=FR_WAKEUP_UNDEFINED, 1=FR_WAKEUP_RECEIVED_HEADER, 2=FR_WAKEUP_RECEIVED_WUP, 3=FR_WAKEUP_COLLISION_HEADER, 4=FR_WAKEUP_COLLISION_WUP, 5=FR_WAKEUP_COLLISION_UNKNOWN, 6=FR_WAKEUP_TRANSMITTED}, implementation-data-type=uint32, additional-native-type-qualifier=enum
    Fr_StartupStateType:
      compu {0=FR_STARTUP_UNDEFINED, 1=FR_STARTUP_COLDSTART_LISTEN, 2=FR_STARTUP_INTEGRATION_COLDSTART_CHECK, 3=FR_STARTUP_COLDSTART_JOIN, 4=FR_STARTUP_COLDSTART_COLLISION_RESOLUTION, 5=FR_STARTUP_COLDSTART_CONSISTENCY_CHECK, 6=FR_STARTUP_INTEGRATION_LISTEN, 7=FR_STARTUP_INITIALIZE_SCHEDULE, 8=FR_STARTUP_INTEGRATION_CONSISTENCY_CHECK, 9=FR_STARTUP_COLDSTART_GAP, 10=FR_STARTUP_EXTERNAL_STARTUP}
      implementation-data-type=uint32
      additional-native-type-qualifier=enum
    Fr_POCStatusType: category=STRUCTURE
      9 x element, all with category=TYPE_REFERENCE:
        State: implementation-data-type=Fr_POCStateType
        Freeze: implementation-data-type=boolean
        CHIHaltRequest: implementation-data-type=boolean
        CHIReadyRequest: implementation-data-type=boolean
        ColdstartNoise: implementation-data-type=boolean
        SlotMode: implementation-data-type=Fr_SlotModeType
        ErrorMode: implementation-data-type=Fr_ErrorModeType
        WakeupStatus: implementation-data-type=Fr_WakeupStatusType
        StartupState: implementation-data-type=Fr_StartupStateType
    Fr_TxLPduStatusType: compu {0=FR_TRANSMITTED, 1=FR_TRANSMITTED_CONFLICT, 2=FR_NOT_TRANSMITTED}, implementation-data-type=uint32, additional-native-type-qualifier=enum
    Fr_RxLPduStatusType: compu {0=FR_RECEIVED, 1=FR_NOT_RECEIVED, 2=FR_RECEIVED_MORE_DATA_AVAILABLE}, implementation-data-type=uint32, additional-native-type-qualifier=enum
    Fr_ChannelType: compu {1=FR_CHANNEL_A, 2=FR_CHANNEL_B, 3=FR_CHANNEL_AB}, implementation-data-type=uint32, additional-native-type-qualifier=enum
    Fr_SlotAssignmentType: category=STRUCTURE
      element Cycle: implementation-data-type=uint8
      element SlotId: implementation-data-type=uint16
      element ChannelId: implementation-data-type=Fr_ChannelType
