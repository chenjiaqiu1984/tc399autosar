AUTOSAR XML (schema 00046)
# Copyright (C) Infineon Technologies (2020)
# All rights reserved.
package /AUTOSAR_Eth_GeneralTypes/ImplementationDataTypes
  16 x impl type, all with type-emitter=BSW:
    Eth_BufIdxType: implementation-data-type=uint32
    Eth_DataType: implementation-data-type=uint8
    Eth_FilterActionType: compu {0=ETH_ADD_TO_FILTER, 1=ETH_REMOVE_FROM_FILTER}, implementation-data-type=uint32, additional-native-type-qualifier=enum
    Eth_FrameType: implementation-data-type=uint16
    Eth_ModeType: compu {0=ETH_MODE_DOWN, 1=ETH_MODE_ACTIVE}, implementation-data-type=uint32, additional-native-type-qualifier=enum
    Eth_RateRatioType: category=STRUCTURE
      element IngressTimeStampDelta: implementation-data-type=Eth_TimeIntDiffType
      element OriginTimeStampDelta: implementation-data-type=Eth_TimeIntDiffType
    Eth_RxStatusType: compu {0=ETH_RECEIVED, 1=ETH_NOT_RECEIVED, 2=ETH_RECEIVED_MORE_DATA_AVAILABLE}, implementation-data-type=uint32, additional-native-type-qualifier=enum
    Eth_StateType: compu {0=ETH_STATE_UNINIT, 1=ETH_STATE_INIT}, implementation-data-type=uint32, additional-native-type-qualifier=enum
    Eth_TimeIntDiffType: category=STRUCTURE
      element diff: implementation-data-type=Eth_TimeStampType
      element sign: implementation-data-type=boolean
    Eth_TimeStampQualType: compu {0=ETH_VALID, 1=ETH_INVALID, 2=ETH_UNCERTAIN}, implementation-data-type=uint32, additional-native-type-qualifier=enum
    Eth_TimeStampType: category=STRUCTURE
      element nanoseconds: implementation-data-type=uint32
      element seconds: implementation-data-type=uint32
      element secondsHi: implementation-data-type=uint16
    Eth_TxStatsType: category=STRUCTURE
      element TxNumberOfOctets: implementation-data-type=uint32
      element TxNUcastPkts: implementation-data-type=uint32
      element TxUniCastPkts: implementation-data-type=uint32
    Eth_TxErrorCounterValuesType: category=STRUCTURE
      7 x element, all with category=TYPE_REFERENCE, implementation-data-type=uint32:
        TxDroppedNoErrorPkts
        TxDroppedErrorPkts
        TxDeferredTrans
        TxSingleCollision
        TxMultipleCollision
        TxLateCollision
        TxExcessiveCollison
    Eth_CounterType: category=STRUCTURE
      18 x element, all with category=TYPE_REFERENCE, implementation-data-type=uint32:
        DropPktBufOverrun
        DropPktCrc
        UndersizePkt
        OversizePkt
        AlgnmtErr
        SqeTestErr
        DiscInbdPkt
        ErrInbdPkt
        DiscOtbdPkt
        ErrOtbdPkt
        SnglCollPkt
        MultCollPkt
        DfrdPkt
        LatCollPkt
        HwDepCtr{0..3}
    Eth_RxStatsType: category=STRUCTURE
      18 x element, all with category=TYPE_REFERENCE, implementation-data-type=uint32:
        RxStatsDropEvents
        RxStatsOctets
        RxStatsPkts
        RxStatsBroadcastPkts
        RxStatsMulticastPkts
        RxStatsCrcAlignErrors
        RxStatsUndersizePkts
        RxStatsOversizePkts
        RxStatsFragments
        RxStatsJabbers
        RxStatsCollisions
        RxStatsPkts64Octets
        RxStatsPkts65to127Octets
        RxStatsPkts128to255Octets
        RxStatsPkts256to511Octets
        RxStatsPkts512to1023Octets
        RxStatsPkts1024to1518Octets
        RxUnicastFrames
    Eth_MacVlanType: category=STRUCTURE
      element MacAddr: array-size=6, array-size-semantics=FIXED-SIZE, implementation-data-type=uint8
      element VlanId: implementation-data-type=uint16
      element SwitchPort: implementation-data-type=uint32
