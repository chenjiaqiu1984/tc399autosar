AUTOSAR XML (schema 00046)
# Copyright (C) Infineon Technologies (2020)
# All rights reserved.
package /AUTOSAR_Can_GeneralTypes/ImplementationDataTypes
  9 x impl type, all with type-emitter=BSW:
    Can_HwHandleType: implementation-data-type=uint16
    Can_HwType: category=STRUCTURE
      element CanId: implementation-data-type=Can_IdType
      element Hoh: implementation-data-type=Can_HwHandleType
      element ControllerId: implementation-data-type=uint8
    Can_PduType: category=STRUCTURE
      4 x element:
        swPduHandle: implementation-data-type=PduIdType
        length: implementation-data-type=uint8
        id: implementation-data-type=Can_IdType
        sdu: category=DATA_REFERENCE, sw-pointer-target-props={target-category=TYPE_REFERENCE, implementation-data-type=uint8}
    Can_IdType: implementation-data-type=uint32
    Can_ControllerStateType: compu {0=CAN_CS_UNINIT, 1=CAN_CS_STARTED, 2=CAN_CS_STOPPED, 3=CAN_CS_SLEEP}, implementation-data-type=uint32, additional-native-type-qualifier=enum
    Can_ErrorStateType: compu {0=CAN_ERRORSTATE_ACTIVE, 1=CAN_ERRORSTATE_PASSIVE, 2=CAN_ERRORSTATE_BUSOFF}, implementation-data-type=uint32, additional-native-type-qualifier=enum
    CanTrcv_TrcvModeType: compu {0=CANTRCV_TRCVMODE_NORMAL, 1=CANTRCV_TRCVMODE_SLEEP, 2=CANTRCV_TRCVMODE_STANDBY}, implementation-data-type=uint32, additional-native-type-qualifier=enum
    CanTrcv_TrcvWakeupModeType: compu {0=CANTRCV_WUMODE_ENABLE, 1=CANTRCV_WUMODE_DISABLE, 2=CANTRCV_WUMODE_CLEAR}, implementation-data-type=uint32, additional-native-type-qualifier=enum
    CanTrcv_TrcvWakeupReasonType: compu {0=CANTRCV_WU_ERROR, 1=CANTRCV_WU_NOT_SUPPORTED, 2=CANTRCV_WU_BY_BUS, 3=CANTRCV_WU_INTERNALLY, 4=CANTRCV_WU_RESET, 5=CANTRCV_WU_POWER_ON, 6=CANTRCV_WU_BY_PIN, 7=CANTRCV_WU_BY_SYSERR}, implementation-data-type=uint32, additional-native-type-qualifier=enum
