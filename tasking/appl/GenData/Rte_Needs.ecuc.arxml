AUTOSAR XML (schema 4-0-3)
package /DaVinci_Project
  module config Rte
    6 x RteBswModuleInstance:
      BswM
        BswM_MainFunctionTimingEvent0 (RteBswEventToTaskMapping): RteBswUsedOsAlarmRef=Os/Rte_Al_TE2_bsw_task_0_10ms
      Dio
      EcuM
        EcuM_MainFunctionTimingEvent0 (RteBswEventToTaskMapping): RteBswUsedOsAlarmRef=Os/Rte_Al_TE2_bsw_task_0_10ms
      McalLib
      Mcu
      Port
    4 x RteSwComponentInstance:
      BswM_EcuSwComposition
        Timer_BswM_MainFunction (RteEventToTaskMapping): RteUsedOsAlarmRef=Os/Rte_Al_TE2_bsw_task_0_10ms
      EcuM_EcuSwComposition
        Timer_EcuM_MainFunction (RteEventToTaskMapping): RteUsedOsAlarmRef=Os/Rte_Al_TE2_bsw_task_0_10ms
      Os_OsCore0_swc_EcuSwComposition
      swc_test_EcuSwComposition
        TMT_swc_test_10ms (RteEventToTaskMapping): RteUsedOsEventRef=Rte_Ev_Run_swc_test_swc_test_10ms, RteUsedOsAlarmRef=Os/Rte_Al_TE_swc_test_swc_test_10ms
        TMT_swc_test_500ms (RteEventToTaskMapping): RteUsedOsEventRef=Rte_Ev_Run_swc_test_swc_test_500ms, RteUsedOsAlarmRef=Os/Rte_Al_TE_swc_test_swc_test_500ms
    RteOsInteraction
      3 x RteUsedOsActivation, all with RteExpectedActivationOffset=0:
        Rte_Al_TE2_bsw_task_0_10ms: RteActivationOsAlarmRef=Os/Rte_Al_TE2_bsw_task_0_10ms, RteActivationOsTaskRef=bsw_task
        Rte_Al_TE_swc_test_swc_test_10ms: RteActivationOsAlarmRef=Os/Rte_Al_TE_swc_test_swc_test_10ms, RteActivationOsTaskRef=swc_task
        Rte_Al_TE_swc_test_swc_test_500ms: RteActivationOsAlarmRef=Os/Rte_Al_TE_swc_test_swc_test_500ms, RteActivationOsTaskRef=swc_task
  module config NvM
  module config Os
    bsw_task (OsTask): OsTaskActivation=1, OsTaskPriority=29, OsTaskSchedule=FULL
    Rte_Al_TE2_bsw_task_0_10ms (OsAlarm): OsAlarmCounterRef=SystemTimer
      OsAlarmAction
        OsAlarmActivateTask: OsAlarmActivateTaskRef=bsw_task
    swc_init (OsTask): OsTaskActivation=1, OsTaskPriority=48, OsTaskSchedule=FULL
    swc_task (OsTask):
      OsTaskActivation = 1
      OsTaskPriority = 30
      OsTaskSchedule = FULL
      OsTaskEventRef = Rte_Ev_Run_swc_test_swc_test_10ms
      OsTaskEventRef = Rte_Ev_Run_swc_test_swc_test_500ms
    Rte_Al_TE_swc_test_swc_test_10ms (OsAlarm): OsAlarmCounterRef=SystemTimer
      OsAlarmAction
        OsAlarmSetEvent: OsAlarmSetEventRef=Rte_Ev_Run_swc_test_swc_test_10ms, OsAlarmSetEventTaskRef=swc_task
    Rte_Al_TE_swc_test_swc_test_500ms (OsAlarm): OsAlarmCounterRef=SystemTimer
      OsAlarmAction
        OsAlarmSetEvent: OsAlarmSetEventRef=Rte_Ev_Run_swc_test_swc_test_500ms, OsAlarmSetEventTaskRef=swc_task
    Rte_Ev_Run_swc_test_swc_test_10ms (OsEvent)
    Rte_Ev_Run_swc_test_swc_test_500ms (OsEvent)
  module config EcuC
  ecuc value collection DaVinci_Project: ecuc-values=[Com, Rte, Os, EcuC, NvM]
