AUTOSAR XML (schema 4-0-3)
package /DaVinci_Project
  module config Rte
    14 x RteBswModuleInstance:
      BswM
        BswM_MainFunctionTimingEvent0 (RteBswEventToTaskMapping): RteBswUsedOsEventRef=Rte_Ev_Cyclic2_bsw_task_0_10ms, RteBswUsedOsAlarmRef=Os/Rte_Al_TE2_bsw_task_0_10ms
      Can
        3 x RteBswEventToTaskMapping, all with RteBswUsedOsEventRef=Rte_Ev_Cyclic2_bsw_task_0_10ms, RteBswUsedOsAlarmRef=Os/Rte_Al_TE2_bsw_task_0_10ms:
          Can_MainFunction_BusOffTimingEvent0
          Can_MainFunction_ModeTimingEvent0
          Can_MainFunction_WakeupTimingEvent0
      CanIf
      CanSM
        CanSM_MainFunctionTimingEvent0 (RteBswEventToTaskMapping): RteBswUsedOsEventRef=Rte_Ev_Cyclic2_bsw_task_0_10ms, RteBswUsedOsAlarmRef=Os/Rte_Al_TE2_bsw_task_0_10ms
      Com
        Com_MainFunctionRxTimingEvent0 (RteBswEventToTaskMapping): RteBswUsedOsEventRef=Rte_Ev_Cyclic2_bsw_task_0_10ms, RteBswUsedOsAlarmRef=Os/Rte_Al_TE2_bsw_task_0_10ms
        Com_MainFunctionTxTimingEvent0 (RteBswEventToTaskMapping): RteBswUsedOsEventRef=Rte_Ev_Cyclic2_bsw_task_0_10ms, RteBswUsedOsAlarmRef=Os/Rte_Al_TE2_bsw_task_0_10ms
      ComM
        ComM_MainFunction_0TimingEvent0 (RteBswEventToTaskMapping): RteBswUsedOsEventRef=Rte_Ev_Cyclic2_bsw_task_0_20ms, RteBswUsedOsAlarmRef=Os/Rte_Al_TE2_bsw_task_0_20ms
      Det
      Dio
      EcuM
        EcuM_MainFunctionTimingEvent0 (RteBswEventToTaskMapping): RteBswUsedOsEventRef=Rte_Ev_Cyclic2_bsw_task_0_10ms, RteBswUsedOsAlarmRef=Os/Rte_Al_TE2_bsw_task_0_10ms
      McalLib
      Mcu
      PduR
      Port
      SomeIpXf
    6 x RteSwComponentInstance:
      BswM_EcuSwComposition
        Timer_BswM_MainFunction (RteEventToTaskMapping): RteUsedOsEventRef=Rte_Ev_Cyclic2_bsw_task_0_10ms, RteUsedOsAlarmRef=Os/Rte_Al_TE2_bsw_task_0_10ms
      ComM_EcuSwComposition
        Timer_ComM_MainFunction_0 (RteEventToTaskMapping): RteUsedOsEventRef=Rte_Ev_Cyclic2_bsw_task_0_20ms, RteUsedOsAlarmRef=Os/Rte_Al_TE2_bsw_task_0_20ms
      Det_EcuSwComposition
      EcuM_EcuSwComposition
        Timer_EcuM_MainFunction (RteEventToTaskMapping): RteUsedOsEventRef=Rte_Ev_Cyclic2_bsw_task_0_10ms, RteUsedOsAlarmRef=Os/Rte_Al_TE2_bsw_task_0_10ms
      Os_OsCore0_swc_EcuSwComposition
      swc_test_EcuSwComposition
        TMT_swc_test_10ms (RteEventToTaskMapping): RteUsedOsEventRef=Rte_Ev_Run_swc_test_swc_test_10ms, RteUsedOsAlarmRef=Os/Rte_Al_TE_swc_test_swc_test_10ms
        TMT_swc_test_500ms (RteEventToTaskMapping): RteUsedOsEventRef=Rte_Ev_Run_swc_test_swc_test_500ms, RteUsedOsAlarmRef=Os/Rte_Al_TE_swc_test_swc_test_500ms
    RteOsInteraction
      4 x RteUsedOsActivation, all with RteExpectedActivationOffset=0:
        Rte_Al_TE2_bsw_task_0_10ms: RteActivationOsAlarmRef=Os/Rte_Al_TE2_bsw_task_0_10ms, RteActivationOsTaskRef=bsw_task
        Rte_Al_TE2_bsw_task_0_20ms: RteActivationOsAlarmRef=Os/Rte_Al_TE2_bsw_task_0_20ms, RteActivationOsTaskRef=bsw_task
        Rte_Al_TE_swc_test_swc_test_10ms: RteActivationOsAlarmRef=Os/Rte_Al_TE_swc_test_swc_test_10ms, RteActivationOsTaskRef=swc_task
        Rte_Al_TE_swc_test_swc_test_500ms: RteActivationOsAlarmRef=Os/Rte_Al_TE_swc_test_swc_test_500ms, RteActivationOsTaskRef=swc_task
  module config NvM
  module config Os
    bsw_task (OsTask):
      OsTaskActivation = 1
      OsTaskPriority = 29
      OsTaskSchedule = FULL
      OsTaskEventRef = Rte_Ev_Cyclic2_bsw_task_0_10ms
      OsTaskEventRef = Rte_Ev_Cyclic2_bsw_task_0_20ms
    Rte_Al_TE2_bsw_task_0_10ms (OsAlarm): OsAlarmCounterRef=SystemTimer
      OsAlarmAction
        OsAlarmSetEvent: OsAlarmSetEventRef=Rte_Ev_Cyclic2_bsw_task_0_10ms, OsAlarmSetEventTaskRef=bsw_task
    Rte_Al_TE2_bsw_task_0_20ms (OsAlarm): OsAlarmCounterRef=SystemTimer
      OsAlarmAction
        OsAlarmSetEvent: OsAlarmSetEventRef=Rte_Ev_Cyclic2_bsw_task_0_20ms, OsAlarmSetEventTaskRef=bsw_task
    swc_init (OsTask): OsTaskActivation=1, OsTaskPriority=48, OsTaskSchedule=FULL
    swc_task (OsTask):
      OsTaskActivation = 1
      OsTaskPriority = 30
      OsTaskSchedule = FULL
      OsTaskEventRef = Rte_Ev_Run_swc_test_swc_test_10ms
      OsTaskEventRef = Rte_Ev_Run_swc_test_swc_test_500ms
    Rte_Al_TE_swc_test_swc_test_10ms (OsAlarm): OsAlarmCounterRef=SystemTimer
      OsAlarmAction
        OsAlarmSetEvent: OsAlarmSetEventRef=Rte_Ev_Run_swc_test_swc_test_10ms, OsAlarmSetEventTaskRef=swc_task
    Rte_Al_TE_swc_test_swc_test_500ms (OsAlarm): OsAlarmCounterRef=SystemTimer
      OsAlarmAction
        OsAlarmSetEvent: OsAlarmSetEventRef=Rte_Ev_Run_swc_test_swc_test_500ms, OsAlarmSetEventTaskRef=swc_task
    4 x OsEvent:
      Rte_Ev_Cyclic2_bsw_task_0_10ms
      Rte_Ev_Cyclic2_bsw_task_0_20ms
      Rte_Ev_Run_swc_test_swc_test_10ms
      Rte_Ev_Run_swc_test_swc_test_500ms
  module config EcuC
  ecuc value collection DaVinci_Project: ecuc-values=[Com, Rte, Os, EcuC, NvM]
