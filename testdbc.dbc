VERSION ""

NS_ :

BS_:

BU_: New_Node_8 TestECU

BO_ 68 MessageRx: 1 New_Node_8
 SG_ signalTest5 : 0|64@1- (1,0) [0|0] ""  TestECU

BO_ 51 MessageTest3: 8 TestECU
 SG_ signalTest : 0|64@1- (1,0) [0|0] "" Vector__XXX

BO_ 34 MessageTest2: 8 TestECU
 SG_ signalTest4 : 32|8@1- (1,0) [0|0] "" Vector__XXX
 SG_ signalTest3 : 0|32@1- (1,0) [0|0] "" Vector__XXX

BO_ 17 MessageTest1: 8 TestECU
 SG_ signalTest2 : 16|16@1- (1,0) [0|0] "" Vector__XXX
 SG_ signalTest1 : 0|8@1- (1,0) [0|0] "" Vector__XXX

BA_DEF_  "BusType" STRING ;
BA_DEF_DEF_  "BusType" "CAN";
